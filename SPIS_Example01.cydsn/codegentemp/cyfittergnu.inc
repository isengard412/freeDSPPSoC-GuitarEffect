.ifndef INCLUDED_CYFITTERGNU_INC
.set INCLUDED_CYFITTERGNU_INC, 1
.include "cydevicegnu.inc"
.include "cydevicegnu_trm.inc"

/* ss */
.set ss__0__INTTYPE, CYREG_PICU15_INTTYPE0
.set ss__0__MASK, 0x01
.set ss__0__PC, CYREG_IO_PC_PRT15_PC0
.set ss__0__PORT, 15
.set ss__0__SHIFT, 0
.set ss__AG, CYREG_PRT15_AG
.set ss__AMUX, CYREG_PRT15_AMUX
.set ss__BIE, CYREG_PRT15_BIE
.set ss__BIT_MASK, CYREG_PRT15_BIT_MASK
.set ss__BYP, CYREG_PRT15_BYP
.set ss__CTL, CYREG_PRT15_CTL
.set ss__DM0, CYREG_PRT15_DM0
.set ss__DM1, CYREG_PRT15_DM1
.set ss__DM2, CYREG_PRT15_DM2
.set ss__DR, CYREG_PRT15_DR
.set ss__INP_DIS, CYREG_PRT15_INP_DIS
.set ss__INTTYPE_BASE, CYDEV_PICU_INTTYPE_PICU15_BASE
.set ss__LCD_COM_SEG, CYREG_PRT15_LCD_COM_SEG
.set ss__LCD_EN, CYREG_PRT15_LCD_EN
.set ss__MASK, 0x01
.set ss__PORT, 15
.set ss__PRT, CYREG_PRT15_PRT
.set ss__PRTDSI__CAPS_SEL, CYREG_PRT15_CAPS_SEL
.set ss__PRTDSI__DBL_SYNC_IN, CYREG_PRT15_DBL_SYNC_IN
.set ss__PRTDSI__OE_SEL0, CYREG_PRT15_OE_SEL0
.set ss__PRTDSI__OE_SEL1, CYREG_PRT15_OE_SEL1
.set ss__PRTDSI__OUT_SEL0, CYREG_PRT15_OUT_SEL0
.set ss__PRTDSI__OUT_SEL1, CYREG_PRT15_OUT_SEL1
.set ss__PRTDSI__SYNC_OUT, CYREG_PRT15_SYNC_OUT
.set ss__PS, CYREG_PRT15_PS
.set ss__SHIFT, 0
.set ss__SLW, CYREG_PRT15_SLW

/* LCD_LCDPort */
.set LCD_LCDPort__0__INTTYPE, CYREG_PICU2_INTTYPE0
.set LCD_LCDPort__0__MASK, 0x01
.set LCD_LCDPort__0__PC, CYREG_PRT2_PC0
.set LCD_LCDPort__0__PORT, 2
.set LCD_LCDPort__0__SHIFT, 0
.set LCD_LCDPort__1__INTTYPE, CYREG_PICU2_INTTYPE1
.set LCD_LCDPort__1__MASK, 0x02
.set LCD_LCDPort__1__PC, CYREG_PRT2_PC1
.set LCD_LCDPort__1__PORT, 2
.set LCD_LCDPort__1__SHIFT, 1
.set LCD_LCDPort__2__INTTYPE, CYREG_PICU2_INTTYPE2
.set LCD_LCDPort__2__MASK, 0x04
.set LCD_LCDPort__2__PC, CYREG_PRT2_PC2
.set LCD_LCDPort__2__PORT, 2
.set LCD_LCDPort__2__SHIFT, 2
.set LCD_LCDPort__3__INTTYPE, CYREG_PICU2_INTTYPE3
.set LCD_LCDPort__3__MASK, 0x08
.set LCD_LCDPort__3__PC, CYREG_PRT2_PC3
.set LCD_LCDPort__3__PORT, 2
.set LCD_LCDPort__3__SHIFT, 3
.set LCD_LCDPort__4__INTTYPE, CYREG_PICU2_INTTYPE4
.set LCD_LCDPort__4__MASK, 0x10
.set LCD_LCDPort__4__PC, CYREG_PRT2_PC4
.set LCD_LCDPort__4__PORT, 2
.set LCD_LCDPort__4__SHIFT, 4
.set LCD_LCDPort__5__INTTYPE, CYREG_PICU2_INTTYPE5
.set LCD_LCDPort__5__MASK, 0x20
.set LCD_LCDPort__5__PC, CYREG_PRT2_PC5
.set LCD_LCDPort__5__PORT, 2
.set LCD_LCDPort__5__SHIFT, 5
.set LCD_LCDPort__6__INTTYPE, CYREG_PICU2_INTTYPE6
.set LCD_LCDPort__6__MASK, 0x40
.set LCD_LCDPort__6__PC, CYREG_PRT2_PC6
.set LCD_LCDPort__6__PORT, 2
.set LCD_LCDPort__6__SHIFT, 6
.set LCD_LCDPort__AG, CYREG_PRT2_AG
.set LCD_LCDPort__AMUX, CYREG_PRT2_AMUX
.set LCD_LCDPort__BIE, CYREG_PRT2_BIE
.set LCD_LCDPort__BIT_MASK, CYREG_PRT2_BIT_MASK
.set LCD_LCDPort__BYP, CYREG_PRT2_BYP
.set LCD_LCDPort__CTL, CYREG_PRT2_CTL
.set LCD_LCDPort__DM0, CYREG_PRT2_DM0
.set LCD_LCDPort__DM1, CYREG_PRT2_DM1
.set LCD_LCDPort__DM2, CYREG_PRT2_DM2
.set LCD_LCDPort__DR, CYREG_PRT2_DR
.set LCD_LCDPort__INP_DIS, CYREG_PRT2_INP_DIS
.set LCD_LCDPort__INTTYPE_BASE, CYDEV_PICU_INTTYPE_PICU2_BASE
.set LCD_LCDPort__LCD_COM_SEG, CYREG_PRT2_LCD_COM_SEG
.set LCD_LCDPort__LCD_EN, CYREG_PRT2_LCD_EN
.set LCD_LCDPort__MASK, 0x7F
.set LCD_LCDPort__PORT, 2
.set LCD_LCDPort__PRT, CYREG_PRT2_PRT
.set LCD_LCDPort__PRTDSI__CAPS_SEL, CYREG_PRT2_CAPS_SEL
.set LCD_LCDPort__PRTDSI__DBL_SYNC_IN, CYREG_PRT2_DBL_SYNC_IN
.set LCD_LCDPort__PRTDSI__OE_SEL0, CYREG_PRT2_OE_SEL0
.set LCD_LCDPort__PRTDSI__OE_SEL1, CYREG_PRT2_OE_SEL1
.set LCD_LCDPort__PRTDSI__OUT_SEL0, CYREG_PRT2_OUT_SEL0
.set LCD_LCDPort__PRTDSI__OUT_SEL1, CYREG_PRT2_OUT_SEL1
.set LCD_LCDPort__PRTDSI__SYNC_OUT, CYREG_PRT2_SYNC_OUT
.set LCD_LCDPort__PS, CYREG_PRT2_PS
.set LCD_LCDPort__SHIFT, 0
.set LCD_LCDPort__SLW, CYREG_PRT2_SLW

/* SPIS_BSPIS */
.set SPIS_BSPIS_BitCounter__16BIT_CONTROL_AUX_CTL_REG, CYREG_B0_UDB07_08_ACTL
.set SPIS_BSPIS_BitCounter__16BIT_CONTROL_CONTROL_REG, CYREG_B0_UDB07_08_CTL
.set SPIS_BSPIS_BitCounter__16BIT_CONTROL_COUNT_REG, CYREG_B0_UDB07_08_CTL
.set SPIS_BSPIS_BitCounter__16BIT_COUNT_CONTROL_REG, CYREG_B0_UDB07_08_CTL
.set SPIS_BSPIS_BitCounter__16BIT_COUNT_COUNT_REG, CYREG_B0_UDB07_08_CTL
.set SPIS_BSPIS_BitCounter__16BIT_MASK_MASK_REG, CYREG_B0_UDB07_08_MSK
.set SPIS_BSPIS_BitCounter__16BIT_MASK_PERIOD_REG, CYREG_B0_UDB07_08_MSK
.set SPIS_BSPIS_BitCounter__16BIT_PERIOD_MASK_REG, CYREG_B0_UDB07_08_MSK
.set SPIS_BSPIS_BitCounter__16BIT_PERIOD_PERIOD_REG, CYREG_B0_UDB07_08_MSK
.set SPIS_BSPIS_BitCounter__CONTROL_AUX_CTL_REG, CYREG_B0_UDB07_ACTL
.set SPIS_BSPIS_BitCounter__CONTROL_REG, CYREG_B0_UDB07_CTL
.set SPIS_BSPIS_BitCounter__CONTROL_ST_REG, CYREG_B0_UDB07_ST_CTL
.set SPIS_BSPIS_BitCounter__COUNT_REG, CYREG_B0_UDB07_CTL
.set SPIS_BSPIS_BitCounter__COUNT_ST_REG, CYREG_B0_UDB07_ST_CTL
.set SPIS_BSPIS_BitCounter__MASK_CTL_AUX_CTL_REG, CYREG_B0_UDB07_MSK_ACTL
.set SPIS_BSPIS_BitCounter__PER_CTL_AUX_CTL_REG, CYREG_B0_UDB07_MSK_ACTL
.set SPIS_BSPIS_BitCounter__PERIOD_REG, CYREG_B0_UDB07_MSK
.set SPIS_BSPIS_BitCounter_ST__16BIT_STATUS_AUX_CTL_REG, CYREG_B0_UDB07_08_ACTL
.set SPIS_BSPIS_BitCounter_ST__16BIT_STATUS_REG, CYREG_B0_UDB07_08_ST
.set SPIS_BSPIS_BitCounter_ST__MASK_REG, CYREG_B0_UDB07_MSK
.set SPIS_BSPIS_BitCounter_ST__MASK_ST_AUX_CTL_REG, CYREG_B0_UDB07_MSK_ACTL
.set SPIS_BSPIS_BitCounter_ST__PER_ST_AUX_CTL_REG, CYREG_B0_UDB07_MSK_ACTL
.set SPIS_BSPIS_BitCounter_ST__STATUS_AUX_CTL_REG, CYREG_B0_UDB07_ACTL
.set SPIS_BSPIS_BitCounter_ST__STATUS_CNT_REG, CYREG_B0_UDB07_ST_CTL
.set SPIS_BSPIS_BitCounter_ST__STATUS_CONTROL_REG, CYREG_B0_UDB07_ST_CTL
.set SPIS_BSPIS_BitCounter_ST__STATUS_REG, CYREG_B0_UDB07_ST
.set SPIS_BSPIS_RxStsReg__16BIT_STATUS_AUX_CTL_REG, CYREG_B1_UDB06_07_ACTL
.set SPIS_BSPIS_RxStsReg__16BIT_STATUS_REG, CYREG_B1_UDB06_07_ST
.set SPIS_BSPIS_RxStsReg__3__MASK, 0x08
.set SPIS_BSPIS_RxStsReg__3__POS, 3
.set SPIS_BSPIS_RxStsReg__4__MASK, 0x10
.set SPIS_BSPIS_RxStsReg__4__POS, 4
.set SPIS_BSPIS_RxStsReg__5__MASK, 0x20
.set SPIS_BSPIS_RxStsReg__5__POS, 5
.set SPIS_BSPIS_RxStsReg__6__MASK, 0x40
.set SPIS_BSPIS_RxStsReg__6__POS, 6
.set SPIS_BSPIS_RxStsReg__MASK, 0x78
.set SPIS_BSPIS_RxStsReg__MASK_REG, CYREG_B1_UDB06_MSK
.set SPIS_BSPIS_RxStsReg__STATUS_AUX_CTL_REG, CYREG_B1_UDB06_ACTL
.set SPIS_BSPIS_RxStsReg__STATUS_REG, CYREG_B1_UDB06_ST
.set SPIS_BSPIS_sR8_Dp_u0__16BIT_A0_REG, CYREG_B0_UDB07_08_A0
.set SPIS_BSPIS_sR8_Dp_u0__16BIT_A1_REG, CYREG_B0_UDB07_08_A1
.set SPIS_BSPIS_sR8_Dp_u0__16BIT_D0_REG, CYREG_B0_UDB07_08_D0
.set SPIS_BSPIS_sR8_Dp_u0__16BIT_D1_REG, CYREG_B0_UDB07_08_D1
.set SPIS_BSPIS_sR8_Dp_u0__16BIT_DP_AUX_CTL_REG, CYREG_B0_UDB07_08_ACTL
.set SPIS_BSPIS_sR8_Dp_u0__16BIT_F0_REG, CYREG_B0_UDB07_08_F0
.set SPIS_BSPIS_sR8_Dp_u0__16BIT_F1_REG, CYREG_B0_UDB07_08_F1
.set SPIS_BSPIS_sR8_Dp_u0__A0_A1_REG, CYREG_B0_UDB07_A0_A1
.set SPIS_BSPIS_sR8_Dp_u0__A0_REG, CYREG_B0_UDB07_A0
.set SPIS_BSPIS_sR8_Dp_u0__A1_REG, CYREG_B0_UDB07_A1
.set SPIS_BSPIS_sR8_Dp_u0__D0_D1_REG, CYREG_B0_UDB07_D0_D1
.set SPIS_BSPIS_sR8_Dp_u0__D0_REG, CYREG_B0_UDB07_D0
.set SPIS_BSPIS_sR8_Dp_u0__D1_REG, CYREG_B0_UDB07_D1
.set SPIS_BSPIS_sR8_Dp_u0__DP_AUX_CTL_REG, CYREG_B0_UDB07_ACTL
.set SPIS_BSPIS_sR8_Dp_u0__F0_F1_REG, CYREG_B0_UDB07_F0_F1
.set SPIS_BSPIS_sR8_Dp_u0__F0_REG, CYREG_B0_UDB07_F0
.set SPIS_BSPIS_sR8_Dp_u0__F1_REG, CYREG_B0_UDB07_F1
.set SPIS_BSPIS_sR8_Dp_u0__MSK_DP_AUX_CTL_REG, CYREG_B0_UDB07_MSK_ACTL
.set SPIS_BSPIS_sR8_Dp_u0__PER_DP_AUX_CTL_REG, CYREG_B0_UDB07_MSK_ACTL
.set SPIS_BSPIS_TxStsReg__0__MASK, 0x01
.set SPIS_BSPIS_TxStsReg__0__POS, 0
.set SPIS_BSPIS_TxStsReg__1__MASK, 0x02
.set SPIS_BSPIS_TxStsReg__1__POS, 1
.set SPIS_BSPIS_TxStsReg__16BIT_STATUS_AUX_CTL_REG, CYREG_B1_UDB04_05_ACTL
.set SPIS_BSPIS_TxStsReg__16BIT_STATUS_REG, CYREG_B1_UDB04_05_ST
.set SPIS_BSPIS_TxStsReg__2__MASK, 0x04
.set SPIS_BSPIS_TxStsReg__2__POS, 2
.set SPIS_BSPIS_TxStsReg__6__MASK, 0x40
.set SPIS_BSPIS_TxStsReg__6__POS, 6
.set SPIS_BSPIS_TxStsReg__MASK, 0x47
.set SPIS_BSPIS_TxStsReg__MASK_REG, CYREG_B1_UDB04_MSK
.set SPIS_BSPIS_TxStsReg__STATUS_AUX_CTL_REG, CYREG_B1_UDB04_ACTL
.set SPIS_BSPIS_TxStsReg__STATUS_REG, CYREG_B1_UDB04_ST

/* miso */
.set miso__0__INTTYPE, CYREG_PICU15_INTTYPE2
.set miso__0__MASK, 0x04
.set miso__0__PC, CYREG_IO_PC_PRT15_PC2
.set miso__0__PORT, 15
.set miso__0__SHIFT, 2
.set miso__AG, CYREG_PRT15_AG
.set miso__AMUX, CYREG_PRT15_AMUX
.set miso__BIE, CYREG_PRT15_BIE
.set miso__BIT_MASK, CYREG_PRT15_BIT_MASK
.set miso__BYP, CYREG_PRT15_BYP
.set miso__CTL, CYREG_PRT15_CTL
.set miso__DM0, CYREG_PRT15_DM0
.set miso__DM1, CYREG_PRT15_DM1
.set miso__DM2, CYREG_PRT15_DM2
.set miso__DR, CYREG_PRT15_DR
.set miso__INP_DIS, CYREG_PRT15_INP_DIS
.set miso__INTTYPE_BASE, CYDEV_PICU_INTTYPE_PICU15_BASE
.set miso__LCD_COM_SEG, CYREG_PRT15_LCD_COM_SEG
.set miso__LCD_EN, CYREG_PRT15_LCD_EN
.set miso__MASK, 0x04
.set miso__PORT, 15
.set miso__PRT, CYREG_PRT15_PRT
.set miso__PRTDSI__CAPS_SEL, CYREG_PRT15_CAPS_SEL
.set miso__PRTDSI__DBL_SYNC_IN, CYREG_PRT15_DBL_SYNC_IN
.set miso__PRTDSI__OE_SEL0, CYREG_PRT15_OE_SEL0
.set miso__PRTDSI__OE_SEL1, CYREG_PRT15_OE_SEL1
.set miso__PRTDSI__OUT_SEL0, CYREG_PRT15_OUT_SEL0
.set miso__PRTDSI__OUT_SEL1, CYREG_PRT15_OUT_SEL1
.set miso__PRTDSI__SYNC_OUT, CYREG_PRT15_SYNC_OUT
.set miso__PS, CYREG_PRT15_PS
.set miso__SHIFT, 2
.set miso__SLW, CYREG_PRT15_SLW

/* mosi */
.set mosi__0__INTTYPE, CYREG_PICU12_INTTYPE3
.set mosi__0__MASK, 0x08
.set mosi__0__PC, CYREG_PRT12_PC3
.set mosi__0__PORT, 12
.set mosi__0__SHIFT, 3
.set mosi__AG, CYREG_PRT12_AG
.set mosi__BIE, CYREG_PRT12_BIE
.set mosi__BIT_MASK, CYREG_PRT12_BIT_MASK
.set mosi__BYP, CYREG_PRT12_BYP
.set mosi__DM0, CYREG_PRT12_DM0
.set mosi__DM1, CYREG_PRT12_DM1
.set mosi__DM2, CYREG_PRT12_DM2
.set mosi__DR, CYREG_PRT12_DR
.set mosi__INP_DIS, CYREG_PRT12_INP_DIS
.set mosi__INTTYPE_BASE, CYDEV_PICU_INTTYPE_PICU12_BASE
.set mosi__MASK, 0x08
.set mosi__PORT, 12
.set mosi__PRT, CYREG_PRT12_PRT
.set mosi__PRTDSI__DBL_SYNC_IN, CYREG_PRT12_DBL_SYNC_IN
.set mosi__PRTDSI__OE_SEL0, CYREG_PRT12_OE_SEL0
.set mosi__PRTDSI__OE_SEL1, CYREG_PRT12_OE_SEL1
.set mosi__PRTDSI__OUT_SEL0, CYREG_PRT12_OUT_SEL0
.set mosi__PRTDSI__OUT_SEL1, CYREG_PRT12_OUT_SEL1
.set mosi__PRTDSI__SYNC_OUT, CYREG_PRT12_SYNC_OUT
.set mosi__PS, CYREG_PRT12_PS
.set mosi__SHIFT, 3
.set mosi__SIO_CFG, CYREG_PRT12_SIO_CFG
.set mosi__SIO_DIFF, CYREG_PRT12_SIO_DIFF
.set mosi__SIO_HYST_EN, CYREG_PRT12_SIO_HYST_EN
.set mosi__SIO_REG_HIFREQ, CYREG_PRT12_SIO_REG_HIFREQ
.set mosi__SLW, CYREG_PRT12_SLW

/* sclk */
.set sclk__0__INTTYPE, CYREG_PICU12_INTTYPE2
.set sclk__0__MASK, 0x04
.set sclk__0__PC, CYREG_PRT12_PC2
.set sclk__0__PORT, 12
.set sclk__0__SHIFT, 2
.set sclk__AG, CYREG_PRT12_AG
.set sclk__BIE, CYREG_PRT12_BIE
.set sclk__BIT_MASK, CYREG_PRT12_BIT_MASK
.set sclk__BYP, CYREG_PRT12_BYP
.set sclk__DM0, CYREG_PRT12_DM0
.set sclk__DM1, CYREG_PRT12_DM1
.set sclk__DM2, CYREG_PRT12_DM2
.set sclk__DR, CYREG_PRT12_DR
.set sclk__INP_DIS, CYREG_PRT12_INP_DIS
.set sclk__INTTYPE_BASE, CYDEV_PICU_INTTYPE_PICU12_BASE
.set sclk__MASK, 0x04
.set sclk__PORT, 12
.set sclk__PRT, CYREG_PRT12_PRT
.set sclk__PRTDSI__DBL_SYNC_IN, CYREG_PRT12_DBL_SYNC_IN
.set sclk__PRTDSI__OE_SEL0, CYREG_PRT12_OE_SEL0
.set sclk__PRTDSI__OE_SEL1, CYREG_PRT12_OE_SEL1
.set sclk__PRTDSI__OUT_SEL0, CYREG_PRT12_OUT_SEL0
.set sclk__PRTDSI__OUT_SEL1, CYREG_PRT12_OUT_SEL1
.set sclk__PRTDSI__SYNC_OUT, CYREG_PRT12_SYNC_OUT
.set sclk__PS, CYREG_PRT12_PS
.set sclk__SHIFT, 2
.set sclk__SIO_CFG, CYREG_PRT12_SIO_CFG
.set sclk__SIO_DIFF, CYREG_PRT12_SIO_DIFF
.set sclk__SIO_HYST_EN, CYREG_PRT12_SIO_HYST_EN
.set sclk__SIO_REG_HIFREQ, CYREG_PRT12_SIO_REG_HIFREQ
.set sclk__SLW, CYREG_PRT12_SLW

/* Clock */
.set Clock__CFG0, CYREG_CLKDIST_DCFG0_CFG0
.set Clock__CFG1, CYREG_CLKDIST_DCFG0_CFG1
.set Clock__CFG2, CYREG_CLKDIST_DCFG0_CFG2
.set Clock__CFG2_SRC_SEL_MASK, 0x07
.set Clock__INDEX, 0x00
.set Clock__PM_ACT_CFG, CYREG_PM_ACT_CFG2
.set Clock__PM_ACT_MSK, 0x01
.set Clock__PM_STBY_CFG, CYREG_PM_STBY_CFG2
.set Clock__PM_STBY_MSK, 0x01

/* DMA_RX */
.set DMA_RX__DRQ_CTL, CYREG_IDMUX_DRQ_CTL0
.set DMA_RX__DRQ_NUMBER, 0
.set DMA_RX__NUMBEROF_TDS, 0
.set DMA_RX__PRIORITY, 2
.set DMA_RX__TERMIN_EN, 0
.set DMA_RX__TERMIN_SEL, 0
.set DMA_RX__TERMOUT0_EN, 0
.set DMA_RX__TERMOUT0_SEL, 0
.set DMA_RX__TERMOUT1_EN, 0
.set DMA_RX__TERMOUT1_SEL, 0

/* DMA_TX */
.set DMA_TX__DRQ_CTL, CYREG_IDMUX_DRQ_CTL0
.set DMA_TX__DRQ_NUMBER, 1
.set DMA_TX__NUMBEROF_TDS, 0
.set DMA_TX__PRIORITY, 2
.set DMA_TX__TERMIN_EN, 0
.set DMA_TX__TERMIN_SEL, 0
.set DMA_TX__TERMOUT0_EN, 0
.set DMA_TX__TERMOUT0_SEL, 0
.set DMA_TX__TERMOUT1_EN, 0
.set DMA_TX__TERMOUT1_SEL, 0

/* Miscellaneous */
.set BCLK__BUS_CLK__HZ, 24000000
.set BCLK__BUS_CLK__KHZ, 24000
.set BCLK__BUS_CLK__MHZ, 24
.set CYDEV_CHIP_DIE_LEOPARD, 1
.set CYDEV_CHIP_DIE_PANTHER, 18
.set CYDEV_CHIP_DIE_PSOC4A, 10
.set CYDEV_CHIP_DIE_PSOC5LP, 17
.set CYDEV_CHIP_DIE_TMA4, 2
.set CYDEV_CHIP_DIE_UNKNOWN, 0
.set CYDEV_CHIP_FAMILY_PSOC3, 1
.set CYDEV_CHIP_FAMILY_PSOC4, 2
.set CYDEV_CHIP_FAMILY_PSOC5, 3
.set CYDEV_CHIP_FAMILY_UNKNOWN, 0
.set CYDEV_CHIP_FAMILY_USED, CYDEV_CHIP_FAMILY_PSOC5
.set CYDEV_CHIP_JTAG_ID, 0x2E161069
.set CYDEV_CHIP_MEMBER_3A, 1
.set CYDEV_CHIP_MEMBER_4A, 10
.set CYDEV_CHIP_MEMBER_4C, 15
.set CYDEV_CHIP_MEMBER_4D, 6
.set CYDEV_CHIP_MEMBER_4E, 4
.set CYDEV_CHIP_MEMBER_4F, 11
.set CYDEV_CHIP_MEMBER_4G, 2
.set CYDEV_CHIP_MEMBER_4H, 9
.set CYDEV_CHIP_MEMBER_4I, 14
.set CYDEV_CHIP_MEMBER_4J, 7
.set CYDEV_CHIP_MEMBER_4K, 8
.set CYDEV_CHIP_MEMBER_4L, 13
.set CYDEV_CHIP_MEMBER_4M, 12
.set CYDEV_CHIP_MEMBER_4N, 5
.set CYDEV_CHIP_MEMBER_4U, 3
.set CYDEV_CHIP_MEMBER_5A, 17
.set CYDEV_CHIP_MEMBER_5B, 16
.set CYDEV_CHIP_MEMBER_UNKNOWN, 0
.set CYDEV_CHIP_MEMBER_USED, CYDEV_CHIP_MEMBER_5B
.set CYDEV_CHIP_DIE_EXPECT, CYDEV_CHIP_MEMBER_USED
.set CYDEV_CHIP_DIE_ACTUAL, CYDEV_CHIP_DIE_EXPECT
.set CYDEV_CHIP_REV_LEOPARD_ES1, 0
.set CYDEV_CHIP_REV_LEOPARD_ES2, 1
.set CYDEV_CHIP_REV_LEOPARD_ES3, 3
.set CYDEV_CHIP_REV_LEOPARD_PRODUCTION, 3
.set CYDEV_CHIP_REV_PANTHER_ES0, 0
.set CYDEV_CHIP_REV_PANTHER_ES1, 1
.set CYDEV_CHIP_REV_PANTHER_PRODUCTION, 1
.set CYDEV_CHIP_REV_PSOC4A_ES0, 17
.set CYDEV_CHIP_REV_PSOC4A_PRODUCTION, 17
.set CYDEV_CHIP_REV_PSOC5LP_ES0, 0
.set CYDEV_CHIP_REV_PSOC5LP_PRODUCTION, 0
.set CYDEV_CHIP_REV_TMA4_ES, 17
.set CYDEV_CHIP_REV_TMA4_ES2, 33
.set CYDEV_CHIP_REV_TMA4_PRODUCTION, 17
.set CYDEV_CHIP_REVISION_3A_ES1, 0
.set CYDEV_CHIP_REVISION_3A_ES2, 1
.set CYDEV_CHIP_REVISION_3A_ES3, 3
.set CYDEV_CHIP_REVISION_3A_PRODUCTION, 3
.set CYDEV_CHIP_REVISION_4A_ES0, 17
.set CYDEV_CHIP_REVISION_4A_PRODUCTION, 17
.set CYDEV_CHIP_REVISION_4C_PRODUCTION, 0
.set CYDEV_CHIP_REVISION_4D_PRODUCTION, 0
.set CYDEV_CHIP_REVISION_4E_PRODUCTION, 0
.set CYDEV_CHIP_REVISION_4F_PRODUCTION, 0
.set CYDEV_CHIP_REVISION_4F_PRODUCTION_256DMA, 0
.set CYDEV_CHIP_REVISION_4F_PRODUCTION_256K, 0
.set CYDEV_CHIP_REVISION_4G_ES, 17
.set CYDEV_CHIP_REVISION_4G_ES2, 33
.set CYDEV_CHIP_REVISION_4G_PRODUCTION, 17
.set CYDEV_CHIP_REVISION_4H_PRODUCTION, 0
.set CYDEV_CHIP_REVISION_4I_PRODUCTION, 0
.set CYDEV_CHIP_REVISION_4J_PRODUCTION, 0
.set CYDEV_CHIP_REVISION_4K_PRODUCTION, 0
.set CYDEV_CHIP_REVISION_4L_PRODUCTION, 0
.set CYDEV_CHIP_REVISION_4M_PRODUCTION, 0
.set CYDEV_CHIP_REVISION_4N_PRODUCTION, 0
.set CYDEV_CHIP_REVISION_4U_PRODUCTION, 0
.set CYDEV_CHIP_REVISION_5A_ES0, 0
.set CYDEV_CHIP_REVISION_5A_ES1, 1
.set CYDEV_CHIP_REVISION_5A_PRODUCTION, 1
.set CYDEV_CHIP_REVISION_5B_ES0, 0
.set CYDEV_CHIP_REVISION_5B_PRODUCTION, 0
.set CYDEV_CHIP_REVISION_USED, CYDEV_CHIP_REVISION_5B_PRODUCTION
.set CYDEV_CHIP_REV_EXPECT, CYDEV_CHIP_REVISION_USED
.set CYDEV_CONFIG_FASTBOOT_ENABLED, 0
.set CYDEV_CONFIG_UNUSED_IO_AllowButWarn, 0
.set CYDEV_CONFIG_UNUSED_IO, CYDEV_CONFIG_UNUSED_IO_AllowButWarn
.set CYDEV_CONFIG_UNUSED_IO_AllowWithInfo, 1
.set CYDEV_CONFIG_UNUSED_IO_Disallowed, 2
.set CYDEV_CONFIGURATION_COMPRESSED, 0
.set CYDEV_CONFIGURATION_DMA, 1
.set CYDEV_CONFIGURATION_ECC, 1
.set CYDEV_CONFIGURATION_IMOENABLED, CYDEV_CONFIG_FASTBOOT_ENABLED
.set CYDEV_CONFIGURATION_MODE_COMPRESSED, 0
.set CYDEV_CONFIGURATION_MODE_DMA, 2
.set CYDEV_CONFIGURATION_MODE, CYDEV_CONFIGURATION_MODE_DMA
.set CYDEV_CONFIGURATION_MODE_UNCOMPRESSED, 1
.set CYDEV_DEBUG_ENABLE_MASK, 0x20
.set CYDEV_DEBUG_ENABLE_REGISTER, CYREG_MLOGIC_DEBUG
.set CYDEV_DEBUGGING_DPS_Disable, 3
.set CYDEV_DEBUGGING_DPS_JTAG_4, 1
.set CYDEV_DEBUGGING_DPS_JTAG_5, 0
.set CYDEV_DEBUGGING_DPS_SWD, 2
.set CYDEV_DEBUGGING_DPS_SWD_SWV, 6
.set CYDEV_DEBUGGING_DPS, CYDEV_DEBUGGING_DPS_SWD_SWV
.set CYDEV_DEBUGGING_ENABLE, 1
.set CYDEV_DEBUGGING_XRES, 0
.set CYDEV_DMA_CHANNELS_AVAILABLE, 24
.set CYDEV_ECC_ENABLE, 0
.set CYDEV_HEAP_SIZE, 0x80
.set CYDEV_INSTRUCT_CACHE_ENABLED, 1
.set CYDEV_INTR_RISING, 0x00000000
.set CYDEV_IS_EXPORTING_CODE, 0
.set CYDEV_IS_IMPORTING_CODE, 0
.set CYDEV_PROJ_TYPE, 0
.set CYDEV_PROJ_TYPE_BOOTLOADER, 1
.set CYDEV_PROJ_TYPE_LAUNCHER, 5
.set CYDEV_PROJ_TYPE_LOADABLE, 2
.set CYDEV_PROJ_TYPE_LOADABLEANDBOOTLOADER, 4
.set CYDEV_PROJ_TYPE_MULTIAPPBOOTLOADER, 3
.set CYDEV_PROJ_TYPE_STANDARD, 0
.set CYDEV_PROTECTION_ENABLE, 0
.set CYDEV_STACK_SIZE, 0x0800
.set CYDEV_USE_BUNDLED_CMSIS, 1
.set CYDEV_VARIABLE_VDDA, 0
.set CYDEV_VDDA_MV, 5000
.set CYDEV_VDDD_MV, 5000
.set CYDEV_VDDIO0_MV, 5000
.set CYDEV_VDDIO1_MV, 5000
.set CYDEV_VDDIO2_MV, 5000
.set CYDEV_VDDIO3_MV, 5000
.set CYDEV_VIO0_MV, 5000
.set CYDEV_VIO1_MV, 5000
.set CYDEV_VIO2_MV, 5000
.set CYDEV_VIO3_MV, 5000
.set CYIPBLOCK_ARM_CM3_VERSION, 0
.set CYIPBLOCK_P3_ANAIF_VERSION, 0
.set CYIPBLOCK_P3_CAN_VERSION, 0
.set CYIPBLOCK_P3_CAPSENSE_VERSION, 0
.set CYIPBLOCK_P3_COMP_VERSION, 0
.set CYIPBLOCK_P3_DECIMATOR_VERSION, 0
.set CYIPBLOCK_P3_DFB_VERSION, 0
.set CYIPBLOCK_P3_DMA_VERSION, 0
.set CYIPBLOCK_P3_DRQ_VERSION, 0
.set CYIPBLOCK_P3_DSM_VERSION, 0
.set CYIPBLOCK_P3_EMIF_VERSION, 0
.set CYIPBLOCK_P3_I2C_VERSION, 0
.set CYIPBLOCK_P3_LCD_VERSION, 0
.set CYIPBLOCK_P3_LPF_VERSION, 0
.set CYIPBLOCK_P3_OPAMP_VERSION, 0
.set CYIPBLOCK_P3_PM_VERSION, 0
.set CYIPBLOCK_P3_SCCT_VERSION, 0
.set CYIPBLOCK_P3_TIMER_VERSION, 0
.set CYIPBLOCK_P3_USB_VERSION, 0
.set CYIPBLOCK_P3_VIDAC_VERSION, 0
.set CYIPBLOCK_P3_VREF_VERSION, 0
.set CYIPBLOCK_S8_GPIO_VERSION, 0
.set CYIPBLOCK_S8_IRQ_VERSION, 0
.set CYIPBLOCK_S8_SAR_VERSION, 0
.set CYIPBLOCK_S8_SIO_VERSION, 0
.set CYIPBLOCK_S8_UDB_VERSION, 0
.set DMA_CHANNELS_USED__MASK0, 0x00000003
.set CYDEV_BOOTLOADER_ENABLE, 0
.endif
