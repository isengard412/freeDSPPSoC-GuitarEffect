#ifndef INCLUDED_CYFITTERIAR_INC
#define INCLUDED_CYFITTERIAR_INC
    INCLUDE cydeviceiar_trm.inc

/* I2C_Slave_SCB */
I2C_Slave_SCB__BIST_CONTROL EQU CYREG_SCB1_BIST_CONTROL
I2C_Slave_SCB__BIST_DATA EQU CYREG_SCB1_BIST_DATA
I2C_Slave_SCB__CTRL EQU CYREG_SCB1_CTRL
I2C_Slave_SCB__EZ_DATA00 EQU CYREG_SCB1_EZ_DATA00
I2C_Slave_SCB__EZ_DATA01 EQU CYREG_SCB1_EZ_DATA01
I2C_Slave_SCB__EZ_DATA02 EQU CYREG_SCB1_EZ_DATA02
I2C_Slave_SCB__EZ_DATA03 EQU CYREG_SCB1_EZ_DATA03
I2C_Slave_SCB__EZ_DATA04 EQU CYREG_SCB1_EZ_DATA04
I2C_Slave_SCB__EZ_DATA05 EQU CYREG_SCB1_EZ_DATA05
I2C_Slave_SCB__EZ_DATA06 EQU CYREG_SCB1_EZ_DATA06
I2C_Slave_SCB__EZ_DATA07 EQU CYREG_SCB1_EZ_DATA07
I2C_Slave_SCB__EZ_DATA08 EQU CYREG_SCB1_EZ_DATA08
I2C_Slave_SCB__EZ_DATA09 EQU CYREG_SCB1_EZ_DATA09
I2C_Slave_SCB__EZ_DATA10 EQU CYREG_SCB1_EZ_DATA10
I2C_Slave_SCB__EZ_DATA11 EQU CYREG_SCB1_EZ_DATA11
I2C_Slave_SCB__EZ_DATA12 EQU CYREG_SCB1_EZ_DATA12
I2C_Slave_SCB__EZ_DATA13 EQU CYREG_SCB1_EZ_DATA13
I2C_Slave_SCB__EZ_DATA14 EQU CYREG_SCB1_EZ_DATA14
I2C_Slave_SCB__EZ_DATA15 EQU CYREG_SCB1_EZ_DATA15
I2C_Slave_SCB__EZ_DATA16 EQU CYREG_SCB1_EZ_DATA16
I2C_Slave_SCB__EZ_DATA17 EQU CYREG_SCB1_EZ_DATA17
I2C_Slave_SCB__EZ_DATA18 EQU CYREG_SCB1_EZ_DATA18
I2C_Slave_SCB__EZ_DATA19 EQU CYREG_SCB1_EZ_DATA19
I2C_Slave_SCB__EZ_DATA20 EQU CYREG_SCB1_EZ_DATA20
I2C_Slave_SCB__EZ_DATA21 EQU CYREG_SCB1_EZ_DATA21
I2C_Slave_SCB__EZ_DATA22 EQU CYREG_SCB1_EZ_DATA22
I2C_Slave_SCB__EZ_DATA23 EQU CYREG_SCB1_EZ_DATA23
I2C_Slave_SCB__EZ_DATA24 EQU CYREG_SCB1_EZ_DATA24
I2C_Slave_SCB__EZ_DATA25 EQU CYREG_SCB1_EZ_DATA25
I2C_Slave_SCB__EZ_DATA26 EQU CYREG_SCB1_EZ_DATA26
I2C_Slave_SCB__EZ_DATA27 EQU CYREG_SCB1_EZ_DATA27
I2C_Slave_SCB__EZ_DATA28 EQU CYREG_SCB1_EZ_DATA28
I2C_Slave_SCB__EZ_DATA29 EQU CYREG_SCB1_EZ_DATA29
I2C_Slave_SCB__EZ_DATA30 EQU CYREG_SCB1_EZ_DATA30
I2C_Slave_SCB__EZ_DATA31 EQU CYREG_SCB1_EZ_DATA31
I2C_Slave_SCB__I2C_CFG EQU CYREG_SCB1_I2C_CFG
I2C_Slave_SCB__I2C_CTRL EQU CYREG_SCB1_I2C_CTRL
I2C_Slave_SCB__I2C_M_CMD EQU CYREG_SCB1_I2C_M_CMD
I2C_Slave_SCB__I2C_S_CMD EQU CYREG_SCB1_I2C_S_CMD
I2C_Slave_SCB__I2C_STATUS EQU CYREG_SCB1_I2C_STATUS
I2C_Slave_SCB__INTR_CAUSE EQU CYREG_SCB1_INTR_CAUSE
I2C_Slave_SCB__INTR_I2C_EC EQU CYREG_SCB1_INTR_I2C_EC
I2C_Slave_SCB__INTR_I2C_EC_MASK EQU CYREG_SCB1_INTR_I2C_EC_MASK
I2C_Slave_SCB__INTR_I2C_EC_MASKED EQU CYREG_SCB1_INTR_I2C_EC_MASKED
I2C_Slave_SCB__INTR_M EQU CYREG_SCB1_INTR_M
I2C_Slave_SCB__INTR_M_MASK EQU CYREG_SCB1_INTR_M_MASK
I2C_Slave_SCB__INTR_M_MASKED EQU CYREG_SCB1_INTR_M_MASKED
I2C_Slave_SCB__INTR_M_SET EQU CYREG_SCB1_INTR_M_SET
I2C_Slave_SCB__INTR_RX EQU CYREG_SCB1_INTR_RX
I2C_Slave_SCB__INTR_RX_MASK EQU CYREG_SCB1_INTR_RX_MASK
I2C_Slave_SCB__INTR_RX_MASKED EQU CYREG_SCB1_INTR_RX_MASKED
I2C_Slave_SCB__INTR_RX_SET EQU CYREG_SCB1_INTR_RX_SET
I2C_Slave_SCB__INTR_S EQU CYREG_SCB1_INTR_S
I2C_Slave_SCB__INTR_S_MASK EQU CYREG_SCB1_INTR_S_MASK
I2C_Slave_SCB__INTR_S_MASKED EQU CYREG_SCB1_INTR_S_MASKED
I2C_Slave_SCB__INTR_S_SET EQU CYREG_SCB1_INTR_S_SET
I2C_Slave_SCB__INTR_SPI_EC EQU CYREG_SCB1_INTR_SPI_EC
I2C_Slave_SCB__INTR_SPI_EC_MASK EQU CYREG_SCB1_INTR_SPI_EC_MASK
I2C_Slave_SCB__INTR_SPI_EC_MASKED EQU CYREG_SCB1_INTR_SPI_EC_MASKED
I2C_Slave_SCB__INTR_TX EQU CYREG_SCB1_INTR_TX
I2C_Slave_SCB__INTR_TX_MASK EQU CYREG_SCB1_INTR_TX_MASK
I2C_Slave_SCB__INTR_TX_MASKED EQU CYREG_SCB1_INTR_TX_MASKED
I2C_Slave_SCB__INTR_TX_SET EQU CYREG_SCB1_INTR_TX_SET
I2C_Slave_SCB__RX_CTRL EQU CYREG_SCB1_RX_CTRL
I2C_Slave_SCB__RX_FIFO_CTRL EQU CYREG_SCB1_RX_FIFO_CTRL
I2C_Slave_SCB__RX_FIFO_RD EQU CYREG_SCB1_RX_FIFO_RD
I2C_Slave_SCB__RX_FIFO_RD_SILENT EQU CYREG_SCB1_RX_FIFO_RD_SILENT
I2C_Slave_SCB__RX_FIFO_STATUS EQU CYREG_SCB1_RX_FIFO_STATUS
I2C_Slave_SCB__RX_MATCH EQU CYREG_SCB1_RX_MATCH
I2C_Slave_SCB__SPI_CTRL EQU CYREG_SCB1_SPI_CTRL
I2C_Slave_SCB__SPI_STATUS EQU CYREG_SCB1_SPI_STATUS
I2C_Slave_SCB__SS0_POSISTION EQU 0
I2C_Slave_SCB__SS1_POSISTION EQU 1
I2C_Slave_SCB__SS2_POSISTION EQU 2
I2C_Slave_SCB__SS3_POSISTION EQU 3
I2C_Slave_SCB__STATUS EQU CYREG_SCB1_STATUS
I2C_Slave_SCB__TX_CTRL EQU CYREG_SCB1_TX_CTRL
I2C_Slave_SCB__TX_FIFO_CTRL EQU CYREG_SCB1_TX_FIFO_CTRL
I2C_Slave_SCB__TX_FIFO_STATUS EQU CYREG_SCB1_TX_FIFO_STATUS
I2C_Slave_SCB__TX_FIFO_WR EQU CYREG_SCB1_TX_FIFO_WR
I2C_Slave_SCB__UART_CTRL EQU CYREG_SCB1_UART_CTRL
I2C_Slave_SCB__UART_RX_CTRL EQU CYREG_SCB1_UART_RX_CTRL
I2C_Slave_SCB__UART_RX_STATUS EQU CYREG_SCB1_UART_RX_STATUS
I2C_Slave_SCB__UART_TX_CTRL EQU CYREG_SCB1_UART_TX_CTRL

/* I2C_Slave_SCB_IRQ */
I2C_Slave_SCB_IRQ__INTC_CLR_EN_REG EQU CYREG_CM0_ICER
I2C_Slave_SCB_IRQ__INTC_CLR_PD_REG EQU CYREG_CM0_ICPR
I2C_Slave_SCB_IRQ__INTC_MASK EQU 0x800
I2C_Slave_SCB_IRQ__INTC_NUMBER EQU 11
I2C_Slave_SCB_IRQ__INTC_PRIOR_MASK EQU 0xC0000000
I2C_Slave_SCB_IRQ__INTC_PRIOR_NUM EQU 3
I2C_Slave_SCB_IRQ__INTC_PRIOR_REG EQU CYREG_CM0_IPR2
I2C_Slave_SCB_IRQ__INTC_SET_EN_REG EQU CYREG_CM0_ISER
I2C_Slave_SCB_IRQ__INTC_SET_PD_REG EQU CYREG_CM0_ISPR

/* I2C_Slave_SCBCLK */
I2C_Slave_SCBCLK__DIVIDER_MASK EQU 0x0000FFFF
I2C_Slave_SCBCLK__ENABLE EQU CYREG_CLK_DIVIDER_A00
I2C_Slave_SCBCLK__ENABLE_MASK EQU 0x80000000
I2C_Slave_SCBCLK__MASK EQU 0x80000000
I2C_Slave_SCBCLK__REGISTER EQU CYREG_CLK_DIVIDER_A00

/* I2C_Slave_scl */
I2C_Slave_scl__0__DM__MASK EQU 0x07
I2C_Slave_scl__0__DM__SHIFT EQU 0
I2C_Slave_scl__0__DR EQU CYREG_PRT3_DR
I2C_Slave_scl__0__HSIOM EQU CYREG_HSIOM_PORT_SEL3
I2C_Slave_scl__0__HSIOM_MASK EQU 0x0000000F
I2C_Slave_scl__0__HSIOM_SHIFT EQU 0
I2C_Slave_scl__0__INTCFG EQU CYREG_PRT3_INTCFG
I2C_Slave_scl__0__INTSTAT EQU CYREG_PRT3_INTSTAT
I2C_Slave_scl__0__MASK EQU 0x01
I2C_Slave_scl__0__PA__CFG0 EQU CYREG_UDB_PA3_CFG0
I2C_Slave_scl__0__PA__CFG1 EQU CYREG_UDB_PA3_CFG1
I2C_Slave_scl__0__PA__CFG10 EQU CYREG_UDB_PA3_CFG10
I2C_Slave_scl__0__PA__CFG11 EQU CYREG_UDB_PA3_CFG11
I2C_Slave_scl__0__PA__CFG12 EQU CYREG_UDB_PA3_CFG12
I2C_Slave_scl__0__PA__CFG13 EQU CYREG_UDB_PA3_CFG13
I2C_Slave_scl__0__PA__CFG14 EQU CYREG_UDB_PA3_CFG14
I2C_Slave_scl__0__PA__CFG2 EQU CYREG_UDB_PA3_CFG2
I2C_Slave_scl__0__PA__CFG3 EQU CYREG_UDB_PA3_CFG3
I2C_Slave_scl__0__PA__CFG4 EQU CYREG_UDB_PA3_CFG4
I2C_Slave_scl__0__PA__CFG5 EQU CYREG_UDB_PA3_CFG5
I2C_Slave_scl__0__PA__CFG6 EQU CYREG_UDB_PA3_CFG6
I2C_Slave_scl__0__PA__CFG7 EQU CYREG_UDB_PA3_CFG7
I2C_Slave_scl__0__PA__CFG8 EQU CYREG_UDB_PA3_CFG8
I2C_Slave_scl__0__PA__CFG9 EQU CYREG_UDB_PA3_CFG9
I2C_Slave_scl__0__PC EQU CYREG_PRT3_PC
I2C_Slave_scl__0__PC2 EQU CYREG_PRT3_PC2
I2C_Slave_scl__0__PORT EQU 3
I2C_Slave_scl__0__PS EQU CYREG_PRT3_PS
I2C_Slave_scl__0__SHIFT EQU 0
I2C_Slave_scl__DR EQU CYREG_PRT3_DR
I2C_Slave_scl__INTCFG EQU CYREG_PRT3_INTCFG
I2C_Slave_scl__INTSTAT EQU CYREG_PRT3_INTSTAT
I2C_Slave_scl__MASK EQU 0x01
I2C_Slave_scl__PA__CFG0 EQU CYREG_UDB_PA3_CFG0
I2C_Slave_scl__PA__CFG1 EQU CYREG_UDB_PA3_CFG1
I2C_Slave_scl__PA__CFG10 EQU CYREG_UDB_PA3_CFG10
I2C_Slave_scl__PA__CFG11 EQU CYREG_UDB_PA3_CFG11
I2C_Slave_scl__PA__CFG12 EQU CYREG_UDB_PA3_CFG12
I2C_Slave_scl__PA__CFG13 EQU CYREG_UDB_PA3_CFG13
I2C_Slave_scl__PA__CFG14 EQU CYREG_UDB_PA3_CFG14
I2C_Slave_scl__PA__CFG2 EQU CYREG_UDB_PA3_CFG2
I2C_Slave_scl__PA__CFG3 EQU CYREG_UDB_PA3_CFG3
I2C_Slave_scl__PA__CFG4 EQU CYREG_UDB_PA3_CFG4
I2C_Slave_scl__PA__CFG5 EQU CYREG_UDB_PA3_CFG5
I2C_Slave_scl__PA__CFG6 EQU CYREG_UDB_PA3_CFG6
I2C_Slave_scl__PA__CFG7 EQU CYREG_UDB_PA3_CFG7
I2C_Slave_scl__PA__CFG8 EQU CYREG_UDB_PA3_CFG8
I2C_Slave_scl__PA__CFG9 EQU CYREG_UDB_PA3_CFG9
I2C_Slave_scl__PC EQU CYREG_PRT3_PC
I2C_Slave_scl__PC2 EQU CYREG_PRT3_PC2
I2C_Slave_scl__PORT EQU 3
I2C_Slave_scl__PS EQU CYREG_PRT3_PS
I2C_Slave_scl__SHIFT EQU 0

/* I2C_Slave_sda */
I2C_Slave_sda__0__DM__MASK EQU 0x38
I2C_Slave_sda__0__DM__SHIFT EQU 3
I2C_Slave_sda__0__DR EQU CYREG_PRT3_DR
I2C_Slave_sda__0__HSIOM EQU CYREG_HSIOM_PORT_SEL3
I2C_Slave_sda__0__HSIOM_MASK EQU 0x000000F0
I2C_Slave_sda__0__HSIOM_SHIFT EQU 4
I2C_Slave_sda__0__INTCFG EQU CYREG_PRT3_INTCFG
I2C_Slave_sda__0__INTSTAT EQU CYREG_PRT3_INTSTAT
I2C_Slave_sda__0__MASK EQU 0x02
I2C_Slave_sda__0__PA__CFG0 EQU CYREG_UDB_PA3_CFG0
I2C_Slave_sda__0__PA__CFG1 EQU CYREG_UDB_PA3_CFG1
I2C_Slave_sda__0__PA__CFG10 EQU CYREG_UDB_PA3_CFG10
I2C_Slave_sda__0__PA__CFG11 EQU CYREG_UDB_PA3_CFG11
I2C_Slave_sda__0__PA__CFG12 EQU CYREG_UDB_PA3_CFG12
I2C_Slave_sda__0__PA__CFG13 EQU CYREG_UDB_PA3_CFG13
I2C_Slave_sda__0__PA__CFG14 EQU CYREG_UDB_PA3_CFG14
I2C_Slave_sda__0__PA__CFG2 EQU CYREG_UDB_PA3_CFG2
I2C_Slave_sda__0__PA__CFG3 EQU CYREG_UDB_PA3_CFG3
I2C_Slave_sda__0__PA__CFG4 EQU CYREG_UDB_PA3_CFG4
I2C_Slave_sda__0__PA__CFG5 EQU CYREG_UDB_PA3_CFG5
I2C_Slave_sda__0__PA__CFG6 EQU CYREG_UDB_PA3_CFG6
I2C_Slave_sda__0__PA__CFG7 EQU CYREG_UDB_PA3_CFG7
I2C_Slave_sda__0__PA__CFG8 EQU CYREG_UDB_PA3_CFG8
I2C_Slave_sda__0__PA__CFG9 EQU CYREG_UDB_PA3_CFG9
I2C_Slave_sda__0__PC EQU CYREG_PRT3_PC
I2C_Slave_sda__0__PC2 EQU CYREG_PRT3_PC2
I2C_Slave_sda__0__PORT EQU 3
I2C_Slave_sda__0__PS EQU CYREG_PRT3_PS
I2C_Slave_sda__0__SHIFT EQU 1
I2C_Slave_sda__DR EQU CYREG_PRT3_DR
I2C_Slave_sda__INTCFG EQU CYREG_PRT3_INTCFG
I2C_Slave_sda__INTSTAT EQU CYREG_PRT3_INTSTAT
I2C_Slave_sda__MASK EQU 0x02
I2C_Slave_sda__PA__CFG0 EQU CYREG_UDB_PA3_CFG0
I2C_Slave_sda__PA__CFG1 EQU CYREG_UDB_PA3_CFG1
I2C_Slave_sda__PA__CFG10 EQU CYREG_UDB_PA3_CFG10
I2C_Slave_sda__PA__CFG11 EQU CYREG_UDB_PA3_CFG11
I2C_Slave_sda__PA__CFG12 EQU CYREG_UDB_PA3_CFG12
I2C_Slave_sda__PA__CFG13 EQU CYREG_UDB_PA3_CFG13
I2C_Slave_sda__PA__CFG14 EQU CYREG_UDB_PA3_CFG14
I2C_Slave_sda__PA__CFG2 EQU CYREG_UDB_PA3_CFG2
I2C_Slave_sda__PA__CFG3 EQU CYREG_UDB_PA3_CFG3
I2C_Slave_sda__PA__CFG4 EQU CYREG_UDB_PA3_CFG4
I2C_Slave_sda__PA__CFG5 EQU CYREG_UDB_PA3_CFG5
I2C_Slave_sda__PA__CFG6 EQU CYREG_UDB_PA3_CFG6
I2C_Slave_sda__PA__CFG7 EQU CYREG_UDB_PA3_CFG7
I2C_Slave_sda__PA__CFG8 EQU CYREG_UDB_PA3_CFG8
I2C_Slave_sda__PA__CFG9 EQU CYREG_UDB_PA3_CFG9
I2C_Slave_sda__PC EQU CYREG_PRT3_PC
I2C_Slave_sda__PC2 EQU CYREG_PRT3_PC2
I2C_Slave_sda__PORT EQU 3
I2C_Slave_sda__PS EQU CYREG_PRT3_PS
I2C_Slave_sda__SHIFT EQU 1

/* Bootloader_Status */
Bootloader_Status__0__DM__MASK EQU 0xE00
Bootloader_Status__0__DM__SHIFT EQU 9
Bootloader_Status__0__DR EQU CYREG_PRT0_DR
Bootloader_Status__0__HSIOM EQU CYREG_HSIOM_PORT_SEL0
Bootloader_Status__0__HSIOM_MASK EQU 0x0000F000
Bootloader_Status__0__HSIOM_SHIFT EQU 12
Bootloader_Status__0__INTCFG EQU CYREG_PRT0_INTCFG
Bootloader_Status__0__INTSTAT EQU CYREG_PRT0_INTSTAT
Bootloader_Status__0__MASK EQU 0x08
Bootloader_Status__0__PA__CFG0 EQU CYREG_UDB_PA0_CFG0
Bootloader_Status__0__PA__CFG1 EQU CYREG_UDB_PA0_CFG1
Bootloader_Status__0__PA__CFG10 EQU CYREG_UDB_PA0_CFG10
Bootloader_Status__0__PA__CFG11 EQU CYREG_UDB_PA0_CFG11
Bootloader_Status__0__PA__CFG12 EQU CYREG_UDB_PA0_CFG12
Bootloader_Status__0__PA__CFG13 EQU CYREG_UDB_PA0_CFG13
Bootloader_Status__0__PA__CFG14 EQU CYREG_UDB_PA0_CFG14
Bootloader_Status__0__PA__CFG2 EQU CYREG_UDB_PA0_CFG2
Bootloader_Status__0__PA__CFG3 EQU CYREG_UDB_PA0_CFG3
Bootloader_Status__0__PA__CFG4 EQU CYREG_UDB_PA0_CFG4
Bootloader_Status__0__PA__CFG5 EQU CYREG_UDB_PA0_CFG5
Bootloader_Status__0__PA__CFG6 EQU CYREG_UDB_PA0_CFG6
Bootloader_Status__0__PA__CFG7 EQU CYREG_UDB_PA0_CFG7
Bootloader_Status__0__PA__CFG8 EQU CYREG_UDB_PA0_CFG8
Bootloader_Status__0__PA__CFG9 EQU CYREG_UDB_PA0_CFG9
Bootloader_Status__0__PC EQU CYREG_PRT0_PC
Bootloader_Status__0__PC2 EQU CYREG_PRT0_PC2
Bootloader_Status__0__PORT EQU 0
Bootloader_Status__0__PS EQU CYREG_PRT0_PS
Bootloader_Status__0__SHIFT EQU 3
Bootloader_Status__DR EQU CYREG_PRT0_DR
Bootloader_Status__INTCFG EQU CYREG_PRT0_INTCFG
Bootloader_Status__INTSTAT EQU CYREG_PRT0_INTSTAT
Bootloader_Status__MASK EQU 0x08
Bootloader_Status__PA__CFG0 EQU CYREG_UDB_PA0_CFG0
Bootloader_Status__PA__CFG1 EQU CYREG_UDB_PA0_CFG1
Bootloader_Status__PA__CFG10 EQU CYREG_UDB_PA0_CFG10
Bootloader_Status__PA__CFG11 EQU CYREG_UDB_PA0_CFG11
Bootloader_Status__PA__CFG12 EQU CYREG_UDB_PA0_CFG12
Bootloader_Status__PA__CFG13 EQU CYREG_UDB_PA0_CFG13
Bootloader_Status__PA__CFG14 EQU CYREG_UDB_PA0_CFG14
Bootloader_Status__PA__CFG2 EQU CYREG_UDB_PA0_CFG2
Bootloader_Status__PA__CFG3 EQU CYREG_UDB_PA0_CFG3
Bootloader_Status__PA__CFG4 EQU CYREG_UDB_PA0_CFG4
Bootloader_Status__PA__CFG5 EQU CYREG_UDB_PA0_CFG5
Bootloader_Status__PA__CFG6 EQU CYREG_UDB_PA0_CFG6
Bootloader_Status__PA__CFG7 EQU CYREG_UDB_PA0_CFG7
Bootloader_Status__PA__CFG8 EQU CYREG_UDB_PA0_CFG8
Bootloader_Status__PA__CFG9 EQU CYREG_UDB_PA0_CFG9
Bootloader_Status__PC EQU CYREG_PRT0_PC
Bootloader_Status__PC2 EQU CYREG_PRT0_PC2
Bootloader_Status__PORT EQU 0
Bootloader_Status__PS EQU CYREG_PRT0_PS
Bootloader_Status__SHIFT EQU 3

/* Miscellaneous */
CYDEV_BCLK__HFCLK__HZ EQU 32000000
CYDEV_BCLK__HFCLK__KHZ EQU 32000
CYDEV_BCLK__HFCLK__MHZ EQU 32
CYDEV_BCLK__SYSCLK__HZ EQU 16000000
CYDEV_BCLK__SYSCLK__KHZ EQU 16000
CYDEV_BCLK__SYSCLK__MHZ EQU 16
CYDEV_BOOTLOADER_APPLICATIONS EQU 1
CYDEV_BOOTLOADER_CHECKSUM_BASIC EQU 0
CYDEV_BOOTLOADER_CHECKSUM_CRC EQU 1
CYDEV_BOOTLOADER_IO_COMP_CUSTOM_IO EQU 0
CyBtldr_Custom_Interface EQU CYDEV_BOOTLOADER_IO_COMP_CUSTOM_IO
CYDEV_BOOTLOADER_IO_COMP_I2C_Slave EQU 1
CyBtldr_I2C_Slave EQU CYDEV_BOOTLOADER_IO_COMP_I2C_Slave
CYDEV_BOOTLOADER_IO_COMP EQU CYDEV_BOOTLOADER_IO_COMP_I2C_Slave
CYDEV_CHIP_DIE_LEOPARD EQU 1
CYDEV_CHIP_DIE_PANTHER EQU 18
CYDEV_CHIP_DIE_PSOC4A EQU 10
CYDEV_CHIP_DIE_PSOC5LP EQU 17
CYDEV_CHIP_DIE_TMA4 EQU 2
CYDEV_CHIP_DIE_UNKNOWN EQU 0
CYDEV_CHIP_FAMILY_PSOC3 EQU 1
CYDEV_CHIP_FAMILY_PSOC4 EQU 2
CYDEV_CHIP_FAMILY_PSOC5 EQU 3
CYDEV_CHIP_FAMILY_UNKNOWN EQU 0
CYDEV_CHIP_FAMILY_USED EQU CYDEV_CHIP_FAMILY_PSOC4
CYDEV_CHIP_JTAG_ID EQU 0x04C81193
CYDEV_CHIP_MEMBER_3A EQU 1
CYDEV_CHIP_MEMBER_4A EQU 10
CYDEV_CHIP_MEMBER_4C EQU 15
CYDEV_CHIP_MEMBER_4D EQU 6
CYDEV_CHIP_MEMBER_4E EQU 4
CYDEV_CHIP_MEMBER_4F EQU 11
CYDEV_CHIP_MEMBER_4G EQU 2
CYDEV_CHIP_MEMBER_4H EQU 9
CYDEV_CHIP_MEMBER_4I EQU 14
CYDEV_CHIP_MEMBER_4J EQU 7
CYDEV_CHIP_MEMBER_4K EQU 8
CYDEV_CHIP_MEMBER_4L EQU 13
CYDEV_CHIP_MEMBER_4M EQU 12
CYDEV_CHIP_MEMBER_4N EQU 5
CYDEV_CHIP_MEMBER_4U EQU 3
CYDEV_CHIP_MEMBER_5A EQU 17
CYDEV_CHIP_MEMBER_5B EQU 16
CYDEV_CHIP_MEMBER_UNKNOWN EQU 0
CYDEV_CHIP_MEMBER_USED EQU CYDEV_CHIP_MEMBER_4A
CYDEV_CHIP_DIE_EXPECT EQU CYDEV_CHIP_MEMBER_USED
CYDEV_CHIP_DIE_ACTUAL EQU CYDEV_CHIP_DIE_EXPECT
CYDEV_CHIP_REV_LEOPARD_ES1 EQU 0
CYDEV_CHIP_REV_LEOPARD_ES2 EQU 1
CYDEV_CHIP_REV_LEOPARD_ES3 EQU 3
CYDEV_CHIP_REV_LEOPARD_PRODUCTION EQU 3
CYDEV_CHIP_REV_PANTHER_ES0 EQU 0
CYDEV_CHIP_REV_PANTHER_ES1 EQU 1
CYDEV_CHIP_REV_PANTHER_PRODUCTION EQU 1
CYDEV_CHIP_REV_PSOC4A_ES0 EQU 17
CYDEV_CHIP_REV_PSOC4A_PRODUCTION EQU 17
CYDEV_CHIP_REV_PSOC5LP_ES0 EQU 0
CYDEV_CHIP_REV_PSOC5LP_PRODUCTION EQU 0
CYDEV_CHIP_REV_TMA4_ES EQU 17
CYDEV_CHIP_REV_TMA4_ES2 EQU 33
CYDEV_CHIP_REV_TMA4_PRODUCTION EQU 17
CYDEV_CHIP_REVISION_3A_ES1 EQU 0
CYDEV_CHIP_REVISION_3A_ES2 EQU 1
CYDEV_CHIP_REVISION_3A_ES3 EQU 3
CYDEV_CHIP_REVISION_3A_PRODUCTION EQU 3
CYDEV_CHIP_REVISION_4A_ES0 EQU 17
CYDEV_CHIP_REVISION_4A_PRODUCTION EQU 17
CYDEV_CHIP_REVISION_4C_PRODUCTION EQU 0
CYDEV_CHIP_REVISION_4D_PRODUCTION EQU 0
CYDEV_CHIP_REVISION_4E_PRODUCTION EQU 0
CYDEV_CHIP_REVISION_4F_PRODUCTION EQU 0
CYDEV_CHIP_REVISION_4F_PRODUCTION_256DMA EQU 0
CYDEV_CHIP_REVISION_4F_PRODUCTION_256K EQU 0
CYDEV_CHIP_REVISION_4G_ES EQU 17
CYDEV_CHIP_REVISION_4G_ES2 EQU 33
CYDEV_CHIP_REVISION_4G_PRODUCTION EQU 17
CYDEV_CHIP_REVISION_4H_PRODUCTION EQU 0
CYDEV_CHIP_REVISION_4I_PRODUCTION EQU 0
CYDEV_CHIP_REVISION_4J_PRODUCTION EQU 0
CYDEV_CHIP_REVISION_4K_PRODUCTION EQU 0
CYDEV_CHIP_REVISION_4L_PRODUCTION EQU 0
CYDEV_CHIP_REVISION_4M_PRODUCTION EQU 0
CYDEV_CHIP_REVISION_4N_PRODUCTION EQU 0
CYDEV_CHIP_REVISION_4U_PRODUCTION EQU 0
CYDEV_CHIP_REVISION_5A_ES0 EQU 0
CYDEV_CHIP_REVISION_5A_ES1 EQU 1
CYDEV_CHIP_REVISION_5A_PRODUCTION EQU 1
CYDEV_CHIP_REVISION_5B_ES0 EQU 0
CYDEV_CHIP_REVISION_5B_PRODUCTION EQU 0
CYDEV_CHIP_REVISION_USED EQU CYDEV_CHIP_REVISION_4A_PRODUCTION
CYDEV_CHIP_REV_EXPECT EQU CYDEV_CHIP_REVISION_USED
CYDEV_CONFIG_READ_ACCELERATOR EQU 1
CYDEV_CONFIG_UNUSED_IO_AllowButWarn EQU 0
CYDEV_CONFIG_UNUSED_IO EQU CYDEV_CONFIG_UNUSED_IO_AllowButWarn
CYDEV_CONFIG_UNUSED_IO_AllowWithInfo EQU 1
CYDEV_CONFIG_UNUSED_IO_Disallowed EQU 2
CYDEV_CONFIGURATION_COMPRESSED EQU 1
CYDEV_CONFIGURATION_MODE_COMPRESSED EQU 0
CYDEV_CONFIGURATION_MODE EQU CYDEV_CONFIGURATION_MODE_COMPRESSED
CYDEV_CONFIGURATION_MODE_DMA EQU 2
CYDEV_CONFIGURATION_MODE_UNCOMPRESSED EQU 1
CYDEV_DEBUG_PROTECT_KILL EQU 4
CYDEV_DEBUG_PROTECT_OPEN EQU 1
CYDEV_DEBUG_PROTECT EQU CYDEV_DEBUG_PROTECT_OPEN
CYDEV_DEBUG_PROTECT_PROTECTED EQU 2
CYDEV_DEBUGGING_DPS_Disable EQU 3
CYDEV_DEBUGGING_DPS_SWD EQU 2
CYDEV_DEBUGGING_DPS EQU CYDEV_DEBUGGING_DPS_SWD
CYDEV_DEBUGGING_ENABLE EQU 1
CYDEV_DFT_SELECT_CLK0 EQU 1
CYDEV_DFT_SELECT_CLK1 EQU 2
CYDEV_HEAP_SIZE EQU 0x0100
CYDEV_IMO_TRIMMED_BY_USB EQU 0
CYDEV_IMO_TRIMMED_BY_WCO EQU 0
CYDEV_IS_EXPORTING_CODE EQU 0
CYDEV_IS_IMPORTING_CODE EQU 0
CYDEV_PROJ_TYPE EQU 1
CYDEV_PROJ_TYPE_BOOTLOADER EQU 1
CYDEV_PROJ_TYPE_LAUNCHER EQU 5
CYDEV_PROJ_TYPE_LOADABLE EQU 2
CYDEV_PROJ_TYPE_LOADABLEANDBOOTLOADER EQU 4
CYDEV_PROJ_TYPE_MULTIAPPBOOTLOADER EQU 3
CYDEV_PROJ_TYPE_STANDARD EQU 0
CYDEV_STACK_SIZE EQU 0x0400
CYDEV_USE_BUNDLED_CMSIS EQU 1
CYDEV_VARIABLE_VDDA EQU 1
CYDEV_VDDA_MV EQU 3300
CYDEV_VDDD_MV EQU 3300
CYDEV_WDT_GENERATE_ISR EQU 0
CYIPBLOCK_M0S8_CTBM_VERSION EQU 0
CYIPBLOCK_m0s8cpuss_VERSION EQU 0
CYIPBLOCK_m0s8csd_VERSION EQU 0
CYIPBLOCK_m0s8gpio2_VERSION EQU 0
CYIPBLOCK_m0s8hsiom4a_VERSION EQU 0
CYIPBLOCK_m0s8lcd_VERSION EQU 0
CYIPBLOCK_m0s8lpcomp_VERSION EQU 0
CYIPBLOCK_m0s8pclk_VERSION EQU 0
CYIPBLOCK_m0s8sar_VERSION EQU 0
CYIPBLOCK_m0s8scb_VERSION EQU 0
CYIPBLOCK_m0s8srssv2_VERSION EQU 1
CYIPBLOCK_m0s8tcpwm_VERSION EQU 0
CYIPBLOCK_m0s8udbif_VERSION EQU 0
CYIPBLOCK_S8_GPIO_VERSION EQU 2
CYDEV_BOOTLOADER_ENABLE EQU 1

#endif /* INCLUDED_CYFITTERIAR_INC */
