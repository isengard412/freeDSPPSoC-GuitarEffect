.ifndef INCLUDED_CYFITTERGNU_INC
.set INCLUDED_CYFITTERGNU_INC, 1
.include "cydevicegnu.inc"
.include "cydevicegnu_trm.inc"

/* SCL */
.set SCL__0__INTTYPE, CYREG_PICU4_INTTYPE0
.set SCL__0__MASK, 0x01
.set SCL__0__PC, CYREG_PRT4_PC0
.set SCL__0__PORT, 4
.set SCL__0__SHIFT, 0
.set SCL__AG, CYREG_PRT4_AG
.set SCL__AMUX, CYREG_PRT4_AMUX
.set SCL__BIE, CYREG_PRT4_BIE
.set SCL__BIT_MASK, CYREG_PRT4_BIT_MASK
.set SCL__BYP, CYREG_PRT4_BYP
.set SCL__CTL, CYREG_PRT4_CTL
.set SCL__DM0, CYREG_PRT4_DM0
.set SCL__DM1, CYREG_PRT4_DM1
.set SCL__DM2, CYREG_PRT4_DM2
.set SCL__DR, CYREG_PRT4_DR
.set SCL__INP_DIS, CYREG_PRT4_INP_DIS
.set SCL__INTTYPE_BASE, CYDEV_PICU_INTTYPE_PICU4_BASE
.set SCL__LCD_COM_SEG, CYREG_PRT4_LCD_COM_SEG
.set SCL__LCD_EN, CYREG_PRT4_LCD_EN
.set SCL__MASK, 0x01
.set SCL__PORT, 4
.set SCL__PRT, CYREG_PRT4_PRT
.set SCL__PRTDSI__CAPS_SEL, CYREG_PRT4_CAPS_SEL
.set SCL__PRTDSI__DBL_SYNC_IN, CYREG_PRT4_DBL_SYNC_IN
.set SCL__PRTDSI__OE_SEL0, CYREG_PRT4_OE_SEL0
.set SCL__PRTDSI__OE_SEL1, CYREG_PRT4_OE_SEL1
.set SCL__PRTDSI__OUT_SEL0, CYREG_PRT4_OUT_SEL0
.set SCL__PRTDSI__OUT_SEL1, CYREG_PRT4_OUT_SEL1
.set SCL__PRTDSI__SYNC_OUT, CYREG_PRT4_SYNC_OUT
.set SCL__PS, CYREG_PRT4_PS
.set SCL__SHIFT, 0
.set SCL__SLW, CYREG_PRT4_SLW

/* SDA */
.set SDA__0__INTTYPE, CYREG_PICU4_INTTYPE1
.set SDA__0__MASK, 0x02
.set SDA__0__PC, CYREG_PRT4_PC1
.set SDA__0__PORT, 4
.set SDA__0__SHIFT, 1
.set SDA__AG, CYREG_PRT4_AG
.set SDA__AMUX, CYREG_PRT4_AMUX
.set SDA__BIE, CYREG_PRT4_BIE
.set SDA__BIT_MASK, CYREG_PRT4_BIT_MASK
.set SDA__BYP, CYREG_PRT4_BYP
.set SDA__CTL, CYREG_PRT4_CTL
.set SDA__DM0, CYREG_PRT4_DM0
.set SDA__DM1, CYREG_PRT4_DM1
.set SDA__DM2, CYREG_PRT4_DM2
.set SDA__DR, CYREG_PRT4_DR
.set SDA__INP_DIS, CYREG_PRT4_INP_DIS
.set SDA__INTTYPE_BASE, CYDEV_PICU_INTTYPE_PICU4_BASE
.set SDA__LCD_COM_SEG, CYREG_PRT4_LCD_COM_SEG
.set SDA__LCD_EN, CYREG_PRT4_LCD_EN
.set SDA__MASK, 0x02
.set SDA__PORT, 4
.set SDA__PRT, CYREG_PRT4_PRT
.set SDA__PRTDSI__CAPS_SEL, CYREG_PRT4_CAPS_SEL
.set SDA__PRTDSI__DBL_SYNC_IN, CYREG_PRT4_DBL_SYNC_IN
.set SDA__PRTDSI__OE_SEL0, CYREG_PRT4_OE_SEL0
.set SDA__PRTDSI__OE_SEL1, CYREG_PRT4_OE_SEL1
.set SDA__PRTDSI__OUT_SEL0, CYREG_PRT4_OUT_SEL0
.set SDA__PRTDSI__OUT_SEL1, CYREG_PRT4_OUT_SEL1
.set SDA__PRTDSI__SYNC_OUT, CYREG_PRT4_SYNC_OUT
.set SDA__PS, CYREG_PRT4_PS
.set SDA__SHIFT, 1
.set SDA__SLW, CYREG_PRT4_SLW

/* I2C_M_bI2C_UDB */
.set I2C_M_bI2C_UDB_Master_ClkGen_u0__16BIT_A0_REG, CYREG_B0_UDB02_03_A0
.set I2C_M_bI2C_UDB_Master_ClkGen_u0__16BIT_A1_REG, CYREG_B0_UDB02_03_A1
.set I2C_M_bI2C_UDB_Master_ClkGen_u0__16BIT_D0_REG, CYREG_B0_UDB02_03_D0
.set I2C_M_bI2C_UDB_Master_ClkGen_u0__16BIT_D1_REG, CYREG_B0_UDB02_03_D1
.set I2C_M_bI2C_UDB_Master_ClkGen_u0__16BIT_DP_AUX_CTL_REG, CYREG_B0_UDB02_03_ACTL
.set I2C_M_bI2C_UDB_Master_ClkGen_u0__16BIT_F0_REG, CYREG_B0_UDB02_03_F0
.set I2C_M_bI2C_UDB_Master_ClkGen_u0__16BIT_F1_REG, CYREG_B0_UDB02_03_F1
.set I2C_M_bI2C_UDB_Master_ClkGen_u0__A0_A1_REG, CYREG_B0_UDB02_A0_A1
.set I2C_M_bI2C_UDB_Master_ClkGen_u0__A0_REG, CYREG_B0_UDB02_A0
.set I2C_M_bI2C_UDB_Master_ClkGen_u0__A1_REG, CYREG_B0_UDB02_A1
.set I2C_M_bI2C_UDB_Master_ClkGen_u0__D0_D1_REG, CYREG_B0_UDB02_D0_D1
.set I2C_M_bI2C_UDB_Master_ClkGen_u0__D0_REG, CYREG_B0_UDB02_D0
.set I2C_M_bI2C_UDB_Master_ClkGen_u0__D1_REG, CYREG_B0_UDB02_D1
.set I2C_M_bI2C_UDB_Master_ClkGen_u0__DP_AUX_CTL_REG, CYREG_B0_UDB02_ACTL
.set I2C_M_bI2C_UDB_Master_ClkGen_u0__F0_F1_REG, CYREG_B0_UDB02_F0_F1
.set I2C_M_bI2C_UDB_Master_ClkGen_u0__F0_REG, CYREG_B0_UDB02_F0
.set I2C_M_bI2C_UDB_Master_ClkGen_u0__F1_REG, CYREG_B0_UDB02_F1
.set I2C_M_bI2C_UDB_Shifter_u0__16BIT_A0_REG, CYREG_B0_UDB03_04_A0
.set I2C_M_bI2C_UDB_Shifter_u0__16BIT_A1_REG, CYREG_B0_UDB03_04_A1
.set I2C_M_bI2C_UDB_Shifter_u0__16BIT_D0_REG, CYREG_B0_UDB03_04_D0
.set I2C_M_bI2C_UDB_Shifter_u0__16BIT_D1_REG, CYREG_B0_UDB03_04_D1
.set I2C_M_bI2C_UDB_Shifter_u0__16BIT_DP_AUX_CTL_REG, CYREG_B0_UDB03_04_ACTL
.set I2C_M_bI2C_UDB_Shifter_u0__16BIT_F0_REG, CYREG_B0_UDB03_04_F0
.set I2C_M_bI2C_UDB_Shifter_u0__16BIT_F1_REG, CYREG_B0_UDB03_04_F1
.set I2C_M_bI2C_UDB_Shifter_u0__A0_A1_REG, CYREG_B0_UDB03_A0_A1
.set I2C_M_bI2C_UDB_Shifter_u0__A0_REG, CYREG_B0_UDB03_A0
.set I2C_M_bI2C_UDB_Shifter_u0__A1_REG, CYREG_B0_UDB03_A1
.set I2C_M_bI2C_UDB_Shifter_u0__D0_D1_REG, CYREG_B0_UDB03_D0_D1
.set I2C_M_bI2C_UDB_Shifter_u0__D0_REG, CYREG_B0_UDB03_D0
.set I2C_M_bI2C_UDB_Shifter_u0__D1_REG, CYREG_B0_UDB03_D1
.set I2C_M_bI2C_UDB_Shifter_u0__DP_AUX_CTL_REG, CYREG_B0_UDB03_ACTL
.set I2C_M_bI2C_UDB_Shifter_u0__F0_F1_REG, CYREG_B0_UDB03_F0_F1
.set I2C_M_bI2C_UDB_Shifter_u0__F0_REG, CYREG_B0_UDB03_F0
.set I2C_M_bI2C_UDB_Shifter_u0__F1_REG, CYREG_B0_UDB03_F1
.set I2C_M_bI2C_UDB_StsReg__0__MASK, 0x01
.set I2C_M_bI2C_UDB_StsReg__0__POS, 0
.set I2C_M_bI2C_UDB_StsReg__1__MASK, 0x02
.set I2C_M_bI2C_UDB_StsReg__1__POS, 1
.set I2C_M_bI2C_UDB_StsReg__16BIT_STATUS_AUX_CTL_REG, CYREG_B0_UDB04_05_ACTL
.set I2C_M_bI2C_UDB_StsReg__16BIT_STATUS_REG, CYREG_B0_UDB04_05_ST
.set I2C_M_bI2C_UDB_StsReg__2__MASK, 0x04
.set I2C_M_bI2C_UDB_StsReg__2__POS, 2
.set I2C_M_bI2C_UDB_StsReg__3__MASK, 0x08
.set I2C_M_bI2C_UDB_StsReg__3__POS, 3
.set I2C_M_bI2C_UDB_StsReg__4__MASK, 0x10
.set I2C_M_bI2C_UDB_StsReg__4__POS, 4
.set I2C_M_bI2C_UDB_StsReg__5__MASK, 0x20
.set I2C_M_bI2C_UDB_StsReg__5__POS, 5
.set I2C_M_bI2C_UDB_StsReg__MASK, 0x3F
.set I2C_M_bI2C_UDB_StsReg__MASK_REG, CYREG_B0_UDB04_MSK
.set I2C_M_bI2C_UDB_StsReg__STATUS_AUX_CTL_REG, CYREG_B0_UDB04_ACTL
.set I2C_M_bI2C_UDB_StsReg__STATUS_REG, CYREG_B0_UDB04_ST
.set I2C_M_bI2C_UDB_SyncCtl_CtrlReg__1__MASK, 0x02
.set I2C_M_bI2C_UDB_SyncCtl_CtrlReg__1__POS, 1
.set I2C_M_bI2C_UDB_SyncCtl_CtrlReg__16BIT_CONTROL_AUX_CTL_REG, CYREG_B0_UDB07_08_ACTL
.set I2C_M_bI2C_UDB_SyncCtl_CtrlReg__16BIT_CONTROL_CONTROL_REG, CYREG_B0_UDB07_08_CTL
.set I2C_M_bI2C_UDB_SyncCtl_CtrlReg__16BIT_CONTROL_COUNT_REG, CYREG_B0_UDB07_08_CTL
.set I2C_M_bI2C_UDB_SyncCtl_CtrlReg__16BIT_COUNT_CONTROL_REG, CYREG_B0_UDB07_08_CTL
.set I2C_M_bI2C_UDB_SyncCtl_CtrlReg__16BIT_COUNT_COUNT_REG, CYREG_B0_UDB07_08_CTL
.set I2C_M_bI2C_UDB_SyncCtl_CtrlReg__16BIT_MASK_MASK_REG, CYREG_B0_UDB07_08_MSK
.set I2C_M_bI2C_UDB_SyncCtl_CtrlReg__16BIT_MASK_PERIOD_REG, CYREG_B0_UDB07_08_MSK
.set I2C_M_bI2C_UDB_SyncCtl_CtrlReg__16BIT_PERIOD_MASK_REG, CYREG_B0_UDB07_08_MSK
.set I2C_M_bI2C_UDB_SyncCtl_CtrlReg__16BIT_PERIOD_PERIOD_REG, CYREG_B0_UDB07_08_MSK
.set I2C_M_bI2C_UDB_SyncCtl_CtrlReg__2__MASK, 0x04
.set I2C_M_bI2C_UDB_SyncCtl_CtrlReg__2__POS, 2
.set I2C_M_bI2C_UDB_SyncCtl_CtrlReg__4__MASK, 0x10
.set I2C_M_bI2C_UDB_SyncCtl_CtrlReg__4__POS, 4
.set I2C_M_bI2C_UDB_SyncCtl_CtrlReg__5__MASK, 0x20
.set I2C_M_bI2C_UDB_SyncCtl_CtrlReg__5__POS, 5
.set I2C_M_bI2C_UDB_SyncCtl_CtrlReg__6__MASK, 0x40
.set I2C_M_bI2C_UDB_SyncCtl_CtrlReg__6__POS, 6
.set I2C_M_bI2C_UDB_SyncCtl_CtrlReg__7__MASK, 0x80
.set I2C_M_bI2C_UDB_SyncCtl_CtrlReg__7__POS, 7
.set I2C_M_bI2C_UDB_SyncCtl_CtrlReg__CONTROL_AUX_CTL_REG, CYREG_B0_UDB07_ACTL
.set I2C_M_bI2C_UDB_SyncCtl_CtrlReg__CONTROL_REG, CYREG_B0_UDB07_CTL
.set I2C_M_bI2C_UDB_SyncCtl_CtrlReg__CONTROL_ST_REG, CYREG_B0_UDB07_ST_CTL
.set I2C_M_bI2C_UDB_SyncCtl_CtrlReg__COUNT_REG, CYREG_B0_UDB07_CTL
.set I2C_M_bI2C_UDB_SyncCtl_CtrlReg__COUNT_ST_REG, CYREG_B0_UDB07_ST_CTL
.set I2C_M_bI2C_UDB_SyncCtl_CtrlReg__MASK, 0xF6
.set I2C_M_bI2C_UDB_SyncCtl_CtrlReg__MASK_CTL_AUX_CTL_REG, CYREG_B0_UDB07_MSK_ACTL
.set I2C_M_bI2C_UDB_SyncCtl_CtrlReg__PER_CTL_AUX_CTL_REG, CYREG_B0_UDB07_MSK_ACTL
.set I2C_M_bI2C_UDB_SyncCtl_CtrlReg__PERIOD_REG, CYREG_B0_UDB07_MSK

/* I2C_M_I2C_IRQ */
.set I2C_M_I2C_IRQ__INTC_CLR_EN_REG, CYREG_NVIC_CLRENA0
.set I2C_M_I2C_IRQ__INTC_CLR_PD_REG, CYREG_NVIC_CLRPEND0
.set I2C_M_I2C_IRQ__INTC_MASK, 0x01
.set I2C_M_I2C_IRQ__INTC_NUMBER, 0
.set I2C_M_I2C_IRQ__INTC_PRIOR_NUM, 7
.set I2C_M_I2C_IRQ__INTC_PRIOR_REG, CYREG_NVIC_PRI_0
.set I2C_M_I2C_IRQ__INTC_SET_EN_REG, CYREG_NVIC_SETENA0
.set I2C_M_I2C_IRQ__INTC_SET_PD_REG, CYREG_NVIC_SETPEND0

/* I2C_M_IntClock */
.set I2C_M_IntClock__CFG0, CYREG_CLKDIST_DCFG0_CFG0
.set I2C_M_IntClock__CFG1, CYREG_CLKDIST_DCFG0_CFG1
.set I2C_M_IntClock__CFG2, CYREG_CLKDIST_DCFG0_CFG2
.set I2C_M_IntClock__CFG2_SRC_SEL_MASK, 0x07
.set I2C_M_IntClock__INDEX, 0x00
.set I2C_M_IntClock__PM_ACT_CFG, CYREG_PM_ACT_CFG2
.set I2C_M_IntClock__PM_ACT_MSK, 0x01
.set I2C_M_IntClock__PM_STBY_CFG, CYREG_PM_STBY_CFG2
.set I2C_M_IntClock__PM_STBY_MSK, 0x01

/* Button */
.set Button__0__INTTYPE, CYREG_PICU1_INTTYPE7
.set Button__0__MASK, 0x80
.set Button__0__PC, CYREG_PRT1_PC7
.set Button__0__PORT, 1
.set Button__0__SHIFT, 7
.set Button__AG, CYREG_PRT1_AG
.set Button__AMUX, CYREG_PRT1_AMUX
.set Button__BIE, CYREG_PRT1_BIE
.set Button__BIT_MASK, CYREG_PRT1_BIT_MASK
.set Button__BYP, CYREG_PRT1_BYP
.set Button__CTL, CYREG_PRT1_CTL
.set Button__DM0, CYREG_PRT1_DM0
.set Button__DM1, CYREG_PRT1_DM1
.set Button__DM2, CYREG_PRT1_DM2
.set Button__DR, CYREG_PRT1_DR
.set Button__INP_DIS, CYREG_PRT1_INP_DIS
.set Button__INTSTAT, CYREG_PICU1_INTSTAT
.set Button__INTTYPE_BASE, CYDEV_PICU_INTTYPE_PICU1_BASE
.set Button__LCD_COM_SEG, CYREG_PRT1_LCD_COM_SEG
.set Button__LCD_EN, CYREG_PRT1_LCD_EN
.set Button__MASK, 0x80
.set Button__PORT, 1
.set Button__PRT, CYREG_PRT1_PRT
.set Button__PRTDSI__CAPS_SEL, CYREG_PRT1_CAPS_SEL
.set Button__PRTDSI__DBL_SYNC_IN, CYREG_PRT1_DBL_SYNC_IN
.set Button__PRTDSI__OE_SEL0, CYREG_PRT1_OE_SEL0
.set Button__PRTDSI__OE_SEL1, CYREG_PRT1_OE_SEL1
.set Button__PRTDSI__OUT_SEL0, CYREG_PRT1_OUT_SEL0
.set Button__PRTDSI__OUT_SEL1, CYREG_PRT1_OUT_SEL1
.set Button__PRTDSI__SYNC_OUT, CYREG_PRT1_SYNC_OUT
.set Button__PS, CYREG_PRT1_PS
.set Button__SHIFT, 7
.set Button__SLW, CYREG_PRT1_SLW
.set Button__SNAP, CYREG_PICU1_SNAP

/* Button_Isr */
.set Button_Isr__INTC_CLR_EN_REG, CYREG_NVIC_CLRENA0
.set Button_Isr__INTC_CLR_PD_REG, CYREG_NVIC_CLRPEND0
.set Button_Isr__INTC_MASK, 0x20
.set Button_Isr__INTC_NUMBER, 5
.set Button_Isr__INTC_PRIOR_NUM, 7
.set Button_Isr__INTC_PRIOR_REG, CYREG_NVIC_PRI_5
.set Button_Isr__INTC_SET_EN_REG, CYREG_NVIC_SETENA0
.set Button_Isr__INTC_SET_PD_REG, CYREG_NVIC_SETPEND0

/* LCD_RST */
.set LCD_RST__0__INTTYPE, CYREG_PICU3_INTTYPE5
.set LCD_RST__0__MASK, 0x20
.set LCD_RST__0__PC, CYREG_PRT3_PC5
.set LCD_RST__0__PORT, 3
.set LCD_RST__0__SHIFT, 5
.set LCD_RST__AG, CYREG_PRT3_AG
.set LCD_RST__AMUX, CYREG_PRT3_AMUX
.set LCD_RST__BIE, CYREG_PRT3_BIE
.set LCD_RST__BIT_MASK, CYREG_PRT3_BIT_MASK
.set LCD_RST__BYP, CYREG_PRT3_BYP
.set LCD_RST__CTL, CYREG_PRT3_CTL
.set LCD_RST__DM0, CYREG_PRT3_DM0
.set LCD_RST__DM1, CYREG_PRT3_DM1
.set LCD_RST__DM2, CYREG_PRT3_DM2
.set LCD_RST__DR, CYREG_PRT3_DR
.set LCD_RST__INP_DIS, CYREG_PRT3_INP_DIS
.set LCD_RST__INTTYPE_BASE, CYDEV_PICU_INTTYPE_PICU3_BASE
.set LCD_RST__LCD_COM_SEG, CYREG_PRT3_LCD_COM_SEG
.set LCD_RST__LCD_EN, CYREG_PRT3_LCD_EN
.set LCD_RST__MASK, 0x20
.set LCD_RST__PORT, 3
.set LCD_RST__PRT, CYREG_PRT3_PRT
.set LCD_RST__PRTDSI__CAPS_SEL, CYREG_PRT3_CAPS_SEL
.set LCD_RST__PRTDSI__DBL_SYNC_IN, CYREG_PRT3_DBL_SYNC_IN
.set LCD_RST__PRTDSI__OE_SEL0, CYREG_PRT3_OE_SEL0
.set LCD_RST__PRTDSI__OE_SEL1, CYREG_PRT3_OE_SEL1
.set LCD_RST__PRTDSI__OUT_SEL0, CYREG_PRT3_OUT_SEL0
.set LCD_RST__PRTDSI__OUT_SEL1, CYREG_PRT3_OUT_SEL1
.set LCD_RST__PRTDSI__SYNC_OUT, CYREG_PRT3_SYNC_OUT
.set LCD_RST__PS, CYREG_PRT3_PS
.set LCD_RST__SHIFT, 5
.set LCD_RST__SLW, CYREG_PRT3_SLW

/* Miscellaneous */
.set BCLK__BUS_CLK__HZ, 24000000
.set BCLK__BUS_CLK__KHZ, 24000
.set BCLK__BUS_CLK__MHZ, 24
.set CYDEV_CHIP_DIE_LEOPARD, 1
.set CYDEV_CHIP_DIE_PANTHER, 18
.set CYDEV_CHIP_DIE_PSOC4A, 10
.set CYDEV_CHIP_DIE_PSOC5LP, 17
.set CYDEV_CHIP_DIE_TMA4, 2
.set CYDEV_CHIP_DIE_UNKNOWN, 0
.set CYDEV_CHIP_FAMILY_PSOC3, 1
.set CYDEV_CHIP_FAMILY_PSOC4, 2
.set CYDEV_CHIP_FAMILY_PSOC5, 3
.set CYDEV_CHIP_FAMILY_UNKNOWN, 0
.set CYDEV_CHIP_FAMILY_USED, CYDEV_CHIP_FAMILY_PSOC5
.set CYDEV_CHIP_JTAG_ID, 0x2E123069
.set CYDEV_CHIP_MEMBER_3A, 1
.set CYDEV_CHIP_MEMBER_4A, 10
.set CYDEV_CHIP_MEMBER_4C, 15
.set CYDEV_CHIP_MEMBER_4D, 6
.set CYDEV_CHIP_MEMBER_4E, 4
.set CYDEV_CHIP_MEMBER_4F, 11
.set CYDEV_CHIP_MEMBER_4G, 2
.set CYDEV_CHIP_MEMBER_4H, 9
.set CYDEV_CHIP_MEMBER_4I, 14
.set CYDEV_CHIP_MEMBER_4J, 7
.set CYDEV_CHIP_MEMBER_4K, 8
.set CYDEV_CHIP_MEMBER_4L, 13
.set CYDEV_CHIP_MEMBER_4M, 12
.set CYDEV_CHIP_MEMBER_4N, 5
.set CYDEV_CHIP_MEMBER_4U, 3
.set CYDEV_CHIP_MEMBER_5A, 17
.set CYDEV_CHIP_MEMBER_5B, 16
.set CYDEV_CHIP_MEMBER_UNKNOWN, 0
.set CYDEV_CHIP_MEMBER_USED, CYDEV_CHIP_MEMBER_5B
.set CYDEV_CHIP_DIE_EXPECT, CYDEV_CHIP_MEMBER_USED
.set CYDEV_CHIP_DIE_ACTUAL, CYDEV_CHIP_DIE_EXPECT
.set CYDEV_CHIP_REV_LEOPARD_ES1, 0
.set CYDEV_CHIP_REV_LEOPARD_ES2, 1
.set CYDEV_CHIP_REV_LEOPARD_ES3, 3
.set CYDEV_CHIP_REV_LEOPARD_PRODUCTION, 3
.set CYDEV_CHIP_REV_PANTHER_ES0, 0
.set CYDEV_CHIP_REV_PANTHER_ES1, 1
.set CYDEV_CHIP_REV_PANTHER_PRODUCTION, 1
.set CYDEV_CHIP_REV_PSOC4A_ES0, 17
.set CYDEV_CHIP_REV_PSOC4A_PRODUCTION, 17
.set CYDEV_CHIP_REV_PSOC5LP_ES0, 0
.set CYDEV_CHIP_REV_PSOC5LP_PRODUCTION, 0
.set CYDEV_CHIP_REV_TMA4_ES, 17
.set CYDEV_CHIP_REV_TMA4_ES2, 33
.set CYDEV_CHIP_REV_TMA4_PRODUCTION, 17
.set CYDEV_CHIP_REVISION_3A_ES1, 0
.set CYDEV_CHIP_REVISION_3A_ES2, 1
.set CYDEV_CHIP_REVISION_3A_ES3, 3
.set CYDEV_CHIP_REVISION_3A_PRODUCTION, 3
.set CYDEV_CHIP_REVISION_4A_ES0, 17
.set CYDEV_CHIP_REVISION_4A_PRODUCTION, 17
.set CYDEV_CHIP_REVISION_4C_PRODUCTION, 0
.set CYDEV_CHIP_REVISION_4D_PRODUCTION, 0
.set CYDEV_CHIP_REVISION_4E_PRODUCTION, 0
.set CYDEV_CHIP_REVISION_4F_PRODUCTION, 0
.set CYDEV_CHIP_REVISION_4F_PRODUCTION_256DMA, 0
.set CYDEV_CHIP_REVISION_4F_PRODUCTION_256K, 0
.set CYDEV_CHIP_REVISION_4G_ES, 17
.set CYDEV_CHIP_REVISION_4G_ES2, 33
.set CYDEV_CHIP_REVISION_4G_PRODUCTION, 17
.set CYDEV_CHIP_REVISION_4H_PRODUCTION, 0
.set CYDEV_CHIP_REVISION_4I_PRODUCTION, 0
.set CYDEV_CHIP_REVISION_4J_PRODUCTION, 0
.set CYDEV_CHIP_REVISION_4K_PRODUCTION, 0
.set CYDEV_CHIP_REVISION_4L_PRODUCTION, 0
.set CYDEV_CHIP_REVISION_4M_PRODUCTION, 0
.set CYDEV_CHIP_REVISION_4N_PRODUCTION, 0
.set CYDEV_CHIP_REVISION_4U_PRODUCTION, 0
.set CYDEV_CHIP_REVISION_5A_ES0, 0
.set CYDEV_CHIP_REVISION_5A_ES1, 1
.set CYDEV_CHIP_REVISION_5A_PRODUCTION, 1
.set CYDEV_CHIP_REVISION_5B_ES0, 0
.set CYDEV_CHIP_REVISION_5B_PRODUCTION, 0
.set CYDEV_CHIP_REVISION_USED, CYDEV_CHIP_REVISION_5B_PRODUCTION
.set CYDEV_CHIP_REV_EXPECT, CYDEV_CHIP_REVISION_USED
.set CYDEV_CONFIG_FASTBOOT_ENABLED, 1
.set CYDEV_CONFIG_UNUSED_IO_AllowButWarn, 0
.set CYDEV_CONFIG_UNUSED_IO, CYDEV_CONFIG_UNUSED_IO_AllowButWarn
.set CYDEV_CONFIG_UNUSED_IO_AllowWithInfo, 1
.set CYDEV_CONFIG_UNUSED_IO_Disallowed, 2
.set CYDEV_CONFIGURATION_COMPRESSED, 1
.set CYDEV_CONFIGURATION_DMA, 0
.set CYDEV_CONFIGURATION_ECC, 1
.set CYDEV_CONFIGURATION_IMOENABLED, CYDEV_CONFIG_FASTBOOT_ENABLED
.set CYDEV_CONFIGURATION_MODE_COMPRESSED, 0
.set CYDEV_CONFIGURATION_MODE, CYDEV_CONFIGURATION_MODE_COMPRESSED
.set CYDEV_CONFIGURATION_MODE_DMA, 2
.set CYDEV_CONFIGURATION_MODE_UNCOMPRESSED, 1
.set CYDEV_DEBUG_ENABLE_MASK, 0x20
.set CYDEV_DEBUG_ENABLE_REGISTER, CYREG_MLOGIC_DEBUG
.set CYDEV_DEBUGGING_DPS_Disable, 3
.set CYDEV_DEBUGGING_DPS_JTAG_4, 1
.set CYDEV_DEBUGGING_DPS_JTAG_5, 0
.set CYDEV_DEBUGGING_DPS_SWD, 2
.set CYDEV_DEBUGGING_DPS_SWD_SWV, 6
.set CYDEV_DEBUGGING_DPS, CYDEV_DEBUGGING_DPS_SWD_SWV
.set CYDEV_DEBUGGING_ENABLE, 1
.set CYDEV_DEBUGGING_XRES, 0
.set CYDEV_DMA_CHANNELS_AVAILABLE, 24
.set CYDEV_ECC_ENABLE, 0
.set CYDEV_HEAP_SIZE, 0x80
.set CYDEV_INSTRUCT_CACHE_ENABLED, 1
.set CYDEV_INTR_RISING, 0x00000001
.set CYDEV_IS_EXPORTING_CODE, 0
.set CYDEV_IS_IMPORTING_CODE, 0
.set CYDEV_PROJ_TYPE, 0
.set CYDEV_PROJ_TYPE_BOOTLOADER, 1
.set CYDEV_PROJ_TYPE_LAUNCHER, 5
.set CYDEV_PROJ_TYPE_LOADABLE, 2
.set CYDEV_PROJ_TYPE_LOADABLEANDBOOTLOADER, 4
.set CYDEV_PROJ_TYPE_MULTIAPPBOOTLOADER, 3
.set CYDEV_PROJ_TYPE_STANDARD, 0
.set CYDEV_PROTECTION_ENABLE, 0
.set CYDEV_STACK_SIZE, 0x0800
.set CYDEV_USE_BUNDLED_CMSIS, 1
.set CYDEV_VARIABLE_VDDA, 0
.set CYDEV_VDDA_MV, 5000
.set CYDEV_VDDD_MV, 5000
.set CYDEV_VDDIO0_MV, 5000
.set CYDEV_VDDIO1_MV, 5000
.set CYDEV_VDDIO2_MV, 5000
.set CYDEV_VDDIO3_MV, 5000
.set CYDEV_VIO0_MV, 5000
.set CYDEV_VIO1_MV, 5000
.set CYDEV_VIO2_MV, 5000
.set CYDEV_VIO3_MV, 5000
.set CYIPBLOCK_ARM_CM3_VERSION, 0
.set CYIPBLOCK_P3_ANAIF_VERSION, 0
.set CYIPBLOCK_P3_CAN_VERSION, 0
.set CYIPBLOCK_P3_CAPSENSE_VERSION, 0
.set CYIPBLOCK_P3_COMP_VERSION, 0
.set CYIPBLOCK_P3_DECIMATOR_VERSION, 0
.set CYIPBLOCK_P3_DFB_VERSION, 0
.set CYIPBLOCK_P3_DMA_VERSION, 0
.set CYIPBLOCK_P3_DRQ_VERSION, 0
.set CYIPBLOCK_P3_DSM_VERSION, 0
.set CYIPBLOCK_P3_EMIF_VERSION, 0
.set CYIPBLOCK_P3_I2C_VERSION, 0
.set CYIPBLOCK_P3_LCD_VERSION, 0
.set CYIPBLOCK_P3_LPF_VERSION, 0
.set CYIPBLOCK_P3_OPAMP_VERSION, 0
.set CYIPBLOCK_P3_PM_VERSION, 0
.set CYIPBLOCK_P3_SCCT_VERSION, 0
.set CYIPBLOCK_P3_TIMER_VERSION, 0
.set CYIPBLOCK_P3_USB_VERSION, 0
.set CYIPBLOCK_P3_VIDAC_VERSION, 0
.set CYIPBLOCK_P3_VREF_VERSION, 0
.set CYIPBLOCK_S8_GPIO_VERSION, 0
.set CYIPBLOCK_S8_IRQ_VERSION, 0
.set CYIPBLOCK_S8_SAR_VERSION, 0
.set CYIPBLOCK_S8_SIO_VERSION, 0
.set CYIPBLOCK_S8_UDB_VERSION, 0
.set DMA_CHANNELS_USED__MASK0, 0x00000000
.set CYDEV_BOOTLOADER_ENABLE, 0
.endif
