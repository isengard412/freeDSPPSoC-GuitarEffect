.ifndef INCLUDED_CYFITTERGNU_INC
.set INCLUDED_CYFITTERGNU_INC, 1
.include "cydevicegnu.inc"
.include "cydevicegnu_trm.inc"

/* SCL */
.set SCL__0__INTTYPE, CYREG_PICU12_INTTYPE0
.set SCL__0__MASK, 0x01
.set SCL__0__PC, CYREG_PRT12_PC0
.set SCL__0__PORT, 12
.set SCL__0__SHIFT, 0
.set SCL__AG, CYREG_PRT12_AG
.set SCL__BIE, CYREG_PRT12_BIE
.set SCL__BIT_MASK, CYREG_PRT12_BIT_MASK
.set SCL__BYP, CYREG_PRT12_BYP
.set SCL__DM0, CYREG_PRT12_DM0
.set SCL__DM1, CYREG_PRT12_DM1
.set SCL__DM2, CYREG_PRT12_DM2
.set SCL__DR, CYREG_PRT12_DR
.set SCL__INP_DIS, CYREG_PRT12_INP_DIS
.set SCL__INTTYPE_BASE, CYDEV_PICU_INTTYPE_PICU12_BASE
.set SCL__MASK, 0x01
.set SCL__PORT, 12
.set SCL__PRT, CYREG_PRT12_PRT
.set SCL__PRTDSI__DBL_SYNC_IN, CYREG_PRT12_DBL_SYNC_IN
.set SCL__PRTDSI__OE_SEL0, CYREG_PRT12_OE_SEL0
.set SCL__PRTDSI__OE_SEL1, CYREG_PRT12_OE_SEL1
.set SCL__PRTDSI__OUT_SEL0, CYREG_PRT12_OUT_SEL0
.set SCL__PRTDSI__OUT_SEL1, CYREG_PRT12_OUT_SEL1
.set SCL__PRTDSI__SYNC_OUT, CYREG_PRT12_SYNC_OUT
.set SCL__PS, CYREG_PRT12_PS
.set SCL__SHIFT, 0
.set SCL__SIO_CFG, CYREG_PRT12_SIO_CFG
.set SCL__SIO_DIFF, CYREG_PRT12_SIO_DIFF
.set SCL__SIO_HYST_EN, CYREG_PRT12_SIO_HYST_EN
.set SCL__SIO_REG_HIFREQ, CYREG_PRT12_SIO_REG_HIFREQ
.set SCL__SLW, CYREG_PRT12_SLW

/* SDA */
.set SDA__0__INTTYPE, CYREG_PICU12_INTTYPE1
.set SDA__0__MASK, 0x02
.set SDA__0__PC, CYREG_PRT12_PC1
.set SDA__0__PORT, 12
.set SDA__0__SHIFT, 1
.set SDA__AG, CYREG_PRT12_AG
.set SDA__BIE, CYREG_PRT12_BIE
.set SDA__BIT_MASK, CYREG_PRT12_BIT_MASK
.set SDA__BYP, CYREG_PRT12_BYP
.set SDA__DM0, CYREG_PRT12_DM0
.set SDA__DM1, CYREG_PRT12_DM1
.set SDA__DM2, CYREG_PRT12_DM2
.set SDA__DR, CYREG_PRT12_DR
.set SDA__INP_DIS, CYREG_PRT12_INP_DIS
.set SDA__INTTYPE_BASE, CYDEV_PICU_INTTYPE_PICU12_BASE
.set SDA__MASK, 0x02
.set SDA__PORT, 12
.set SDA__PRT, CYREG_PRT12_PRT
.set SDA__PRTDSI__DBL_SYNC_IN, CYREG_PRT12_DBL_SYNC_IN
.set SDA__PRTDSI__OE_SEL0, CYREG_PRT12_OE_SEL0
.set SDA__PRTDSI__OE_SEL1, CYREG_PRT12_OE_SEL1
.set SDA__PRTDSI__OUT_SEL0, CYREG_PRT12_OUT_SEL0
.set SDA__PRTDSI__OUT_SEL1, CYREG_PRT12_OUT_SEL1
.set SDA__PRTDSI__SYNC_OUT, CYREG_PRT12_SYNC_OUT
.set SDA__PS, CYREG_PRT12_PS
.set SDA__SHIFT, 1
.set SDA__SIO_CFG, CYREG_PRT12_SIO_CFG
.set SDA__SIO_DIFF, CYREG_PRT12_SIO_DIFF
.set SDA__SIO_HYST_EN, CYREG_PRT12_SIO_HYST_EN
.set SDA__SIO_REG_HIFREQ, CYREG_PRT12_SIO_REG_HIFREQ
.set SDA__SLW, CYREG_PRT12_SLW

/* I2CS_I2C_FF */
.set I2CS_I2C_FF__ADR, CYREG_I2C_ADR
.set I2CS_I2C_FF__CFG, CYREG_I2C_CFG
.set I2CS_I2C_FF__CLK_DIV1, CYREG_I2C_CLK_DIV1
.set I2CS_I2C_FF__CLK_DIV2, CYREG_I2C_CLK_DIV2
.set I2CS_I2C_FF__CSR, CYREG_I2C_CSR
.set I2CS_I2C_FF__D, CYREG_I2C_D
.set I2CS_I2C_FF__MCSR, CYREG_I2C_MCSR
.set I2CS_I2C_FF__PM_ACT_CFG, CYREG_PM_ACT_CFG5
.set I2CS_I2C_FF__PM_ACT_MSK, 0x04
.set I2CS_I2C_FF__PM_STBY_CFG, CYREG_PM_STBY_CFG5
.set I2CS_I2C_FF__PM_STBY_MSK, 0x04
.set I2CS_I2C_FF__TMOUT_CFG0, CYREG_I2C_TMOUT_CFG0
.set I2CS_I2C_FF__TMOUT_CFG1, CYREG_I2C_TMOUT_CFG1
.set I2CS_I2C_FF__TMOUT_CSR, CYREG_I2C_TMOUT_CSR
.set I2CS_I2C_FF__TMOUT_SR, CYREG_I2C_TMOUT_SR
.set I2CS_I2C_FF__XCFG, CYREG_I2C_XCFG

/* I2CS_I2C_IRQ */
.set I2CS_I2C_IRQ__INTC_CLR_EN_REG, CYREG_NVIC_CLRENA0
.set I2CS_I2C_IRQ__INTC_CLR_PD_REG, CYREG_NVIC_CLRPEND0
.set I2CS_I2C_IRQ__INTC_MASK, 0x8000
.set I2CS_I2C_IRQ__INTC_NUMBER, 15
.set I2CS_I2C_IRQ__INTC_PRIOR_NUM, 7
.set I2CS_I2C_IRQ__INTC_PRIOR_REG, CYREG_NVIC_PRI_15
.set I2CS_I2C_IRQ__INTC_SET_EN_REG, CYREG_NVIC_SETENA0
.set I2CS_I2C_IRQ__INTC_SET_PD_REG, CYREG_NVIC_SETPEND0

/* IDAC8_viDAC8 */
.set IDAC8_viDAC8__CR0, CYREG_DAC2_CR0
.set IDAC8_viDAC8__CR1, CYREG_DAC2_CR1
.set IDAC8_viDAC8__D, CYREG_DAC2_D
.set IDAC8_viDAC8__PM_ACT_CFG, CYREG_PM_ACT_CFG8
.set IDAC8_viDAC8__PM_ACT_MSK, 0x04
.set IDAC8_viDAC8__PM_STBY_CFG, CYREG_PM_STBY_CFG8
.set IDAC8_viDAC8__PM_STBY_MSK, 0x04
.set IDAC8_viDAC8__STROBE, CYREG_DAC2_STROBE
.set IDAC8_viDAC8__SW0, CYREG_DAC2_SW0
.set IDAC8_viDAC8__SW2, CYREG_DAC2_SW2
.set IDAC8_viDAC8__SW3, CYREG_DAC2_SW3
.set IDAC8_viDAC8__SW4, CYREG_DAC2_SW4
.set IDAC8_viDAC8__TR, CYREG_DAC2_TR
.set IDAC8_viDAC8__TRIM__M1, CYREG_FLSHID_CUST_TABLES_DAC2_M1
.set IDAC8_viDAC8__TRIM__M2, CYREG_FLSHID_CUST_TABLES_DAC2_M2
.set IDAC8_viDAC8__TRIM__M3, CYREG_FLSHID_CUST_TABLES_DAC2_M3
.set IDAC8_viDAC8__TRIM__M4, CYREG_FLSHID_CUST_TABLES_DAC2_M4
.set IDAC8_viDAC8__TRIM__M5, CYREG_FLSHID_CUST_TABLES_DAC2_M5
.set IDAC8_viDAC8__TRIM__M6, CYREG_FLSHID_CUST_TABLES_DAC2_M6
.set IDAC8_viDAC8__TRIM__M7, CYREG_FLSHID_CUST_TABLES_DAC2_M7
.set IDAC8_viDAC8__TRIM__M8, CYREG_FLSHID_CUST_TABLES_DAC2_M8
.set IDAC8_viDAC8__TST, CYREG_DAC2_TST

/* Mux_0 */
.set Mux_0__0__INTTYPE, CYREG_PICU0_INTTYPE0
.set Mux_0__0__MASK, 0x01
.set Mux_0__0__PC, CYREG_PRT0_PC0
.set Mux_0__0__PORT, 0
.set Mux_0__0__SHIFT, 0
.set Mux_0__AG, CYREG_PRT0_AG
.set Mux_0__AMUX, CYREG_PRT0_AMUX
.set Mux_0__BIE, CYREG_PRT0_BIE
.set Mux_0__BIT_MASK, CYREG_PRT0_BIT_MASK
.set Mux_0__BYP, CYREG_PRT0_BYP
.set Mux_0__CTL, CYREG_PRT0_CTL
.set Mux_0__DM0, CYREG_PRT0_DM0
.set Mux_0__DM1, CYREG_PRT0_DM1
.set Mux_0__DM2, CYREG_PRT0_DM2
.set Mux_0__DR, CYREG_PRT0_DR
.set Mux_0__INP_DIS, CYREG_PRT0_INP_DIS
.set Mux_0__INTTYPE_BASE, CYDEV_PICU_INTTYPE_PICU0_BASE
.set Mux_0__LCD_COM_SEG, CYREG_PRT0_LCD_COM_SEG
.set Mux_0__LCD_EN, CYREG_PRT0_LCD_EN
.set Mux_0__MASK, 0x01
.set Mux_0__PORT, 0
.set Mux_0__PRT, CYREG_PRT0_PRT
.set Mux_0__PRTDSI__CAPS_SEL, CYREG_PRT0_CAPS_SEL
.set Mux_0__PRTDSI__DBL_SYNC_IN, CYREG_PRT0_DBL_SYNC_IN
.set Mux_0__PRTDSI__OE_SEL0, CYREG_PRT0_OE_SEL0
.set Mux_0__PRTDSI__OE_SEL1, CYREG_PRT0_OE_SEL1
.set Mux_0__PRTDSI__OUT_SEL0, CYREG_PRT0_OUT_SEL0
.set Mux_0__PRTDSI__OUT_SEL1, CYREG_PRT0_OUT_SEL1
.set Mux_0__PRTDSI__SYNC_OUT, CYREG_PRT0_SYNC_OUT
.set Mux_0__PS, CYREG_PRT0_PS
.set Mux_0__SHIFT, 0
.set Mux_0__SLW, CYREG_PRT0_SLW

/* Mux_1 */
.set Mux_1__0__INTTYPE, CYREG_PICU0_INTTYPE1
.set Mux_1__0__MASK, 0x02
.set Mux_1__0__PC, CYREG_PRT0_PC1
.set Mux_1__0__PORT, 0
.set Mux_1__0__SHIFT, 1
.set Mux_1__AG, CYREG_PRT0_AG
.set Mux_1__AMUX, CYREG_PRT0_AMUX
.set Mux_1__BIE, CYREG_PRT0_BIE
.set Mux_1__BIT_MASK, CYREG_PRT0_BIT_MASK
.set Mux_1__BYP, CYREG_PRT0_BYP
.set Mux_1__CTL, CYREG_PRT0_CTL
.set Mux_1__DM0, CYREG_PRT0_DM0
.set Mux_1__DM1, CYREG_PRT0_DM1
.set Mux_1__DM2, CYREG_PRT0_DM2
.set Mux_1__DR, CYREG_PRT0_DR
.set Mux_1__INP_DIS, CYREG_PRT0_INP_DIS
.set Mux_1__INTTYPE_BASE, CYDEV_PICU_INTTYPE_PICU0_BASE
.set Mux_1__LCD_COM_SEG, CYREG_PRT0_LCD_COM_SEG
.set Mux_1__LCD_EN, CYREG_PRT0_LCD_EN
.set Mux_1__MASK, 0x02
.set Mux_1__PORT, 0
.set Mux_1__PRT, CYREG_PRT0_PRT
.set Mux_1__PRTDSI__CAPS_SEL, CYREG_PRT0_CAPS_SEL
.set Mux_1__PRTDSI__DBL_SYNC_IN, CYREG_PRT0_DBL_SYNC_IN
.set Mux_1__PRTDSI__OE_SEL0, CYREG_PRT0_OE_SEL0
.set Mux_1__PRTDSI__OE_SEL1, CYREG_PRT0_OE_SEL1
.set Mux_1__PRTDSI__OUT_SEL0, CYREG_PRT0_OUT_SEL0
.set Mux_1__PRTDSI__OUT_SEL1, CYREG_PRT0_OUT_SEL1
.set Mux_1__PRTDSI__SYNC_OUT, CYREG_PRT0_SYNC_OUT
.set Mux_1__PS, CYREG_PRT0_PS
.set Mux_1__SHIFT, 1
.set Mux_1__SLW, CYREG_PRT0_SLW

/* Mux_2 */
.set Mux_2__0__INTTYPE, CYREG_PICU0_INTTYPE2
.set Mux_2__0__MASK, 0x04
.set Mux_2__0__PC, CYREG_PRT0_PC2
.set Mux_2__0__PORT, 0
.set Mux_2__0__SHIFT, 2
.set Mux_2__AG, CYREG_PRT0_AG
.set Mux_2__AMUX, CYREG_PRT0_AMUX
.set Mux_2__BIE, CYREG_PRT0_BIE
.set Mux_2__BIT_MASK, CYREG_PRT0_BIT_MASK
.set Mux_2__BYP, CYREG_PRT0_BYP
.set Mux_2__CTL, CYREG_PRT0_CTL
.set Mux_2__DM0, CYREG_PRT0_DM0
.set Mux_2__DM1, CYREG_PRT0_DM1
.set Mux_2__DM2, CYREG_PRT0_DM2
.set Mux_2__DR, CYREG_PRT0_DR
.set Mux_2__INP_DIS, CYREG_PRT0_INP_DIS
.set Mux_2__INTTYPE_BASE, CYDEV_PICU_INTTYPE_PICU0_BASE
.set Mux_2__LCD_COM_SEG, CYREG_PRT0_LCD_COM_SEG
.set Mux_2__LCD_EN, CYREG_PRT0_LCD_EN
.set Mux_2__MASK, 0x04
.set Mux_2__PORT, 0
.set Mux_2__PRT, CYREG_PRT0_PRT
.set Mux_2__PRTDSI__CAPS_SEL, CYREG_PRT0_CAPS_SEL
.set Mux_2__PRTDSI__DBL_SYNC_IN, CYREG_PRT0_DBL_SYNC_IN
.set Mux_2__PRTDSI__OE_SEL0, CYREG_PRT0_OE_SEL0
.set Mux_2__PRTDSI__OE_SEL1, CYREG_PRT0_OE_SEL1
.set Mux_2__PRTDSI__OUT_SEL0, CYREG_PRT0_OUT_SEL0
.set Mux_2__PRTDSI__OUT_SEL1, CYREG_PRT0_OUT_SEL1
.set Mux_2__PRTDSI__SYNC_OUT, CYREG_PRT0_SYNC_OUT
.set Mux_2__PS, CYREG_PRT0_PS
.set Mux_2__SHIFT, 2
.set Mux_2__SLW, CYREG_PRT0_SLW

/* Mux_3 */
.set Mux_3__0__INTTYPE, CYREG_PICU0_INTTYPE3
.set Mux_3__0__MASK, 0x08
.set Mux_3__0__PC, CYREG_PRT0_PC3
.set Mux_3__0__PORT, 0
.set Mux_3__0__SHIFT, 3
.set Mux_3__AG, CYREG_PRT0_AG
.set Mux_3__AMUX, CYREG_PRT0_AMUX
.set Mux_3__BIE, CYREG_PRT0_BIE
.set Mux_3__BIT_MASK, CYREG_PRT0_BIT_MASK
.set Mux_3__BYP, CYREG_PRT0_BYP
.set Mux_3__CTL, CYREG_PRT0_CTL
.set Mux_3__DM0, CYREG_PRT0_DM0
.set Mux_3__DM1, CYREG_PRT0_DM1
.set Mux_3__DM2, CYREG_PRT0_DM2
.set Mux_3__DR, CYREG_PRT0_DR
.set Mux_3__INP_DIS, CYREG_PRT0_INP_DIS
.set Mux_3__INTTYPE_BASE, CYDEV_PICU_INTTYPE_PICU0_BASE
.set Mux_3__LCD_COM_SEG, CYREG_PRT0_LCD_COM_SEG
.set Mux_3__LCD_EN, CYREG_PRT0_LCD_EN
.set Mux_3__MASK, 0x08
.set Mux_3__PORT, 0
.set Mux_3__PRT, CYREG_PRT0_PRT
.set Mux_3__PRTDSI__CAPS_SEL, CYREG_PRT0_CAPS_SEL
.set Mux_3__PRTDSI__DBL_SYNC_IN, CYREG_PRT0_DBL_SYNC_IN
.set Mux_3__PRTDSI__OE_SEL0, CYREG_PRT0_OE_SEL0
.set Mux_3__PRTDSI__OE_SEL1, CYREG_PRT0_OE_SEL1
.set Mux_3__PRTDSI__OUT_SEL0, CYREG_PRT0_OUT_SEL0
.set Mux_3__PRTDSI__OUT_SEL1, CYREG_PRT0_OUT_SEL1
.set Mux_3__PRTDSI__SYNC_OUT, CYREG_PRT0_SYNC_OUT
.set Mux_3__PS, CYREG_PRT0_PS
.set Mux_3__SHIFT, 3
.set Mux_3__SLW, CYREG_PRT0_SLW

/* Mux_4 */
.set Mux_4__0__INTTYPE, CYREG_PICU0_INTTYPE4
.set Mux_4__0__MASK, 0x10
.set Mux_4__0__PC, CYREG_PRT0_PC4
.set Mux_4__0__PORT, 0
.set Mux_4__0__SHIFT, 4
.set Mux_4__AG, CYREG_PRT0_AG
.set Mux_4__AMUX, CYREG_PRT0_AMUX
.set Mux_4__BIE, CYREG_PRT0_BIE
.set Mux_4__BIT_MASK, CYREG_PRT0_BIT_MASK
.set Mux_4__BYP, CYREG_PRT0_BYP
.set Mux_4__CTL, CYREG_PRT0_CTL
.set Mux_4__DM0, CYREG_PRT0_DM0
.set Mux_4__DM1, CYREG_PRT0_DM1
.set Mux_4__DM2, CYREG_PRT0_DM2
.set Mux_4__DR, CYREG_PRT0_DR
.set Mux_4__INP_DIS, CYREG_PRT0_INP_DIS
.set Mux_4__INTTYPE_BASE, CYDEV_PICU_INTTYPE_PICU0_BASE
.set Mux_4__LCD_COM_SEG, CYREG_PRT0_LCD_COM_SEG
.set Mux_4__LCD_EN, CYREG_PRT0_LCD_EN
.set Mux_4__MASK, 0x10
.set Mux_4__PORT, 0
.set Mux_4__PRT, CYREG_PRT0_PRT
.set Mux_4__PRTDSI__CAPS_SEL, CYREG_PRT0_CAPS_SEL
.set Mux_4__PRTDSI__DBL_SYNC_IN, CYREG_PRT0_DBL_SYNC_IN
.set Mux_4__PRTDSI__OE_SEL0, CYREG_PRT0_OE_SEL0
.set Mux_4__PRTDSI__OE_SEL1, CYREG_PRT0_OE_SEL1
.set Mux_4__PRTDSI__OUT_SEL0, CYREG_PRT0_OUT_SEL0
.set Mux_4__PRTDSI__OUT_SEL1, CYREG_PRT0_OUT_SEL1
.set Mux_4__PRTDSI__SYNC_OUT, CYREG_PRT0_SYNC_OUT
.set Mux_4__PS, CYREG_PRT0_PS
.set Mux_4__SHIFT, 4
.set Mux_4__SLW, CYREG_PRT0_SLW

/* Mux_5 */
.set Mux_5__0__INTTYPE, CYREG_PICU0_INTTYPE5
.set Mux_5__0__MASK, 0x20
.set Mux_5__0__PC, CYREG_PRT0_PC5
.set Mux_5__0__PORT, 0
.set Mux_5__0__SHIFT, 5
.set Mux_5__AG, CYREG_PRT0_AG
.set Mux_5__AMUX, CYREG_PRT0_AMUX
.set Mux_5__BIE, CYREG_PRT0_BIE
.set Mux_5__BIT_MASK, CYREG_PRT0_BIT_MASK
.set Mux_5__BYP, CYREG_PRT0_BYP
.set Mux_5__CTL, CYREG_PRT0_CTL
.set Mux_5__DM0, CYREG_PRT0_DM0
.set Mux_5__DM1, CYREG_PRT0_DM1
.set Mux_5__DM2, CYREG_PRT0_DM2
.set Mux_5__DR, CYREG_PRT0_DR
.set Mux_5__INP_DIS, CYREG_PRT0_INP_DIS
.set Mux_5__INTTYPE_BASE, CYDEV_PICU_INTTYPE_PICU0_BASE
.set Mux_5__LCD_COM_SEG, CYREG_PRT0_LCD_COM_SEG
.set Mux_5__LCD_EN, CYREG_PRT0_LCD_EN
.set Mux_5__MASK, 0x20
.set Mux_5__PORT, 0
.set Mux_5__PRT, CYREG_PRT0_PRT
.set Mux_5__PRTDSI__CAPS_SEL, CYREG_PRT0_CAPS_SEL
.set Mux_5__PRTDSI__DBL_SYNC_IN, CYREG_PRT0_DBL_SYNC_IN
.set Mux_5__PRTDSI__OE_SEL0, CYREG_PRT0_OE_SEL0
.set Mux_5__PRTDSI__OE_SEL1, CYREG_PRT0_OE_SEL1
.set Mux_5__PRTDSI__OUT_SEL0, CYREG_PRT0_OUT_SEL0
.set Mux_5__PRTDSI__OUT_SEL1, CYREG_PRT0_OUT_SEL1
.set Mux_5__PRTDSI__SYNC_OUT, CYREG_PRT0_SYNC_OUT
.set Mux_5__PS, CYREG_PRT0_PS
.set Mux_5__SHIFT, 5
.set Mux_5__SLW, CYREG_PRT0_SLW

/* Mux_6 */
.set Mux_6__0__INTTYPE, CYREG_PICU0_INTTYPE6
.set Mux_6__0__MASK, 0x40
.set Mux_6__0__PC, CYREG_PRT0_PC6
.set Mux_6__0__PORT, 0
.set Mux_6__0__SHIFT, 6
.set Mux_6__AG, CYREG_PRT0_AG
.set Mux_6__AMUX, CYREG_PRT0_AMUX
.set Mux_6__BIE, CYREG_PRT0_BIE
.set Mux_6__BIT_MASK, CYREG_PRT0_BIT_MASK
.set Mux_6__BYP, CYREG_PRT0_BYP
.set Mux_6__CTL, CYREG_PRT0_CTL
.set Mux_6__DM0, CYREG_PRT0_DM0
.set Mux_6__DM1, CYREG_PRT0_DM1
.set Mux_6__DM2, CYREG_PRT0_DM2
.set Mux_6__DR, CYREG_PRT0_DR
.set Mux_6__INP_DIS, CYREG_PRT0_INP_DIS
.set Mux_6__INTTYPE_BASE, CYDEV_PICU_INTTYPE_PICU0_BASE
.set Mux_6__LCD_COM_SEG, CYREG_PRT0_LCD_COM_SEG
.set Mux_6__LCD_EN, CYREG_PRT0_LCD_EN
.set Mux_6__MASK, 0x40
.set Mux_6__PORT, 0
.set Mux_6__PRT, CYREG_PRT0_PRT
.set Mux_6__PRTDSI__CAPS_SEL, CYREG_PRT0_CAPS_SEL
.set Mux_6__PRTDSI__DBL_SYNC_IN, CYREG_PRT0_DBL_SYNC_IN
.set Mux_6__PRTDSI__OE_SEL0, CYREG_PRT0_OE_SEL0
.set Mux_6__PRTDSI__OE_SEL1, CYREG_PRT0_OE_SEL1
.set Mux_6__PRTDSI__OUT_SEL0, CYREG_PRT0_OUT_SEL0
.set Mux_6__PRTDSI__OUT_SEL1, CYREG_PRT0_OUT_SEL1
.set Mux_6__PRTDSI__SYNC_OUT, CYREG_PRT0_SYNC_OUT
.set Mux_6__PS, CYREG_PRT0_PS
.set Mux_6__SHIFT, 6
.set Mux_6__SLW, CYREG_PRT0_SLW

/* Mux_7 */
.set Mux_7__0__INTTYPE, CYREG_PICU1_INTTYPE4
.set Mux_7__0__MASK, 0x10
.set Mux_7__0__PC, CYREG_PRT1_PC4
.set Mux_7__0__PORT, 1
.set Mux_7__0__SHIFT, 4
.set Mux_7__AG, CYREG_PRT1_AG
.set Mux_7__AMUX, CYREG_PRT1_AMUX
.set Mux_7__BIE, CYREG_PRT1_BIE
.set Mux_7__BIT_MASK, CYREG_PRT1_BIT_MASK
.set Mux_7__BYP, CYREG_PRT1_BYP
.set Mux_7__CTL, CYREG_PRT1_CTL
.set Mux_7__DM0, CYREG_PRT1_DM0
.set Mux_7__DM1, CYREG_PRT1_DM1
.set Mux_7__DM2, CYREG_PRT1_DM2
.set Mux_7__DR, CYREG_PRT1_DR
.set Mux_7__INP_DIS, CYREG_PRT1_INP_DIS
.set Mux_7__INTTYPE_BASE, CYDEV_PICU_INTTYPE_PICU1_BASE
.set Mux_7__LCD_COM_SEG, CYREG_PRT1_LCD_COM_SEG
.set Mux_7__LCD_EN, CYREG_PRT1_LCD_EN
.set Mux_7__MASK, 0x10
.set Mux_7__PORT, 1
.set Mux_7__PRT, CYREG_PRT1_PRT
.set Mux_7__PRTDSI__CAPS_SEL, CYREG_PRT1_CAPS_SEL
.set Mux_7__PRTDSI__DBL_SYNC_IN, CYREG_PRT1_DBL_SYNC_IN
.set Mux_7__PRTDSI__OE_SEL0, CYREG_PRT1_OE_SEL0
.set Mux_7__PRTDSI__OE_SEL1, CYREG_PRT1_OE_SEL1
.set Mux_7__PRTDSI__OUT_SEL0, CYREG_PRT1_OUT_SEL0
.set Mux_7__PRTDSI__OUT_SEL1, CYREG_PRT1_OUT_SEL1
.set Mux_7__PRTDSI__SYNC_OUT, CYREG_PRT1_SYNC_OUT
.set Mux_7__PS, CYREG_PRT1_PS
.set Mux_7__SHIFT, 4
.set Mux_7__SLW, CYREG_PRT1_SLW

/* LCD_Char_LCDPort */
.set LCD_Char_LCDPort__0__INTTYPE, CYREG_PICU2_INTTYPE0
.set LCD_Char_LCDPort__0__MASK, 0x01
.set LCD_Char_LCDPort__0__PC, CYREG_PRT2_PC0
.set LCD_Char_LCDPort__0__PORT, 2
.set LCD_Char_LCDPort__0__SHIFT, 0
.set LCD_Char_LCDPort__1__INTTYPE, CYREG_PICU2_INTTYPE1
.set LCD_Char_LCDPort__1__MASK, 0x02
.set LCD_Char_LCDPort__1__PC, CYREG_PRT2_PC1
.set LCD_Char_LCDPort__1__PORT, 2
.set LCD_Char_LCDPort__1__SHIFT, 1
.set LCD_Char_LCDPort__2__INTTYPE, CYREG_PICU2_INTTYPE2
.set LCD_Char_LCDPort__2__MASK, 0x04
.set LCD_Char_LCDPort__2__PC, CYREG_PRT2_PC2
.set LCD_Char_LCDPort__2__PORT, 2
.set LCD_Char_LCDPort__2__SHIFT, 2
.set LCD_Char_LCDPort__3__INTTYPE, CYREG_PICU2_INTTYPE3
.set LCD_Char_LCDPort__3__MASK, 0x08
.set LCD_Char_LCDPort__3__PC, CYREG_PRT2_PC3
.set LCD_Char_LCDPort__3__PORT, 2
.set LCD_Char_LCDPort__3__SHIFT, 3
.set LCD_Char_LCDPort__4__INTTYPE, CYREG_PICU2_INTTYPE4
.set LCD_Char_LCDPort__4__MASK, 0x10
.set LCD_Char_LCDPort__4__PC, CYREG_PRT2_PC4
.set LCD_Char_LCDPort__4__PORT, 2
.set LCD_Char_LCDPort__4__SHIFT, 4
.set LCD_Char_LCDPort__5__INTTYPE, CYREG_PICU2_INTTYPE5
.set LCD_Char_LCDPort__5__MASK, 0x20
.set LCD_Char_LCDPort__5__PC, CYREG_PRT2_PC5
.set LCD_Char_LCDPort__5__PORT, 2
.set LCD_Char_LCDPort__5__SHIFT, 5
.set LCD_Char_LCDPort__6__INTTYPE, CYREG_PICU2_INTTYPE6
.set LCD_Char_LCDPort__6__MASK, 0x40
.set LCD_Char_LCDPort__6__PC, CYREG_PRT2_PC6
.set LCD_Char_LCDPort__6__PORT, 2
.set LCD_Char_LCDPort__6__SHIFT, 6
.set LCD_Char_LCDPort__AG, CYREG_PRT2_AG
.set LCD_Char_LCDPort__AMUX, CYREG_PRT2_AMUX
.set LCD_Char_LCDPort__BIE, CYREG_PRT2_BIE
.set LCD_Char_LCDPort__BIT_MASK, CYREG_PRT2_BIT_MASK
.set LCD_Char_LCDPort__BYP, CYREG_PRT2_BYP
.set LCD_Char_LCDPort__CTL, CYREG_PRT2_CTL
.set LCD_Char_LCDPort__DM0, CYREG_PRT2_DM0
.set LCD_Char_LCDPort__DM1, CYREG_PRT2_DM1
.set LCD_Char_LCDPort__DM2, CYREG_PRT2_DM2
.set LCD_Char_LCDPort__DR, CYREG_PRT2_DR
.set LCD_Char_LCDPort__INP_DIS, CYREG_PRT2_INP_DIS
.set LCD_Char_LCDPort__INTTYPE_BASE, CYDEV_PICU_INTTYPE_PICU2_BASE
.set LCD_Char_LCDPort__LCD_COM_SEG, CYREG_PRT2_LCD_COM_SEG
.set LCD_Char_LCDPort__LCD_EN, CYREG_PRT2_LCD_EN
.set LCD_Char_LCDPort__MASK, 0x7F
.set LCD_Char_LCDPort__PORT, 2
.set LCD_Char_LCDPort__PRT, CYREG_PRT2_PRT
.set LCD_Char_LCDPort__PRTDSI__CAPS_SEL, CYREG_PRT2_CAPS_SEL
.set LCD_Char_LCDPort__PRTDSI__DBL_SYNC_IN, CYREG_PRT2_DBL_SYNC_IN
.set LCD_Char_LCDPort__PRTDSI__OE_SEL0, CYREG_PRT2_OE_SEL0
.set LCD_Char_LCDPort__PRTDSI__OE_SEL1, CYREG_PRT2_OE_SEL1
.set LCD_Char_LCDPort__PRTDSI__OUT_SEL0, CYREG_PRT2_OUT_SEL0
.set LCD_Char_LCDPort__PRTDSI__OUT_SEL1, CYREG_PRT2_OUT_SEL1
.set LCD_Char_LCDPort__PRTDSI__SYNC_OUT, CYREG_PRT2_SYNC_OUT
.set LCD_Char_LCDPort__PS, CYREG_PRT2_PS
.set LCD_Char_LCDPort__SHIFT, 0
.set LCD_Char_LCDPort__SLW, CYREG_PRT2_SLW

/* ADC_DelSig_DEC */
.set ADC_DelSig_DEC__COHER, CYREG_DEC_COHER
.set ADC_DelSig_DEC__CR, CYREG_DEC_CR
.set ADC_DelSig_DEC__DR1, CYREG_DEC_DR1
.set ADC_DelSig_DEC__DR2, CYREG_DEC_DR2
.set ADC_DelSig_DEC__DR2H, CYREG_DEC_DR2H
.set ADC_DelSig_DEC__GCOR, CYREG_DEC_GCOR
.set ADC_DelSig_DEC__GCORH, CYREG_DEC_GCORH
.set ADC_DelSig_DEC__GVAL, CYREG_DEC_GVAL
.set ADC_DelSig_DEC__OCOR, CYREG_DEC_OCOR
.set ADC_DelSig_DEC__OCORH, CYREG_DEC_OCORH
.set ADC_DelSig_DEC__OCORM, CYREG_DEC_OCORM
.set ADC_DelSig_DEC__OUTSAMP, CYREG_DEC_OUTSAMP
.set ADC_DelSig_DEC__OUTSAMPH, CYREG_DEC_OUTSAMPH
.set ADC_DelSig_DEC__OUTSAMPM, CYREG_DEC_OUTSAMPM
.set ADC_DelSig_DEC__OUTSAMPS, CYREG_DEC_OUTSAMPS
.set ADC_DelSig_DEC__PM_ACT_CFG, CYREG_PM_ACT_CFG10
.set ADC_DelSig_DEC__PM_ACT_MSK, 0x01
.set ADC_DelSig_DEC__PM_STBY_CFG, CYREG_PM_STBY_CFG10
.set ADC_DelSig_DEC__PM_STBY_MSK, 0x01
.set ADC_DelSig_DEC__SHIFT1, CYREG_DEC_SHIFT1
.set ADC_DelSig_DEC__SHIFT2, CYREG_DEC_SHIFT2
.set ADC_DelSig_DEC__SR, CYREG_DEC_SR
.set ADC_DelSig_DEC__TRIM__M1, CYREG_FLSHID_CUST_TABLES_DEC_M1
.set ADC_DelSig_DEC__TRIM__M2, CYREG_FLSHID_CUST_TABLES_DEC_M2
.set ADC_DelSig_DEC__TRIM__M3, CYREG_FLSHID_CUST_TABLES_DEC_M3
.set ADC_DelSig_DEC__TRIM__M4, CYREG_FLSHID_CUST_TABLES_DEC_M4
.set ADC_DelSig_DEC__TRIM__M5, CYREG_FLSHID_CUST_TABLES_DEC_M5
.set ADC_DelSig_DEC__TRIM__M6, CYREG_FLSHID_CUST_TABLES_DEC_M6
.set ADC_DelSig_DEC__TRIM__M7, CYREG_FLSHID_CUST_TABLES_DEC_M7
.set ADC_DelSig_DEC__TRIM__M8, CYREG_FLSHID_CUST_TABLES_DEC_M8

/* ADC_DelSig_DSM */
.set ADC_DelSig_DSM__BUF0, CYREG_DSM0_BUF0
.set ADC_DelSig_DSM__BUF1, CYREG_DSM0_BUF1
.set ADC_DelSig_DSM__BUF2, CYREG_DSM0_BUF2
.set ADC_DelSig_DSM__BUF3, CYREG_DSM0_BUF3
.set ADC_DelSig_DSM__CLK, CYREG_DSM0_CLK
.set ADC_DelSig_DSM__CR0, CYREG_DSM0_CR0
.set ADC_DelSig_DSM__CR1, CYREG_DSM0_CR1
.set ADC_DelSig_DSM__CR10, CYREG_DSM0_CR10
.set ADC_DelSig_DSM__CR11, CYREG_DSM0_CR11
.set ADC_DelSig_DSM__CR12, CYREG_DSM0_CR12
.set ADC_DelSig_DSM__CR13, CYREG_DSM0_CR13
.set ADC_DelSig_DSM__CR14, CYREG_DSM0_CR14
.set ADC_DelSig_DSM__CR15, CYREG_DSM0_CR15
.set ADC_DelSig_DSM__CR16, CYREG_DSM0_CR16
.set ADC_DelSig_DSM__CR17, CYREG_DSM0_CR17
.set ADC_DelSig_DSM__CR2, CYREG_DSM0_CR2
.set ADC_DelSig_DSM__CR3, CYREG_DSM0_CR3
.set ADC_DelSig_DSM__CR4, CYREG_DSM0_CR4
.set ADC_DelSig_DSM__CR5, CYREG_DSM0_CR5
.set ADC_DelSig_DSM__CR6, CYREG_DSM0_CR6
.set ADC_DelSig_DSM__CR7, CYREG_DSM0_CR7
.set ADC_DelSig_DSM__CR8, CYREG_DSM0_CR8
.set ADC_DelSig_DSM__CR9, CYREG_DSM0_CR9
.set ADC_DelSig_DSM__DEM0, CYREG_DSM0_DEM0
.set ADC_DelSig_DSM__DEM1, CYREG_DSM0_DEM1
.set ADC_DelSig_DSM__MISC, CYREG_DSM0_MISC
.set ADC_DelSig_DSM__OUT0, CYREG_DSM0_OUT0
.set ADC_DelSig_DSM__OUT1, CYREG_DSM0_OUT1
.set ADC_DelSig_DSM__REF0, CYREG_DSM0_REF0
.set ADC_DelSig_DSM__REF1, CYREG_DSM0_REF1
.set ADC_DelSig_DSM__REF2, CYREG_DSM0_REF2
.set ADC_DelSig_DSM__REF3, CYREG_DSM0_REF3
.set ADC_DelSig_DSM__RSVD1, CYREG_DSM0_RSVD1
.set ADC_DelSig_DSM__SW0, CYREG_DSM0_SW0
.set ADC_DelSig_DSM__SW2, CYREG_DSM0_SW2
.set ADC_DelSig_DSM__SW3, CYREG_DSM0_SW3
.set ADC_DelSig_DSM__SW4, CYREG_DSM0_SW4
.set ADC_DelSig_DSM__SW6, CYREG_DSM0_SW6
.set ADC_DelSig_DSM__TR0, CYREG_NPUMP_DSM_TR0
.set ADC_DelSig_DSM__TST0, CYREG_DSM0_TST0
.set ADC_DelSig_DSM__TST1, CYREG_DSM0_TST1

/* ADC_DelSig_Ext_CP_Clk */
.set ADC_DelSig_Ext_CP_Clk__CFG0, CYREG_CLKDIST_DCFG0_CFG0
.set ADC_DelSig_Ext_CP_Clk__CFG1, CYREG_CLKDIST_DCFG0_CFG1
.set ADC_DelSig_Ext_CP_Clk__CFG2, CYREG_CLKDIST_DCFG0_CFG2
.set ADC_DelSig_Ext_CP_Clk__CFG2_SRC_SEL_MASK, 0x07
.set ADC_DelSig_Ext_CP_Clk__INDEX, 0x00
.set ADC_DelSig_Ext_CP_Clk__PM_ACT_CFG, CYREG_PM_ACT_CFG2
.set ADC_DelSig_Ext_CP_Clk__PM_ACT_MSK, 0x01
.set ADC_DelSig_Ext_CP_Clk__PM_STBY_CFG, CYREG_PM_STBY_CFG2
.set ADC_DelSig_Ext_CP_Clk__PM_STBY_MSK, 0x01

/* ADC_DelSig_IRQ */
.set ADC_DelSig_IRQ__INTC_CLR_EN_REG, CYREG_NVIC_CLRENA0
.set ADC_DelSig_IRQ__INTC_CLR_PD_REG, CYREG_NVIC_CLRPEND0
.set ADC_DelSig_IRQ__INTC_MASK, 0x20000000
.set ADC_DelSig_IRQ__INTC_NUMBER, 29
.set ADC_DelSig_IRQ__INTC_PRIOR_NUM, 7
.set ADC_DelSig_IRQ__INTC_PRIOR_REG, CYREG_NVIC_PRI_29
.set ADC_DelSig_IRQ__INTC_SET_EN_REG, CYREG_NVIC_SETENA0
.set ADC_DelSig_IRQ__INTC_SET_PD_REG, CYREG_NVIC_SETPEND0

/* ADC_DelSig_theACLK */
.set ADC_DelSig_theACLK__CFG0, CYREG_CLKDIST_ACFG0_CFG0
.set ADC_DelSig_theACLK__CFG1, CYREG_CLKDIST_ACFG0_CFG1
.set ADC_DelSig_theACLK__CFG2, CYREG_CLKDIST_ACFG0_CFG2
.set ADC_DelSig_theACLK__CFG2_SRC_SEL_MASK, 0x07
.set ADC_DelSig_theACLK__CFG3, CYREG_CLKDIST_ACFG0_CFG3
.set ADC_DelSig_theACLK__CFG3_PHASE_DLY_MASK, 0x0F
.set ADC_DelSig_theACLK__INDEX, 0x00
.set ADC_DelSig_theACLK__PM_ACT_CFG, CYREG_PM_ACT_CFG1
.set ADC_DelSig_theACLK__PM_ACT_MSK, 0x01
.set ADC_DelSig_theACLK__PM_STBY_CFG, CYREG_PM_STBY_CFG1
.set ADC_DelSig_theACLK__PM_STBY_MSK, 0x01

/* Pin_Ground */
.set Pin_Ground__0__INTTYPE, CYREG_PICU2_INTTYPE7
.set Pin_Ground__0__MASK, 0x80
.set Pin_Ground__0__PC, CYREG_PRT2_PC7
.set Pin_Ground__0__PORT, 2
.set Pin_Ground__0__SHIFT, 7
.set Pin_Ground__AG, CYREG_PRT2_AG
.set Pin_Ground__AMUX, CYREG_PRT2_AMUX
.set Pin_Ground__BIE, CYREG_PRT2_BIE
.set Pin_Ground__BIT_MASK, CYREG_PRT2_BIT_MASK
.set Pin_Ground__BYP, CYREG_PRT2_BYP
.set Pin_Ground__CTL, CYREG_PRT2_CTL
.set Pin_Ground__DM0, CYREG_PRT2_DM0
.set Pin_Ground__DM1, CYREG_PRT2_DM1
.set Pin_Ground__DM2, CYREG_PRT2_DM2
.set Pin_Ground__DR, CYREG_PRT2_DR
.set Pin_Ground__INP_DIS, CYREG_PRT2_INP_DIS
.set Pin_Ground__INTTYPE_BASE, CYDEV_PICU_INTTYPE_PICU2_BASE
.set Pin_Ground__LCD_COM_SEG, CYREG_PRT2_LCD_COM_SEG
.set Pin_Ground__LCD_EN, CYREG_PRT2_LCD_EN
.set Pin_Ground__MASK, 0x80
.set Pin_Ground__PORT, 2
.set Pin_Ground__PRT, CYREG_PRT2_PRT
.set Pin_Ground__PRTDSI__CAPS_SEL, CYREG_PRT2_CAPS_SEL
.set Pin_Ground__PRTDSI__DBL_SYNC_IN, CYREG_PRT2_DBL_SYNC_IN
.set Pin_Ground__PRTDSI__OE_SEL0, CYREG_PRT2_OE_SEL0
.set Pin_Ground__PRTDSI__OE_SEL1, CYREG_PRT2_OE_SEL1
.set Pin_Ground__PRTDSI__OUT_SEL0, CYREG_PRT2_OUT_SEL0
.set Pin_Ground__PRTDSI__OUT_SEL1, CYREG_PRT2_OUT_SEL1
.set Pin_Ground__PRTDSI__SYNC_OUT, CYREG_PRT2_SYNC_OUT
.set Pin_Ground__PS, CYREG_PRT2_PS
.set Pin_Ground__SHIFT, 7
.set Pin_Ground__SLW, CYREG_PRT2_SLW

/* Current_Source */
.set Current_Source__0__INTTYPE, CYREG_PICU0_INTTYPE7
.set Current_Source__0__MASK, 0x80
.set Current_Source__0__PC, CYREG_PRT0_PC7
.set Current_Source__0__PORT, 0
.set Current_Source__0__SHIFT, 7
.set Current_Source__AG, CYREG_PRT0_AG
.set Current_Source__AMUX, CYREG_PRT0_AMUX
.set Current_Source__BIE, CYREG_PRT0_BIE
.set Current_Source__BIT_MASK, CYREG_PRT0_BIT_MASK
.set Current_Source__BYP, CYREG_PRT0_BYP
.set Current_Source__CTL, CYREG_PRT0_CTL
.set Current_Source__DM0, CYREG_PRT0_DM0
.set Current_Source__DM1, CYREG_PRT0_DM1
.set Current_Source__DM2, CYREG_PRT0_DM2
.set Current_Source__DR, CYREG_PRT0_DR
.set Current_Source__INP_DIS, CYREG_PRT0_INP_DIS
.set Current_Source__INTTYPE_BASE, CYDEV_PICU_INTTYPE_PICU0_BASE
.set Current_Source__LCD_COM_SEG, CYREG_PRT0_LCD_COM_SEG
.set Current_Source__LCD_EN, CYREG_PRT0_LCD_EN
.set Current_Source__MASK, 0x80
.set Current_Source__PORT, 0
.set Current_Source__PRT, CYREG_PRT0_PRT
.set Current_Source__PRTDSI__CAPS_SEL, CYREG_PRT0_CAPS_SEL
.set Current_Source__PRTDSI__DBL_SYNC_IN, CYREG_PRT0_DBL_SYNC_IN
.set Current_Source__PRTDSI__OE_SEL0, CYREG_PRT0_OE_SEL0
.set Current_Source__PRTDSI__OE_SEL1, CYREG_PRT0_OE_SEL1
.set Current_Source__PRTDSI__OUT_SEL0, CYREG_PRT0_OUT_SEL0
.set Current_Source__PRTDSI__OUT_SEL1, CYREG_PRT0_OUT_SEL1
.set Current_Source__PRTDSI__SYNC_OUT, CYREG_PRT0_SYNC_OUT
.set Current_Source__PS, CYREG_PRT0_PS
.set Current_Source__SHIFT, 7
.set Current_Source__SLW, CYREG_PRT0_SLW

/* Miscellaneous */
.set BCLK__BUS_CLK__HZ, 24000000
.set BCLK__BUS_CLK__KHZ, 24000
.set BCLK__BUS_CLK__MHZ, 24
.set CYDEV_CHIP_DIE_LEOPARD, 1
.set CYDEV_CHIP_DIE_PANTHER, 18
.set CYDEV_CHIP_DIE_PSOC4A, 10
.set CYDEV_CHIP_DIE_PSOC5LP, 17
.set CYDEV_CHIP_DIE_TMA4, 2
.set CYDEV_CHIP_DIE_UNKNOWN, 0
.set CYDEV_CHIP_FAMILY_PSOC3, 1
.set CYDEV_CHIP_FAMILY_PSOC4, 2
.set CYDEV_CHIP_FAMILY_PSOC5, 3
.set CYDEV_CHIP_FAMILY_UNKNOWN, 0
.set CYDEV_CHIP_FAMILY_USED, CYDEV_CHIP_FAMILY_PSOC5
.set CYDEV_CHIP_JTAG_ID, 0x2E161069
.set CYDEV_CHIP_MEMBER_3A, 1
.set CYDEV_CHIP_MEMBER_4A, 10
.set CYDEV_CHIP_MEMBER_4C, 15
.set CYDEV_CHIP_MEMBER_4D, 6
.set CYDEV_CHIP_MEMBER_4E, 4
.set CYDEV_CHIP_MEMBER_4F, 11
.set CYDEV_CHIP_MEMBER_4G, 2
.set CYDEV_CHIP_MEMBER_4H, 9
.set CYDEV_CHIP_MEMBER_4I, 14
.set CYDEV_CHIP_MEMBER_4J, 7
.set CYDEV_CHIP_MEMBER_4K, 8
.set CYDEV_CHIP_MEMBER_4L, 13
.set CYDEV_CHIP_MEMBER_4M, 12
.set CYDEV_CHIP_MEMBER_4N, 5
.set CYDEV_CHIP_MEMBER_4U, 3
.set CYDEV_CHIP_MEMBER_5A, 17
.set CYDEV_CHIP_MEMBER_5B, 16
.set CYDEV_CHIP_MEMBER_UNKNOWN, 0
.set CYDEV_CHIP_MEMBER_USED, CYDEV_CHIP_MEMBER_5B
.set CYDEV_CHIP_DIE_EXPECT, CYDEV_CHIP_MEMBER_USED
.set CYDEV_CHIP_DIE_ACTUAL, CYDEV_CHIP_DIE_EXPECT
.set CYDEV_CHIP_REV_LEOPARD_ES1, 0
.set CYDEV_CHIP_REV_LEOPARD_ES2, 1
.set CYDEV_CHIP_REV_LEOPARD_ES3, 3
.set CYDEV_CHIP_REV_LEOPARD_PRODUCTION, 3
.set CYDEV_CHIP_REV_PANTHER_ES0, 0
.set CYDEV_CHIP_REV_PANTHER_ES1, 1
.set CYDEV_CHIP_REV_PANTHER_PRODUCTION, 1
.set CYDEV_CHIP_REV_PSOC4A_ES0, 17
.set CYDEV_CHIP_REV_PSOC4A_PRODUCTION, 17
.set CYDEV_CHIP_REV_PSOC5LP_ES0, 0
.set CYDEV_CHIP_REV_PSOC5LP_PRODUCTION, 0
.set CYDEV_CHIP_REV_TMA4_ES, 17
.set CYDEV_CHIP_REV_TMA4_ES2, 33
.set CYDEV_CHIP_REV_TMA4_PRODUCTION, 17
.set CYDEV_CHIP_REVISION_3A_ES1, 0
.set CYDEV_CHIP_REVISION_3A_ES2, 1
.set CYDEV_CHIP_REVISION_3A_ES3, 3
.set CYDEV_CHIP_REVISION_3A_PRODUCTION, 3
.set CYDEV_CHIP_REVISION_4A_ES0, 17
.set CYDEV_CHIP_REVISION_4A_PRODUCTION, 17
.set CYDEV_CHIP_REVISION_4C_PRODUCTION, 0
.set CYDEV_CHIP_REVISION_4D_PRODUCTION, 0
.set CYDEV_CHIP_REVISION_4E_PRODUCTION, 0
.set CYDEV_CHIP_REVISION_4F_PRODUCTION, 0
.set CYDEV_CHIP_REVISION_4F_PRODUCTION_256DMA, 0
.set CYDEV_CHIP_REVISION_4F_PRODUCTION_256K, 0
.set CYDEV_CHIP_REVISION_4G_ES, 17
.set CYDEV_CHIP_REVISION_4G_ES2, 33
.set CYDEV_CHIP_REVISION_4G_PRODUCTION, 17
.set CYDEV_CHIP_REVISION_4H_PRODUCTION, 0
.set CYDEV_CHIP_REVISION_4I_PRODUCTION, 0
.set CYDEV_CHIP_REVISION_4J_PRODUCTION, 0
.set CYDEV_CHIP_REVISION_4K_PRODUCTION, 0
.set CYDEV_CHIP_REVISION_4L_PRODUCTION, 0
.set CYDEV_CHIP_REVISION_4M_PRODUCTION, 0
.set CYDEV_CHIP_REVISION_4N_PRODUCTION, 0
.set CYDEV_CHIP_REVISION_4U_PRODUCTION, 0
.set CYDEV_CHIP_REVISION_5A_ES0, 0
.set CYDEV_CHIP_REVISION_5A_ES1, 1
.set CYDEV_CHIP_REVISION_5A_PRODUCTION, 1
.set CYDEV_CHIP_REVISION_5B_ES0, 0
.set CYDEV_CHIP_REVISION_5B_PRODUCTION, 0
.set CYDEV_CHIP_REVISION_USED, CYDEV_CHIP_REVISION_5B_PRODUCTION
.set CYDEV_CHIP_REV_EXPECT, CYDEV_CHIP_REVISION_USED
.set CYDEV_CONFIG_FASTBOOT_ENABLED, 0
.set CYDEV_CONFIG_UNUSED_IO_AllowButWarn, 0
.set CYDEV_CONFIG_UNUSED_IO, CYDEV_CONFIG_UNUSED_IO_AllowButWarn
.set CYDEV_CONFIG_UNUSED_IO_AllowWithInfo, 1
.set CYDEV_CONFIG_UNUSED_IO_Disallowed, 2
.set CYDEV_CONFIGURATION_COMPRESSED, 0
.set CYDEV_CONFIGURATION_DMA, 1
.set CYDEV_CONFIGURATION_ECC, 1
.set CYDEV_CONFIGURATION_IMOENABLED, CYDEV_CONFIG_FASTBOOT_ENABLED
.set CYDEV_CONFIGURATION_MODE_COMPRESSED, 0
.set CYDEV_CONFIGURATION_MODE_DMA, 2
.set CYDEV_CONFIGURATION_MODE, CYDEV_CONFIGURATION_MODE_DMA
.set CYDEV_CONFIGURATION_MODE_UNCOMPRESSED, 1
.set CYDEV_DEBUG_ENABLE_MASK, 0x20
.set CYDEV_DEBUG_ENABLE_REGISTER, CYREG_MLOGIC_DEBUG
.set CYDEV_DEBUGGING_DPS_Disable, 3
.set CYDEV_DEBUGGING_DPS_JTAG_4, 1
.set CYDEV_DEBUGGING_DPS_JTAG_5, 0
.set CYDEV_DEBUGGING_DPS_SWD, 2
.set CYDEV_DEBUGGING_DPS_SWD_SWV, 6
.set CYDEV_DEBUGGING_DPS, CYDEV_DEBUGGING_DPS_SWD_SWV
.set CYDEV_DEBUGGING_ENABLE, 1
.set CYDEV_DEBUGGING_XRES, 0
.set CYDEV_DMA_CHANNELS_AVAILABLE, 24
.set CYDEV_ECC_ENABLE, 0
.set CYDEV_HEAP_SIZE, 0x80
.set CYDEV_INSTRUCT_CACHE_ENABLED, 1
.set CYDEV_INTR_RISING, 0x00008000
.set CYDEV_IS_EXPORTING_CODE, 0
.set CYDEV_IS_IMPORTING_CODE, 0
.set CYDEV_PROJ_TYPE, 0
.set CYDEV_PROJ_TYPE_BOOTLOADER, 1
.set CYDEV_PROJ_TYPE_LAUNCHER, 5
.set CYDEV_PROJ_TYPE_LOADABLE, 2
.set CYDEV_PROJ_TYPE_LOADABLEANDBOOTLOADER, 4
.set CYDEV_PROJ_TYPE_MULTIAPPBOOTLOADER, 3
.set CYDEV_PROJ_TYPE_STANDARD, 0
.set CYDEV_PROTECTION_ENABLE, 0
.set CYDEV_STACK_SIZE, 0x0800
.set CYDEV_USE_BUNDLED_CMSIS, 1
.set CYDEV_VARIABLE_VDDA, 0
.set CYDEV_VDDA_MV, 5000
.set CYDEV_VDDD_MV, 5000
.set CYDEV_VDDIO0_MV, 5000
.set CYDEV_VDDIO1_MV, 5000
.set CYDEV_VDDIO2_MV, 5000
.set CYDEV_VDDIO3_MV, 5000
.set CYDEV_VIO0_MV, 5000
.set CYDEV_VIO1_MV, 5000
.set CYDEV_VIO2_MV, 5000
.set CYDEV_VIO3_MV, 5000
.set CYIPBLOCK_ARM_CM3_VERSION, 0
.set CYIPBLOCK_P3_ANAIF_VERSION, 0
.set CYIPBLOCK_P3_CAN_VERSION, 0
.set CYIPBLOCK_P3_CAPSENSE_VERSION, 0
.set CYIPBLOCK_P3_COMP_VERSION, 0
.set CYIPBLOCK_P3_DECIMATOR_VERSION, 0
.set CYIPBLOCK_P3_DFB_VERSION, 0
.set CYIPBLOCK_P3_DMA_VERSION, 0
.set CYIPBLOCK_P3_DRQ_VERSION, 0
.set CYIPBLOCK_P3_DSM_VERSION, 0
.set CYIPBLOCK_P3_EMIF_VERSION, 0
.set CYIPBLOCK_P3_I2C_VERSION, 0
.set CYIPBLOCK_P3_LCD_VERSION, 0
.set CYIPBLOCK_P3_LPF_VERSION, 0
.set CYIPBLOCK_P3_OPAMP_VERSION, 0
.set CYIPBLOCK_P3_PM_VERSION, 0
.set CYIPBLOCK_P3_SCCT_VERSION, 0
.set CYIPBLOCK_P3_TIMER_VERSION, 0
.set CYIPBLOCK_P3_USB_VERSION, 0
.set CYIPBLOCK_P3_VIDAC_VERSION, 0
.set CYIPBLOCK_P3_VREF_VERSION, 0
.set CYIPBLOCK_S8_GPIO_VERSION, 0
.set CYIPBLOCK_S8_IRQ_VERSION, 0
.set CYIPBLOCK_S8_SAR_VERSION, 0
.set CYIPBLOCK_S8_SIO_VERSION, 0
.set CYIPBLOCK_S8_UDB_VERSION, 0
.set DMA_CHANNELS_USED__MASK0, 0x00000000
.set CYDEV_BOOTLOADER_ENABLE, 0
.endif
