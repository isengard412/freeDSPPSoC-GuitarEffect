.ifndef INCLUDED_CYFITTERGNU_INC
.set INCLUDED_CYFITTERGNU_INC, 1
.include "cydevicegnu.inc"
.include "cydevicegnu_trm.inc"

/* LCD_LCDPort */
.set LCD_LCDPort__0__INTTYPE, CYREG_PICU2_INTTYPE0
.set LCD_LCDPort__0__MASK, 0x01
.set LCD_LCDPort__0__PC, CYREG_PRT2_PC0
.set LCD_LCDPort__0__PORT, 2
.set LCD_LCDPort__0__SHIFT, 0
.set LCD_LCDPort__1__INTTYPE, CYREG_PICU2_INTTYPE1
.set LCD_LCDPort__1__MASK, 0x02
.set LCD_LCDPort__1__PC, CYREG_PRT2_PC1
.set LCD_LCDPort__1__PORT, 2
.set LCD_LCDPort__1__SHIFT, 1
.set LCD_LCDPort__2__INTTYPE, CYREG_PICU2_INTTYPE2
.set LCD_LCDPort__2__MASK, 0x04
.set LCD_LCDPort__2__PC, CYREG_PRT2_PC2
.set LCD_LCDPort__2__PORT, 2
.set LCD_LCDPort__2__SHIFT, 2
.set LCD_LCDPort__3__INTTYPE, CYREG_PICU2_INTTYPE3
.set LCD_LCDPort__3__MASK, 0x08
.set LCD_LCDPort__3__PC, CYREG_PRT2_PC3
.set LCD_LCDPort__3__PORT, 2
.set LCD_LCDPort__3__SHIFT, 3
.set LCD_LCDPort__4__INTTYPE, CYREG_PICU2_INTTYPE4
.set LCD_LCDPort__4__MASK, 0x10
.set LCD_LCDPort__4__PC, CYREG_PRT2_PC4
.set LCD_LCDPort__4__PORT, 2
.set LCD_LCDPort__4__SHIFT, 4
.set LCD_LCDPort__5__INTTYPE, CYREG_PICU2_INTTYPE5
.set LCD_LCDPort__5__MASK, 0x20
.set LCD_LCDPort__5__PC, CYREG_PRT2_PC5
.set LCD_LCDPort__5__PORT, 2
.set LCD_LCDPort__5__SHIFT, 5
.set LCD_LCDPort__6__INTTYPE, CYREG_PICU2_INTTYPE6
.set LCD_LCDPort__6__MASK, 0x40
.set LCD_LCDPort__6__PC, CYREG_PRT2_PC6
.set LCD_LCDPort__6__PORT, 2
.set LCD_LCDPort__6__SHIFT, 6
.set LCD_LCDPort__AG, CYREG_PRT2_AG
.set LCD_LCDPort__AMUX, CYREG_PRT2_AMUX
.set LCD_LCDPort__BIE, CYREG_PRT2_BIE
.set LCD_LCDPort__BIT_MASK, CYREG_PRT2_BIT_MASK
.set LCD_LCDPort__BYP, CYREG_PRT2_BYP
.set LCD_LCDPort__CTL, CYREG_PRT2_CTL
.set LCD_LCDPort__DM0, CYREG_PRT2_DM0
.set LCD_LCDPort__DM1, CYREG_PRT2_DM1
.set LCD_LCDPort__DM2, CYREG_PRT2_DM2
.set LCD_LCDPort__DR, CYREG_PRT2_DR
.set LCD_LCDPort__INP_DIS, CYREG_PRT2_INP_DIS
.set LCD_LCDPort__INTTYPE_BASE, CYDEV_PICU_INTTYPE_PICU2_BASE
.set LCD_LCDPort__LCD_COM_SEG, CYREG_PRT2_LCD_COM_SEG
.set LCD_LCDPort__LCD_EN, CYREG_PRT2_LCD_EN
.set LCD_LCDPort__MASK, 0x7F
.set LCD_LCDPort__PORT, 2
.set LCD_LCDPort__PRT, CYREG_PRT2_PRT
.set LCD_LCDPort__PRTDSI__CAPS_SEL, CYREG_PRT2_CAPS_SEL
.set LCD_LCDPort__PRTDSI__DBL_SYNC_IN, CYREG_PRT2_DBL_SYNC_IN
.set LCD_LCDPort__PRTDSI__OE_SEL0, CYREG_PRT2_OE_SEL0
.set LCD_LCDPort__PRTDSI__OE_SEL1, CYREG_PRT2_OE_SEL1
.set LCD_LCDPort__PRTDSI__OUT_SEL0, CYREG_PRT2_OUT_SEL0
.set LCD_LCDPort__PRTDSI__OUT_SEL1, CYREG_PRT2_OUT_SEL1
.set LCD_LCDPort__PRTDSI__SYNC_OUT, CYREG_PRT2_SYNC_OUT
.set LCD_LCDPort__PS, CYREG_PRT2_PS
.set LCD_LCDPort__SHIFT, 0
.set LCD_LCDPort__SLW, CYREG_PRT2_SLW

/* LED1 */
.set LED1__0__INTTYPE, CYREG_PICU1_INTTYPE6
.set LED1__0__MASK, 0x40
.set LED1__0__PC, CYREG_PRT1_PC6
.set LED1__0__PORT, 1
.set LED1__0__SHIFT, 6
.set LED1__AG, CYREG_PRT1_AG
.set LED1__AMUX, CYREG_PRT1_AMUX
.set LED1__BIE, CYREG_PRT1_BIE
.set LED1__BIT_MASK, CYREG_PRT1_BIT_MASK
.set LED1__BYP, CYREG_PRT1_BYP
.set LED1__CTL, CYREG_PRT1_CTL
.set LED1__DM0, CYREG_PRT1_DM0
.set LED1__DM1, CYREG_PRT1_DM1
.set LED1__DM2, CYREG_PRT1_DM2
.set LED1__DR, CYREG_PRT1_DR
.set LED1__INP_DIS, CYREG_PRT1_INP_DIS
.set LED1__INTTYPE_BASE, CYDEV_PICU_INTTYPE_PICU1_BASE
.set LED1__LCD_COM_SEG, CYREG_PRT1_LCD_COM_SEG
.set LED1__LCD_EN, CYREG_PRT1_LCD_EN
.set LED1__MASK, 0x40
.set LED1__PORT, 1
.set LED1__PRT, CYREG_PRT1_PRT
.set LED1__PRTDSI__CAPS_SEL, CYREG_PRT1_CAPS_SEL
.set LED1__PRTDSI__DBL_SYNC_IN, CYREG_PRT1_DBL_SYNC_IN
.set LED1__PRTDSI__OE_SEL0, CYREG_PRT1_OE_SEL0
.set LED1__PRTDSI__OE_SEL1, CYREG_PRT1_OE_SEL1
.set LED1__PRTDSI__OUT_SEL0, CYREG_PRT1_OUT_SEL0
.set LED1__PRTDSI__OUT_SEL1, CYREG_PRT1_OUT_SEL1
.set LED1__PRTDSI__SYNC_OUT, CYREG_PRT1_SYNC_OUT
.set LED1__PS, CYREG_PRT1_PS
.set LED1__SHIFT, 6
.set LED1__SLW, CYREG_PRT1_SLW

/* LED2 */
.set LED2__0__INTTYPE, CYREG_PICU1_INTTYPE7
.set LED2__0__MASK, 0x80
.set LED2__0__PC, CYREG_PRT1_PC7
.set LED2__0__PORT, 1
.set LED2__0__SHIFT, 7
.set LED2__AG, CYREG_PRT1_AG
.set LED2__AMUX, CYREG_PRT1_AMUX
.set LED2__BIE, CYREG_PRT1_BIE
.set LED2__BIT_MASK, CYREG_PRT1_BIT_MASK
.set LED2__BYP, CYREG_PRT1_BYP
.set LED2__CTL, CYREG_PRT1_CTL
.set LED2__DM0, CYREG_PRT1_DM0
.set LED2__DM1, CYREG_PRT1_DM1
.set LED2__DM2, CYREG_PRT1_DM2
.set LED2__DR, CYREG_PRT1_DR
.set LED2__INP_DIS, CYREG_PRT1_INP_DIS
.set LED2__INTTYPE_BASE, CYDEV_PICU_INTTYPE_PICU1_BASE
.set LED2__LCD_COM_SEG, CYREG_PRT1_LCD_COM_SEG
.set LED2__LCD_EN, CYREG_PRT1_LCD_EN
.set LED2__MASK, 0x80
.set LED2__PORT, 1
.set LED2__PRT, CYREG_PRT1_PRT
.set LED2__PRTDSI__CAPS_SEL, CYREG_PRT1_CAPS_SEL
.set LED2__PRTDSI__DBL_SYNC_IN, CYREG_PRT1_DBL_SYNC_IN
.set LED2__PRTDSI__OE_SEL0, CYREG_PRT1_OE_SEL0
.set LED2__PRTDSI__OE_SEL1, CYREG_PRT1_OE_SEL1
.set LED2__PRTDSI__OUT_SEL0, CYREG_PRT1_OUT_SEL0
.set LED2__PRTDSI__OUT_SEL1, CYREG_PRT1_OUT_SEL1
.set LED2__PRTDSI__SYNC_OUT, CYREG_PRT1_SYNC_OUT
.set LED2__PS, CYREG_PRT1_PS
.set LED2__SHIFT, 7
.set LED2__SLW, CYREG_PRT1_SLW

/* Pins */
.set Pins__0__INTTYPE, CYREG_PICU12_INTTYPE0
.set Pins__0__MASK, 0x01
.set Pins__0__PC, CYREG_PRT12_PC0
.set Pins__0__PORT, 12
.set Pins__0__SHIFT, 0
.set Pins__1__INTTYPE, CYREG_PICU12_INTTYPE1
.set Pins__1__MASK, 0x02
.set Pins__1__PC, CYREG_PRT12_PC1
.set Pins__1__PORT, 12
.set Pins__1__SHIFT, 1
.set Pins__AG, CYREG_PRT12_AG
.set Pins__BIE, CYREG_PRT12_BIE
.set Pins__BIT_MASK, CYREG_PRT12_BIT_MASK
.set Pins__BYP, CYREG_PRT12_BYP
.set Pins__DM0, CYREG_PRT12_DM0
.set Pins__DM1, CYREG_PRT12_DM1
.set Pins__DM2, CYREG_PRT12_DM2
.set Pins__DR, CYREG_PRT12_DR
.set Pins__INP_DIS, CYREG_PRT12_INP_DIS
.set Pins__INTTYPE_BASE, CYDEV_PICU_INTTYPE_PICU12_BASE
.set Pins__MASK, 0x03
.set Pins__PORT, 12
.set Pins__PRT, CYREG_PRT12_PRT
.set Pins__PRTDSI__DBL_SYNC_IN, CYREG_PRT12_DBL_SYNC_IN
.set Pins__PRTDSI__OE_SEL0, CYREG_PRT12_OE_SEL0
.set Pins__PRTDSI__OE_SEL1, CYREG_PRT12_OE_SEL1
.set Pins__PRTDSI__OUT_SEL0, CYREG_PRT12_OUT_SEL0
.set Pins__PRTDSI__OUT_SEL1, CYREG_PRT12_OUT_SEL1
.set Pins__PRTDSI__SYNC_OUT, CYREG_PRT12_SYNC_OUT
.set Pins__PS, CYREG_PRT12_PS
.set Pins__scl__INTTYPE, CYREG_PICU12_INTTYPE0
.set Pins__scl__MASK, 0x01
.set Pins__scl__PC, CYREG_PRT12_PC0
.set Pins__scl__PORT, 12
.set Pins__scl__SHIFT, 0
.set Pins__sda__INTTYPE, CYREG_PICU12_INTTYPE1
.set Pins__sda__MASK, 0x02
.set Pins__sda__PC, CYREG_PRT12_PC1
.set Pins__sda__PORT, 12
.set Pins__sda__SHIFT, 1
.set Pins__SHIFT, 0
.set Pins__SIO_CFG, CYREG_PRT12_SIO_CFG
.set Pins__SIO_DIFF, CYREG_PRT12_SIO_DIFF
.set Pins__SIO_HYST_EN, CYREG_PRT12_SIO_HYST_EN
.set Pins__SIO_REG_HIFREQ, CYREG_PRT12_SIO_REG_HIFREQ
.set Pins__SLW, CYREG_PRT12_SLW

/* EZI2C_I2C_Prim */
.set EZI2C_I2C_Prim__ADR, CYREG_I2C_ADR
.set EZI2C_I2C_Prim__CFG, CYREG_I2C_CFG
.set EZI2C_I2C_Prim__CLK_DIV1, CYREG_I2C_CLK_DIV1
.set EZI2C_I2C_Prim__CLK_DIV2, CYREG_I2C_CLK_DIV2
.set EZI2C_I2C_Prim__CSR, CYREG_I2C_CSR
.set EZI2C_I2C_Prim__D, CYREG_I2C_D
.set EZI2C_I2C_Prim__MCSR, CYREG_I2C_MCSR
.set EZI2C_I2C_Prim__PM_ACT_CFG, CYREG_PM_ACT_CFG5
.set EZI2C_I2C_Prim__PM_ACT_MSK, 0x04
.set EZI2C_I2C_Prim__PM_STBY_CFG, CYREG_PM_STBY_CFG5
.set EZI2C_I2C_Prim__PM_STBY_MSK, 0x04
.set EZI2C_I2C_Prim__TMOUT_CFG0, CYREG_I2C_TMOUT_CFG0
.set EZI2C_I2C_Prim__TMOUT_CFG1, CYREG_I2C_TMOUT_CFG1
.set EZI2C_I2C_Prim__TMOUT_CSR, CYREG_I2C_TMOUT_CSR
.set EZI2C_I2C_Prim__TMOUT_SR, CYREG_I2C_TMOUT_SR
.set EZI2C_I2C_Prim__XCFG, CYREG_I2C_XCFG

/* EZI2C_isr */
.set EZI2C_isr__INTC_CLR_EN_REG, CYREG_NVIC_CLRENA0
.set EZI2C_isr__INTC_CLR_PD_REG, CYREG_NVIC_CLRPEND0
.set EZI2C_isr__INTC_MASK, 0x8000
.set EZI2C_isr__INTC_NUMBER, 15
.set EZI2C_isr__INTC_PRIOR_NUM, 7
.set EZI2C_isr__INTC_PRIOR_REG, CYREG_NVIC_PRI_15
.set EZI2C_isr__INTC_SET_EN_REG, CYREG_NVIC_SETENA0
.set EZI2C_isr__INTC_SET_PD_REG, CYREG_NVIC_SETPEND0

/* CapSense_CSD_BufCH0 */
.set CapSense_CSD_BufCH0__CFG0, CYREG_CAPSL_CFG0
.set CapSense_CSD_BufCH0__CFG1, CYREG_CAPSL_CFG1
.set CapSense_CSD_BufCH0__PM_ACT_CFG, CYREG_PM_ACT_CFG11
.set CapSense_CSD_BufCH0__PM_ACT_MSK, 0x10
.set CapSense_CSD_BufCH0__PM_STBY_CFG, CYREG_PM_STBY_CFG11
.set CapSense_CSD_BufCH0__PM_STBY_MSK, 0x10

/* CapSense_CSD_ClockGen */
.set CapSense_CSD_ClockGen_sC16_PRSdp_u0__16BIT_A0_REG, CYREG_B0_UDB08_09_A0
.set CapSense_CSD_ClockGen_sC16_PRSdp_u0__16BIT_A1_REG, CYREG_B0_UDB08_09_A1
.set CapSense_CSD_ClockGen_sC16_PRSdp_u0__16BIT_D0_REG, CYREG_B0_UDB08_09_D0
.set CapSense_CSD_ClockGen_sC16_PRSdp_u0__16BIT_D1_REG, CYREG_B0_UDB08_09_D1
.set CapSense_CSD_ClockGen_sC16_PRSdp_u0__16BIT_DP_AUX_CTL_REG, CYREG_B0_UDB08_09_ACTL
.set CapSense_CSD_ClockGen_sC16_PRSdp_u0__16BIT_F0_REG, CYREG_B0_UDB08_09_F0
.set CapSense_CSD_ClockGen_sC16_PRSdp_u0__16BIT_F1_REG, CYREG_B0_UDB08_09_F1
.set CapSense_CSD_ClockGen_sC16_PRSdp_u0__A0_A1_REG, CYREG_B0_UDB08_A0_A1
.set CapSense_CSD_ClockGen_sC16_PRSdp_u0__A0_REG, CYREG_B0_UDB08_A0
.set CapSense_CSD_ClockGen_sC16_PRSdp_u0__A1_REG, CYREG_B0_UDB08_A1
.set CapSense_CSD_ClockGen_sC16_PRSdp_u0__D0_D1_REG, CYREG_B0_UDB08_D0_D1
.set CapSense_CSD_ClockGen_sC16_PRSdp_u0__D0_REG, CYREG_B0_UDB08_D0
.set CapSense_CSD_ClockGen_sC16_PRSdp_u0__D1_REG, CYREG_B0_UDB08_D1
.set CapSense_CSD_ClockGen_sC16_PRSdp_u0__DP_AUX_CTL_REG, CYREG_B0_UDB08_ACTL
.set CapSense_CSD_ClockGen_sC16_PRSdp_u0__F0_F1_REG, CYREG_B0_UDB08_F0_F1
.set CapSense_CSD_ClockGen_sC16_PRSdp_u0__F0_REG, CYREG_B0_UDB08_F0
.set CapSense_CSD_ClockGen_sC16_PRSdp_u0__F1_REG, CYREG_B0_UDB08_F1
.set CapSense_CSD_ClockGen_sC16_PRSdp_u1__16BIT_A0_REG, CYREG_B0_UDB09_10_A0
.set CapSense_CSD_ClockGen_sC16_PRSdp_u1__16BIT_A1_REG, CYREG_B0_UDB09_10_A1
.set CapSense_CSD_ClockGen_sC16_PRSdp_u1__16BIT_D0_REG, CYREG_B0_UDB09_10_D0
.set CapSense_CSD_ClockGen_sC16_PRSdp_u1__16BIT_D1_REG, CYREG_B0_UDB09_10_D1
.set CapSense_CSD_ClockGen_sC16_PRSdp_u1__16BIT_DP_AUX_CTL_REG, CYREG_B0_UDB09_10_ACTL
.set CapSense_CSD_ClockGen_sC16_PRSdp_u1__16BIT_F0_REG, CYREG_B0_UDB09_10_F0
.set CapSense_CSD_ClockGen_sC16_PRSdp_u1__16BIT_F1_REG, CYREG_B0_UDB09_10_F1
.set CapSense_CSD_ClockGen_sC16_PRSdp_u1__A0_A1_REG, CYREG_B0_UDB09_A0_A1
.set CapSense_CSD_ClockGen_sC16_PRSdp_u1__A0_REG, CYREG_B0_UDB09_A0
.set CapSense_CSD_ClockGen_sC16_PRSdp_u1__A1_REG, CYREG_B0_UDB09_A1
.set CapSense_CSD_ClockGen_sC16_PRSdp_u1__D0_D1_REG, CYREG_B0_UDB09_D0_D1
.set CapSense_CSD_ClockGen_sC16_PRSdp_u1__D0_REG, CYREG_B0_UDB09_D0
.set CapSense_CSD_ClockGen_sC16_PRSdp_u1__D1_REG, CYREG_B0_UDB09_D1
.set CapSense_CSD_ClockGen_sC16_PRSdp_u1__DP_AUX_CTL_REG, CYREG_B0_UDB09_ACTL
.set CapSense_CSD_ClockGen_sC16_PRSdp_u1__F0_F1_REG, CYREG_B0_UDB09_F0_F1
.set CapSense_CSD_ClockGen_sC16_PRSdp_u1__F0_REG, CYREG_B0_UDB09_F0
.set CapSense_CSD_ClockGen_sC16_PRSdp_u1__F1_REG, CYREG_B0_UDB09_F1
.set CapSense_CSD_ClockGen_sC16_PRSdp_u1__MSK_DP_AUX_CTL_REG, CYREG_B0_UDB09_MSK_ACTL
.set CapSense_CSD_ClockGen_sC16_PRSdp_u1__PER_DP_AUX_CTL_REG, CYREG_B0_UDB09_MSK_ACTL
.set CapSense_CSD_ClockGen_ScanSpeed__16BIT_CONTROL_AUX_CTL_REG, CYREG_B0_UDB10_11_ACTL
.set CapSense_CSD_ClockGen_ScanSpeed__16BIT_CONTROL_CONTROL_REG, CYREG_B0_UDB10_11_CTL
.set CapSense_CSD_ClockGen_ScanSpeed__16BIT_CONTROL_COUNT_REG, CYREG_B0_UDB10_11_CTL
.set CapSense_CSD_ClockGen_ScanSpeed__16BIT_COUNT_CONTROL_REG, CYREG_B0_UDB10_11_CTL
.set CapSense_CSD_ClockGen_ScanSpeed__16BIT_COUNT_COUNT_REG, CYREG_B0_UDB10_11_CTL
.set CapSense_CSD_ClockGen_ScanSpeed__16BIT_MASK_MASK_REG, CYREG_B0_UDB10_11_MSK
.set CapSense_CSD_ClockGen_ScanSpeed__16BIT_MASK_PERIOD_REG, CYREG_B0_UDB10_11_MSK
.set CapSense_CSD_ClockGen_ScanSpeed__16BIT_PERIOD_MASK_REG, CYREG_B0_UDB10_11_MSK
.set CapSense_CSD_ClockGen_ScanSpeed__16BIT_PERIOD_PERIOD_REG, CYREG_B0_UDB10_11_MSK
.set CapSense_CSD_ClockGen_ScanSpeed__CONTROL_AUX_CTL_REG, CYREG_B0_UDB10_ACTL
.set CapSense_CSD_ClockGen_ScanSpeed__CONTROL_REG, CYREG_B0_UDB10_CTL
.set CapSense_CSD_ClockGen_ScanSpeed__CONTROL_ST_REG, CYREG_B0_UDB10_ST_CTL
.set CapSense_CSD_ClockGen_ScanSpeed__COUNT_REG, CYREG_B0_UDB10_CTL
.set CapSense_CSD_ClockGen_ScanSpeed__COUNT_ST_REG, CYREG_B0_UDB10_ST_CTL
.set CapSense_CSD_ClockGen_ScanSpeed__MASK_CTL_AUX_CTL_REG, CYREG_B0_UDB10_MSK_ACTL
.set CapSense_CSD_ClockGen_ScanSpeed__PER_CTL_AUX_CTL_REG, CYREG_B0_UDB10_MSK_ACTL
.set CapSense_CSD_ClockGen_ScanSpeed__PERIOD_REG, CYREG_B0_UDB10_MSK
.set CapSense_CSD_ClockGen_SyncCtrl_CtrlReg__0__MASK, 0x01
.set CapSense_CSD_ClockGen_SyncCtrl_CtrlReg__0__POS, 0
.set CapSense_CSD_ClockGen_SyncCtrl_CtrlReg__1__MASK, 0x02
.set CapSense_CSD_ClockGen_SyncCtrl_CtrlReg__1__POS, 1
.set CapSense_CSD_ClockGen_SyncCtrl_CtrlReg__16BIT_CONTROL_AUX_CTL_REG, CYREG_B0_UDB09_10_ACTL
.set CapSense_CSD_ClockGen_SyncCtrl_CtrlReg__16BIT_CONTROL_CONTROL_REG, CYREG_B0_UDB09_10_CTL
.set CapSense_CSD_ClockGen_SyncCtrl_CtrlReg__16BIT_CONTROL_COUNT_REG, CYREG_B0_UDB09_10_CTL
.set CapSense_CSD_ClockGen_SyncCtrl_CtrlReg__16BIT_COUNT_CONTROL_REG, CYREG_B0_UDB09_10_CTL
.set CapSense_CSD_ClockGen_SyncCtrl_CtrlReg__16BIT_COUNT_COUNT_REG, CYREG_B0_UDB09_10_CTL
.set CapSense_CSD_ClockGen_SyncCtrl_CtrlReg__16BIT_MASK_MASK_REG, CYREG_B0_UDB09_10_MSK
.set CapSense_CSD_ClockGen_SyncCtrl_CtrlReg__16BIT_MASK_PERIOD_REG, CYREG_B0_UDB09_10_MSK
.set CapSense_CSD_ClockGen_SyncCtrl_CtrlReg__16BIT_PERIOD_MASK_REG, CYREG_B0_UDB09_10_MSK
.set CapSense_CSD_ClockGen_SyncCtrl_CtrlReg__16BIT_PERIOD_PERIOD_REG, CYREG_B0_UDB09_10_MSK
.set CapSense_CSD_ClockGen_SyncCtrl_CtrlReg__2__MASK, 0x04
.set CapSense_CSD_ClockGen_SyncCtrl_CtrlReg__2__POS, 2
.set CapSense_CSD_ClockGen_SyncCtrl_CtrlReg__4__MASK, 0x10
.set CapSense_CSD_ClockGen_SyncCtrl_CtrlReg__4__POS, 4
.set CapSense_CSD_ClockGen_SyncCtrl_CtrlReg__CONTROL_AUX_CTL_REG, CYREG_B0_UDB09_ACTL
.set CapSense_CSD_ClockGen_SyncCtrl_CtrlReg__CONTROL_REG, CYREG_B0_UDB09_CTL
.set CapSense_CSD_ClockGen_SyncCtrl_CtrlReg__CONTROL_ST_REG, CYREG_B0_UDB09_ST_CTL
.set CapSense_CSD_ClockGen_SyncCtrl_CtrlReg__COUNT_REG, CYREG_B0_UDB09_CTL
.set CapSense_CSD_ClockGen_SyncCtrl_CtrlReg__COUNT_ST_REG, CYREG_B0_UDB09_ST_CTL
.set CapSense_CSD_ClockGen_SyncCtrl_CtrlReg__MASK, 0x17
.set CapSense_CSD_ClockGen_SyncCtrl_CtrlReg__MASK_CTL_AUX_CTL_REG, CYREG_B0_UDB09_MSK_ACTL
.set CapSense_CSD_ClockGen_SyncCtrl_CtrlReg__PER_CTL_AUX_CTL_REG, CYREG_B0_UDB09_MSK_ACTL
.set CapSense_CSD_ClockGen_SyncCtrl_CtrlReg__PERIOD_REG, CYREG_B0_UDB09_MSK
.set CapSense_CSD_ClockGen_UDB_PrescalerDp_u0__16BIT_A0_REG, CYREG_B0_UDB11_12_A0
.set CapSense_CSD_ClockGen_UDB_PrescalerDp_u0__16BIT_A1_REG, CYREG_B0_UDB11_12_A1
.set CapSense_CSD_ClockGen_UDB_PrescalerDp_u0__16BIT_D0_REG, CYREG_B0_UDB11_12_D0
.set CapSense_CSD_ClockGen_UDB_PrescalerDp_u0__16BIT_D1_REG, CYREG_B0_UDB11_12_D1
.set CapSense_CSD_ClockGen_UDB_PrescalerDp_u0__16BIT_DP_AUX_CTL_REG, CYREG_B0_UDB11_12_ACTL
.set CapSense_CSD_ClockGen_UDB_PrescalerDp_u0__16BIT_F0_REG, CYREG_B0_UDB11_12_F0
.set CapSense_CSD_ClockGen_UDB_PrescalerDp_u0__16BIT_F1_REG, CYREG_B0_UDB11_12_F1
.set CapSense_CSD_ClockGen_UDB_PrescalerDp_u0__A0_A1_REG, CYREG_B0_UDB11_A0_A1
.set CapSense_CSD_ClockGen_UDB_PrescalerDp_u0__A0_REG, CYREG_B0_UDB11_A0
.set CapSense_CSD_ClockGen_UDB_PrescalerDp_u0__A1_REG, CYREG_B0_UDB11_A1
.set CapSense_CSD_ClockGen_UDB_PrescalerDp_u0__D0_D1_REG, CYREG_B0_UDB11_D0_D1
.set CapSense_CSD_ClockGen_UDB_PrescalerDp_u0__D0_REG, CYREG_B0_UDB11_D0
.set CapSense_CSD_ClockGen_UDB_PrescalerDp_u0__D1_REG, CYREG_B0_UDB11_D1
.set CapSense_CSD_ClockGen_UDB_PrescalerDp_u0__DP_AUX_CTL_REG, CYREG_B0_UDB11_ACTL
.set CapSense_CSD_ClockGen_UDB_PrescalerDp_u0__F0_F1_REG, CYREG_B0_UDB11_F0_F1
.set CapSense_CSD_ClockGen_UDB_PrescalerDp_u0__F0_REG, CYREG_B0_UDB11_F0
.set CapSense_CSD_ClockGen_UDB_PrescalerDp_u0__F1_REG, CYREG_B0_UDB11_F1

/* CapSense_CSD_CmodCH0 */
.set CapSense_CSD_CmodCH0__0__INTTYPE, CYREG_PICU2_INTTYPE7
.set CapSense_CSD_CmodCH0__0__MASK, 0x80
.set CapSense_CSD_CmodCH0__0__PC, CYREG_PRT2_PC7
.set CapSense_CSD_CmodCH0__0__PORT, 2
.set CapSense_CSD_CmodCH0__0__SHIFT, 7
.set CapSense_CSD_CmodCH0__AG, CYREG_PRT2_AG
.set CapSense_CSD_CmodCH0__AMUX, CYREG_PRT2_AMUX
.set CapSense_CSD_CmodCH0__BIE, CYREG_PRT2_BIE
.set CapSense_CSD_CmodCH0__BIT_MASK, CYREG_PRT2_BIT_MASK
.set CapSense_CSD_CmodCH0__BYP, CYREG_PRT2_BYP
.set CapSense_CSD_CmodCH0__Cmod_CH0__INTTYPE, CYREG_PICU2_INTTYPE7
.set CapSense_CSD_CmodCH0__Cmod_CH0__MASK, 0x80
.set CapSense_CSD_CmodCH0__Cmod_CH0__PC, CYREG_PRT2_PC7
.set CapSense_CSD_CmodCH0__Cmod_CH0__PORT, 2
.set CapSense_CSD_CmodCH0__Cmod_CH0__SHIFT, 7
.set CapSense_CSD_CmodCH0__CTL, CYREG_PRT2_CTL
.set CapSense_CSD_CmodCH0__DM0, CYREG_PRT2_DM0
.set CapSense_CSD_CmodCH0__DM1, CYREG_PRT2_DM1
.set CapSense_CSD_CmodCH0__DM2, CYREG_PRT2_DM2
.set CapSense_CSD_CmodCH0__DR, CYREG_PRT2_DR
.set CapSense_CSD_CmodCH0__INP_DIS, CYREG_PRT2_INP_DIS
.set CapSense_CSD_CmodCH0__INTTYPE_BASE, CYDEV_PICU_INTTYPE_PICU2_BASE
.set CapSense_CSD_CmodCH0__LCD_COM_SEG, CYREG_PRT2_LCD_COM_SEG
.set CapSense_CSD_CmodCH0__LCD_EN, CYREG_PRT2_LCD_EN
.set CapSense_CSD_CmodCH0__MASK, 0x80
.set CapSense_CSD_CmodCH0__PORT, 2
.set CapSense_CSD_CmodCH0__PRT, CYREG_PRT2_PRT
.set CapSense_CSD_CmodCH0__PRTDSI__CAPS_SEL, CYREG_PRT2_CAPS_SEL
.set CapSense_CSD_CmodCH0__PRTDSI__DBL_SYNC_IN, CYREG_PRT2_DBL_SYNC_IN
.set CapSense_CSD_CmodCH0__PRTDSI__OE_SEL0, CYREG_PRT2_OE_SEL0
.set CapSense_CSD_CmodCH0__PRTDSI__OE_SEL1, CYREG_PRT2_OE_SEL1
.set CapSense_CSD_CmodCH0__PRTDSI__OUT_SEL0, CYREG_PRT2_OUT_SEL0
.set CapSense_CSD_CmodCH0__PRTDSI__OUT_SEL1, CYREG_PRT2_OUT_SEL1
.set CapSense_CSD_CmodCH0__PRTDSI__SYNC_OUT, CYREG_PRT2_SYNC_OUT
.set CapSense_CSD_CmodCH0__PS, CYREG_PRT2_PS
.set CapSense_CSD_CmodCH0__SHIFT, 7
.set CapSense_CSD_CmodCH0__SLW, CYREG_PRT2_SLW

/* CapSense_CSD_CompCH0_ctComp */
.set CapSense_CSD_CompCH0_ctComp__CLK, CYREG_CMP2_CLK
.set CapSense_CSD_CompCH0_ctComp__CMP_MASK, 0x04
.set CapSense_CSD_CompCH0_ctComp__CMP_NUMBER, 2
.set CapSense_CSD_CompCH0_ctComp__CR, CYREG_CMP2_CR
.set CapSense_CSD_CompCH0_ctComp__LUT__CR, CYREG_LUT2_CR
.set CapSense_CSD_CompCH0_ctComp__LUT__MSK, CYREG_LUT_MSK
.set CapSense_CSD_CompCH0_ctComp__LUT__MSK_MASK, 0x04
.set CapSense_CSD_CompCH0_ctComp__LUT__MSK_SHIFT, 2
.set CapSense_CSD_CompCH0_ctComp__LUT__MX, CYREG_LUT2_MX
.set CapSense_CSD_CompCH0_ctComp__LUT__SR, CYREG_LUT_SR
.set CapSense_CSD_CompCH0_ctComp__LUT__SR_MASK, 0x04
.set CapSense_CSD_CompCH0_ctComp__LUT__SR_SHIFT, 2
.set CapSense_CSD_CompCH0_ctComp__PM_ACT_CFG, CYREG_PM_ACT_CFG7
.set CapSense_CSD_CompCH0_ctComp__PM_ACT_MSK, 0x04
.set CapSense_CSD_CompCH0_ctComp__PM_STBY_CFG, CYREG_PM_STBY_CFG7
.set CapSense_CSD_CompCH0_ctComp__PM_STBY_MSK, 0x04
.set CapSense_CSD_CompCH0_ctComp__SW0, CYREG_CMP2_SW0
.set CapSense_CSD_CompCH0_ctComp__SW2, CYREG_CMP2_SW2
.set CapSense_CSD_CompCH0_ctComp__SW3, CYREG_CMP2_SW3
.set CapSense_CSD_CompCH0_ctComp__SW4, CYREG_CMP2_SW4
.set CapSense_CSD_CompCH0_ctComp__SW6, CYREG_CMP2_SW6
.set CapSense_CSD_CompCH0_ctComp__TR0, CYREG_CMP2_TR0
.set CapSense_CSD_CompCH0_ctComp__TR1, CYREG_CMP2_TR1
.set CapSense_CSD_CompCH0_ctComp__TRIM__TR0, CYREG_FLSHID_MFG_CFG_CMP2_TR0
.set CapSense_CSD_CompCH0_ctComp__TRIM__TR0_HS, CYREG_FLSHID_CUST_TABLES_CMP2_TR0_HS
.set CapSense_CSD_CompCH0_ctComp__TRIM__TR1, CYREG_FLSHID_MFG_CFG_CMP2_TR1
.set CapSense_CSD_CompCH0_ctComp__TRIM__TR1_HS, CYREG_FLSHID_CUST_TABLES_CMP2_TR1_HS
.set CapSense_CSD_CompCH0_ctComp__WRK, CYREG_CMP_WRK
.set CapSense_CSD_CompCH0_ctComp__WRK_MASK, 0x04
.set CapSense_CSD_CompCH0_ctComp__WRK_SHIFT, 2

/* CapSense_CSD_IdacCH0_viDAC8 */
.set CapSense_CSD_IdacCH0_viDAC8__CR0, CYREG_DAC2_CR0
.set CapSense_CSD_IdacCH0_viDAC8__CR1, CYREG_DAC2_CR1
.set CapSense_CSD_IdacCH0_viDAC8__D, CYREG_DAC2_D
.set CapSense_CSD_IdacCH0_viDAC8__PM_ACT_CFG, CYREG_PM_ACT_CFG8
.set CapSense_CSD_IdacCH0_viDAC8__PM_ACT_MSK, 0x04
.set CapSense_CSD_IdacCH0_viDAC8__PM_STBY_CFG, CYREG_PM_STBY_CFG8
.set CapSense_CSD_IdacCH0_viDAC8__PM_STBY_MSK, 0x04
.set CapSense_CSD_IdacCH0_viDAC8__STROBE, CYREG_DAC2_STROBE
.set CapSense_CSD_IdacCH0_viDAC8__SW0, CYREG_DAC2_SW0
.set CapSense_CSD_IdacCH0_viDAC8__SW2, CYREG_DAC2_SW2
.set CapSense_CSD_IdacCH0_viDAC8__SW3, CYREG_DAC2_SW3
.set CapSense_CSD_IdacCH0_viDAC8__SW4, CYREG_DAC2_SW4
.set CapSense_CSD_IdacCH0_viDAC8__TR, CYREG_DAC2_TR
.set CapSense_CSD_IdacCH0_viDAC8__TRIM__M1, CYREG_FLSHID_CUST_TABLES_DAC2_M1
.set CapSense_CSD_IdacCH0_viDAC8__TRIM__M2, CYREG_FLSHID_CUST_TABLES_DAC2_M2
.set CapSense_CSD_IdacCH0_viDAC8__TRIM__M3, CYREG_FLSHID_CUST_TABLES_DAC2_M3
.set CapSense_CSD_IdacCH0_viDAC8__TRIM__M4, CYREG_FLSHID_CUST_TABLES_DAC2_M4
.set CapSense_CSD_IdacCH0_viDAC8__TRIM__M5, CYREG_FLSHID_CUST_TABLES_DAC2_M5
.set CapSense_CSD_IdacCH0_viDAC8__TRIM__M6, CYREG_FLSHID_CUST_TABLES_DAC2_M6
.set CapSense_CSD_IdacCH0_viDAC8__TRIM__M7, CYREG_FLSHID_CUST_TABLES_DAC2_M7
.set CapSense_CSD_IdacCH0_viDAC8__TRIM__M8, CYREG_FLSHID_CUST_TABLES_DAC2_M8
.set CapSense_CSD_IdacCH0_viDAC8__TST, CYREG_DAC2_TST

/* CapSense_CSD_IntClock */
.set CapSense_CSD_IntClock__CFG0, CYREG_CLKDIST_DCFG0_CFG0
.set CapSense_CSD_IntClock__CFG1, CYREG_CLKDIST_DCFG0_CFG1
.set CapSense_CSD_IntClock__CFG2, CYREG_CLKDIST_DCFG0_CFG2
.set CapSense_CSD_IntClock__CFG2_SRC_SEL_MASK, 0x07
.set CapSense_CSD_IntClock__INDEX, 0x00
.set CapSense_CSD_IntClock__PM_ACT_CFG, CYREG_PM_ACT_CFG2
.set CapSense_CSD_IntClock__PM_ACT_MSK, 0x01
.set CapSense_CSD_IntClock__PM_STBY_CFG, CYREG_PM_STBY_CFG2
.set CapSense_CSD_IntClock__PM_STBY_MSK, 0x01

/* CapSense_CSD_IsrCH0 */
.set CapSense_CSD_IsrCH0__INTC_CLR_EN_REG, CYREG_NVIC_CLRENA0
.set CapSense_CSD_IsrCH0__INTC_CLR_PD_REG, CYREG_NVIC_CLRPEND0
.set CapSense_CSD_IsrCH0__INTC_MASK, 0x01
.set CapSense_CSD_IsrCH0__INTC_NUMBER, 0
.set CapSense_CSD_IsrCH0__INTC_PRIOR_NUM, 7
.set CapSense_CSD_IsrCH0__INTC_PRIOR_REG, CYREG_NVIC_PRI_0
.set CapSense_CSD_IsrCH0__INTC_SET_EN_REG, CYREG_NVIC_SETENA0
.set CapSense_CSD_IsrCH0__INTC_SET_PD_REG, CYREG_NVIC_SETPEND0

/* CapSense_CSD_MeasureCH0 */
.set CapSense_CSD_MeasureCH0_UDB_Counter_u0__16BIT_A0_REG, CYREG_B0_UDB13_14_A0
.set CapSense_CSD_MeasureCH0_UDB_Counter_u0__16BIT_A1_REG, CYREG_B0_UDB13_14_A1
.set CapSense_CSD_MeasureCH0_UDB_Counter_u0__16BIT_D0_REG, CYREG_B0_UDB13_14_D0
.set CapSense_CSD_MeasureCH0_UDB_Counter_u0__16BIT_D1_REG, CYREG_B0_UDB13_14_D1
.set CapSense_CSD_MeasureCH0_UDB_Counter_u0__16BIT_DP_AUX_CTL_REG, CYREG_B0_UDB13_14_ACTL
.set CapSense_CSD_MeasureCH0_UDB_Counter_u0__16BIT_F0_REG, CYREG_B0_UDB13_14_F0
.set CapSense_CSD_MeasureCH0_UDB_Counter_u0__16BIT_F1_REG, CYREG_B0_UDB13_14_F1
.set CapSense_CSD_MeasureCH0_UDB_Counter_u0__A0_A1_REG, CYREG_B0_UDB13_A0_A1
.set CapSense_CSD_MeasureCH0_UDB_Counter_u0__A0_REG, CYREG_B0_UDB13_A0
.set CapSense_CSD_MeasureCH0_UDB_Counter_u0__A1_REG, CYREG_B0_UDB13_A1
.set CapSense_CSD_MeasureCH0_UDB_Counter_u0__D0_D1_REG, CYREG_B0_UDB13_D0_D1
.set CapSense_CSD_MeasureCH0_UDB_Counter_u0__D0_REG, CYREG_B0_UDB13_D0
.set CapSense_CSD_MeasureCH0_UDB_Counter_u0__D1_REG, CYREG_B0_UDB13_D1
.set CapSense_CSD_MeasureCH0_UDB_Counter_u0__DP_AUX_CTL_REG, CYREG_B0_UDB13_ACTL
.set CapSense_CSD_MeasureCH0_UDB_Counter_u0__F0_F1_REG, CYREG_B0_UDB13_F0_F1
.set CapSense_CSD_MeasureCH0_UDB_Counter_u0__F0_REG, CYREG_B0_UDB13_F0
.set CapSense_CSD_MeasureCH0_UDB_Counter_u0__F1_REG, CYREG_B0_UDB13_F1
.set CapSense_CSD_MeasureCH0_UDB_Window_u0__16BIT_A0_REG, CYREG_B0_UDB12_13_A0
.set CapSense_CSD_MeasureCH0_UDB_Window_u0__16BIT_A1_REG, CYREG_B0_UDB12_13_A1
.set CapSense_CSD_MeasureCH0_UDB_Window_u0__16BIT_D0_REG, CYREG_B0_UDB12_13_D0
.set CapSense_CSD_MeasureCH0_UDB_Window_u0__16BIT_D1_REG, CYREG_B0_UDB12_13_D1
.set CapSense_CSD_MeasureCH0_UDB_Window_u0__16BIT_DP_AUX_CTL_REG, CYREG_B0_UDB12_13_ACTL
.set CapSense_CSD_MeasureCH0_UDB_Window_u0__16BIT_F0_REG, CYREG_B0_UDB12_13_F0
.set CapSense_CSD_MeasureCH0_UDB_Window_u0__16BIT_F1_REG, CYREG_B0_UDB12_13_F1
.set CapSense_CSD_MeasureCH0_UDB_Window_u0__A0_A1_REG, CYREG_B0_UDB12_A0_A1
.set CapSense_CSD_MeasureCH0_UDB_Window_u0__A0_REG, CYREG_B0_UDB12_A0
.set CapSense_CSD_MeasureCH0_UDB_Window_u0__A1_REG, CYREG_B0_UDB12_A1
.set CapSense_CSD_MeasureCH0_UDB_Window_u0__D0_D1_REG, CYREG_B0_UDB12_D0_D1
.set CapSense_CSD_MeasureCH0_UDB_Window_u0__D0_REG, CYREG_B0_UDB12_D0
.set CapSense_CSD_MeasureCH0_UDB_Window_u0__D1_REG, CYREG_B0_UDB12_D1
.set CapSense_CSD_MeasureCH0_UDB_Window_u0__DP_AUX_CTL_REG, CYREG_B0_UDB12_ACTL
.set CapSense_CSD_MeasureCH0_UDB_Window_u0__F0_F1_REG, CYREG_B0_UDB12_F0_F1
.set CapSense_CSD_MeasureCH0_UDB_Window_u0__F0_REG, CYREG_B0_UDB12_F0
.set CapSense_CSD_MeasureCH0_UDB_Window_u0__F1_REG, CYREG_B0_UDB12_F1

/* CapSense_CSD_PortCH0 */
.set CapSense_CSD_PortCH0__0__INTTYPE, CYREG_PICU0_INTTYPE5
.set CapSense_CSD_PortCH0__0__MASK, 0x20
.set CapSense_CSD_PortCH0__0__PC, CYREG_PRT0_PC5
.set CapSense_CSD_PortCH0__0__PORT, 0
.set CapSense_CSD_PortCH0__0__SHIFT, 5
.set CapSense_CSD_PortCH0__1__INTTYPE, CYREG_PICU0_INTTYPE6
.set CapSense_CSD_PortCH0__1__MASK, 0x40
.set CapSense_CSD_PortCH0__1__PC, CYREG_PRT0_PC6
.set CapSense_CSD_PortCH0__1__PORT, 0
.set CapSense_CSD_PortCH0__1__SHIFT, 6
.set CapSense_CSD_PortCH0__2__INTTYPE, CYREG_PICU0_INTTYPE0
.set CapSense_CSD_PortCH0__2__MASK, 0x01
.set CapSense_CSD_PortCH0__2__PC, CYREG_PRT0_PC0
.set CapSense_CSD_PortCH0__2__PORT, 0
.set CapSense_CSD_PortCH0__2__SHIFT, 0
.set CapSense_CSD_PortCH0__3__INTTYPE, CYREG_PICU0_INTTYPE1
.set CapSense_CSD_PortCH0__3__MASK, 0x02
.set CapSense_CSD_PortCH0__3__PC, CYREG_PRT0_PC1
.set CapSense_CSD_PortCH0__3__PORT, 0
.set CapSense_CSD_PortCH0__3__SHIFT, 1
.set CapSense_CSD_PortCH0__4__INTTYPE, CYREG_PICU0_INTTYPE2
.set CapSense_CSD_PortCH0__4__MASK, 0x04
.set CapSense_CSD_PortCH0__4__PC, CYREG_PRT0_PC2
.set CapSense_CSD_PortCH0__4__PORT, 0
.set CapSense_CSD_PortCH0__4__SHIFT, 2
.set CapSense_CSD_PortCH0__5__INTTYPE, CYREG_PICU0_INTTYPE3
.set CapSense_CSD_PortCH0__5__MASK, 0x08
.set CapSense_CSD_PortCH0__5__PC, CYREG_PRT0_PC3
.set CapSense_CSD_PortCH0__5__PORT, 0
.set CapSense_CSD_PortCH0__5__SHIFT, 3
.set CapSense_CSD_PortCH0__6__INTTYPE, CYREG_PICU0_INTTYPE4
.set CapSense_CSD_PortCH0__6__MASK, 0x10
.set CapSense_CSD_PortCH0__6__PC, CYREG_PRT0_PC4
.set CapSense_CSD_PortCH0__6__PORT, 0
.set CapSense_CSD_PortCH0__6__SHIFT, 4
.set CapSense_CSD_PortCH0__AG, CYREG_PRT0_AG
.set CapSense_CSD_PortCH0__AMUX, CYREG_PRT0_AMUX
.set CapSense_CSD_PortCH0__BIE, CYREG_PRT0_BIE
.set CapSense_CSD_PortCH0__BIT_MASK, CYREG_PRT0_BIT_MASK
.set CapSense_CSD_PortCH0__Button0__BTN__INTTYPE, CYREG_PICU0_INTTYPE5
.set CapSense_CSD_PortCH0__Button0__BTN__MASK, 0x20
.set CapSense_CSD_PortCH0__Button0__BTN__PC, CYREG_PRT0_PC5
.set CapSense_CSD_PortCH0__Button0__BTN__PORT, 0
.set CapSense_CSD_PortCH0__Button0__BTN__SHIFT, 5
.set CapSense_CSD_PortCH0__Button1__BTN__INTTYPE, CYREG_PICU0_INTTYPE6
.set CapSense_CSD_PortCH0__Button1__BTN__MASK, 0x40
.set CapSense_CSD_PortCH0__Button1__BTN__PC, CYREG_PRT0_PC6
.set CapSense_CSD_PortCH0__Button1__BTN__PORT, 0
.set CapSense_CSD_PortCH0__Button1__BTN__SHIFT, 6
.set CapSense_CSD_PortCH0__BYP, CYREG_PRT0_BYP
.set CapSense_CSD_PortCH0__CTL, CYREG_PRT0_CTL
.set CapSense_CSD_PortCH0__DM0, CYREG_PRT0_DM0
.set CapSense_CSD_PortCH0__DM1, CYREG_PRT0_DM1
.set CapSense_CSD_PortCH0__DM2, CYREG_PRT0_DM2
.set CapSense_CSD_PortCH0__DR, CYREG_PRT0_DR
.set CapSense_CSD_PortCH0__INP_DIS, CYREG_PRT0_INP_DIS
.set CapSense_CSD_PortCH0__INTTYPE_BASE, CYDEV_PICU_INTTYPE_PICU0_BASE
.set CapSense_CSD_PortCH0__LCD_COM_SEG, CYREG_PRT0_LCD_COM_SEG
.set CapSense_CSD_PortCH0__LCD_EN, CYREG_PRT0_LCD_EN
.set CapSense_CSD_PortCH0__LinearSlider0_e0__LS__INTTYPE, CYREG_PICU0_INTTYPE0
.set CapSense_CSD_PortCH0__LinearSlider0_e0__LS__MASK, 0x01
.set CapSense_CSD_PortCH0__LinearSlider0_e0__LS__PC, CYREG_PRT0_PC0
.set CapSense_CSD_PortCH0__LinearSlider0_e0__LS__PORT, 0
.set CapSense_CSD_PortCH0__LinearSlider0_e0__LS__SHIFT, 0
.set CapSense_CSD_PortCH0__LinearSlider0_e1__LS__INTTYPE, CYREG_PICU0_INTTYPE1
.set CapSense_CSD_PortCH0__LinearSlider0_e1__LS__MASK, 0x02
.set CapSense_CSD_PortCH0__LinearSlider0_e1__LS__PC, CYREG_PRT0_PC1
.set CapSense_CSD_PortCH0__LinearSlider0_e1__LS__PORT, 0
.set CapSense_CSD_PortCH0__LinearSlider0_e1__LS__SHIFT, 1
.set CapSense_CSD_PortCH0__LinearSlider0_e2__LS__INTTYPE, CYREG_PICU0_INTTYPE2
.set CapSense_CSD_PortCH0__LinearSlider0_e2__LS__MASK, 0x04
.set CapSense_CSD_PortCH0__LinearSlider0_e2__LS__PC, CYREG_PRT0_PC2
.set CapSense_CSD_PortCH0__LinearSlider0_e2__LS__PORT, 0
.set CapSense_CSD_PortCH0__LinearSlider0_e2__LS__SHIFT, 2
.set CapSense_CSD_PortCH0__LinearSlider0_e3__LS__INTTYPE, CYREG_PICU0_INTTYPE3
.set CapSense_CSD_PortCH0__LinearSlider0_e3__LS__MASK, 0x08
.set CapSense_CSD_PortCH0__LinearSlider0_e3__LS__PC, CYREG_PRT0_PC3
.set CapSense_CSD_PortCH0__LinearSlider0_e3__LS__PORT, 0
.set CapSense_CSD_PortCH0__LinearSlider0_e3__LS__SHIFT, 3
.set CapSense_CSD_PortCH0__LinearSlider0_e4__LS__INTTYPE, CYREG_PICU0_INTTYPE4
.set CapSense_CSD_PortCH0__LinearSlider0_e4__LS__MASK, 0x10
.set CapSense_CSD_PortCH0__LinearSlider0_e4__LS__PC, CYREG_PRT0_PC4
.set CapSense_CSD_PortCH0__LinearSlider0_e4__LS__PORT, 0
.set CapSense_CSD_PortCH0__LinearSlider0_e4__LS__SHIFT, 4
.set CapSense_CSD_PortCH0__PORT, 0
.set CapSense_CSD_PortCH0__PRT, CYREG_PRT0_PRT
.set CapSense_CSD_PortCH0__PRTDSI__CAPS_SEL, CYREG_PRT0_CAPS_SEL
.set CapSense_CSD_PortCH0__PRTDSI__DBL_SYNC_IN, CYREG_PRT0_DBL_SYNC_IN
.set CapSense_CSD_PortCH0__PRTDSI__OE_SEL0, CYREG_PRT0_OE_SEL0
.set CapSense_CSD_PortCH0__PRTDSI__OE_SEL1, CYREG_PRT0_OE_SEL1
.set CapSense_CSD_PortCH0__PRTDSI__OUT_SEL0, CYREG_PRT0_OUT_SEL0
.set CapSense_CSD_PortCH0__PRTDSI__OUT_SEL1, CYREG_PRT0_OUT_SEL1
.set CapSense_CSD_PortCH0__PRTDSI__SYNC_OUT, CYREG_PRT0_SYNC_OUT
.set CapSense_CSD_PortCH0__PS, CYREG_PRT0_PS
.set CapSense_CSD_PortCH0__SLW, CYREG_PRT0_SLW

/* Miscellaneous */
.set BCLK__BUS_CLK__HZ, 24000000
.set BCLK__BUS_CLK__KHZ, 24000
.set BCLK__BUS_CLK__MHZ, 24
.set CYDEV_CHIP_DIE_LEOPARD, 1
.set CYDEV_CHIP_DIE_PANTHER, 19
.set CYDEV_CHIP_DIE_PSOC4A, 11
.set CYDEV_CHIP_DIE_PSOC5LP, 18
.set CYDEV_CHIP_DIE_TMA4, 2
.set CYDEV_CHIP_DIE_UNKNOWN, 0
.set CYDEV_CHIP_FAMILY_PSOC3, 1
.set CYDEV_CHIP_FAMILY_PSOC4, 2
.set CYDEV_CHIP_FAMILY_PSOC5, 3
.set CYDEV_CHIP_FAMILY_UNKNOWN, 0
.set CYDEV_CHIP_FAMILY_USED, CYDEV_CHIP_FAMILY_PSOC5
.set CYDEV_CHIP_JTAG_ID, 0x2E161069
.set CYDEV_CHIP_MEMBER_3A, 1
.set CYDEV_CHIP_MEMBER_4A, 11
.set CYDEV_CHIP_MEMBER_4C, 16
.set CYDEV_CHIP_MEMBER_4D, 7
.set CYDEV_CHIP_MEMBER_4E, 4
.set CYDEV_CHIP_MEMBER_4F, 12
.set CYDEV_CHIP_MEMBER_4G, 2
.set CYDEV_CHIP_MEMBER_4H, 10
.set CYDEV_CHIP_MEMBER_4I, 15
.set CYDEV_CHIP_MEMBER_4J, 8
.set CYDEV_CHIP_MEMBER_4K, 9
.set CYDEV_CHIP_MEMBER_4L, 14
.set CYDEV_CHIP_MEMBER_4M, 13
.set CYDEV_CHIP_MEMBER_4N, 6
.set CYDEV_CHIP_MEMBER_4O, 5
.set CYDEV_CHIP_MEMBER_4U, 3
.set CYDEV_CHIP_MEMBER_5A, 18
.set CYDEV_CHIP_MEMBER_5B, 17
.set CYDEV_CHIP_MEMBER_UNKNOWN, 0
.set CYDEV_CHIP_MEMBER_USED, CYDEV_CHIP_MEMBER_5B
.set CYDEV_CHIP_DIE_EXPECT, CYDEV_CHIP_MEMBER_USED
.set CYDEV_CHIP_DIE_ACTUAL, CYDEV_CHIP_DIE_EXPECT
.set CYDEV_CHIP_REV_LEOPARD_ES1, 0
.set CYDEV_CHIP_REV_LEOPARD_ES2, 1
.set CYDEV_CHIP_REV_LEOPARD_ES3, 3
.set CYDEV_CHIP_REV_LEOPARD_PRODUCTION, 3
.set CYDEV_CHIP_REV_PANTHER_ES0, 0
.set CYDEV_CHIP_REV_PANTHER_ES1, 1
.set CYDEV_CHIP_REV_PANTHER_PRODUCTION, 1
.set CYDEV_CHIP_REV_PSOC4A_ES0, 17
.set CYDEV_CHIP_REV_PSOC4A_PRODUCTION, 17
.set CYDEV_CHIP_REV_PSOC5LP_ES0, 0
.set CYDEV_CHIP_REV_PSOC5LP_PRODUCTION, 0
.set CYDEV_CHIP_REV_TMA4_ES, 17
.set CYDEV_CHIP_REV_TMA4_ES2, 33
.set CYDEV_CHIP_REV_TMA4_PRODUCTION, 17
.set CYDEV_CHIP_REVISION_3A_ES1, 0
.set CYDEV_CHIP_REVISION_3A_ES2, 1
.set CYDEV_CHIP_REVISION_3A_ES3, 3
.set CYDEV_CHIP_REVISION_3A_PRODUCTION, 3
.set CYDEV_CHIP_REVISION_4A_ES0, 17
.set CYDEV_CHIP_REVISION_4A_PRODUCTION, 17
.set CYDEV_CHIP_REVISION_4C_PRODUCTION, 0
.set CYDEV_CHIP_REVISION_4D_PRODUCTION, 0
.set CYDEV_CHIP_REVISION_4E_PRODUCTION, 0
.set CYDEV_CHIP_REVISION_4F_PRODUCTION, 0
.set CYDEV_CHIP_REVISION_4F_PRODUCTION_256DMA, 0
.set CYDEV_CHIP_REVISION_4F_PRODUCTION_256K, 0
.set CYDEV_CHIP_REVISION_4G_ES, 17
.set CYDEV_CHIP_REVISION_4G_ES2, 33
.set CYDEV_CHIP_REVISION_4G_PRODUCTION, 17
.set CYDEV_CHIP_REVISION_4H_PRODUCTION, 0
.set CYDEV_CHIP_REVISION_4I_PRODUCTION, 0
.set CYDEV_CHIP_REVISION_4J_PRODUCTION, 0
.set CYDEV_CHIP_REVISION_4K_PRODUCTION, 0
.set CYDEV_CHIP_REVISION_4L_PRODUCTION, 0
.set CYDEV_CHIP_REVISION_4M_PRODUCTION, 0
.set CYDEV_CHIP_REVISION_4N_PRODUCTION, 0
.set CYDEV_CHIP_REVISION_4O_PRODUCTION, 0
.set CYDEV_CHIP_REVISION_4U_PRODUCTION, 0
.set CYDEV_CHIP_REVISION_5A_ES0, 0
.set CYDEV_CHIP_REVISION_5A_ES1, 1
.set CYDEV_CHIP_REVISION_5A_PRODUCTION, 1
.set CYDEV_CHIP_REVISION_5B_ES0, 0
.set CYDEV_CHIP_REVISION_5B_PRODUCTION, 0
.set CYDEV_CHIP_REVISION_USED, CYDEV_CHIP_REVISION_5B_PRODUCTION
.set CYDEV_CHIP_REV_EXPECT, CYDEV_CHIP_REVISION_USED
.set CYDEV_CONFIG_FASTBOOT_ENABLED, 1
.set CYDEV_CONFIG_UNUSED_IO_AllowButWarn, 0
.set CYDEV_CONFIG_UNUSED_IO, CYDEV_CONFIG_UNUSED_IO_AllowButWarn
.set CYDEV_CONFIG_UNUSED_IO_AllowWithInfo, 1
.set CYDEV_CONFIG_UNUSED_IO_Disallowed, 2
.set CYDEV_CONFIGURATION_COMPRESSED, 1
.set CYDEV_CONFIGURATION_DMA, 0
.set CYDEV_CONFIGURATION_ECC, 1
.set CYDEV_CONFIGURATION_IMOENABLED, CYDEV_CONFIG_FASTBOOT_ENABLED
.set CYDEV_CONFIGURATION_MODE_COMPRESSED, 0
.set CYDEV_CONFIGURATION_MODE, CYDEV_CONFIGURATION_MODE_COMPRESSED
.set CYDEV_CONFIGURATION_MODE_DMA, 2
.set CYDEV_CONFIGURATION_MODE_UNCOMPRESSED, 1
.set CYDEV_DEBUG_ENABLE_MASK, 0x20
.set CYDEV_DEBUG_ENABLE_REGISTER, CYREG_MLOGIC_DEBUG
.set CYDEV_DEBUGGING_DPS_Disable, 3
.set CYDEV_DEBUGGING_DPS_JTAG_4, 1
.set CYDEV_DEBUGGING_DPS_JTAG_5, 0
.set CYDEV_DEBUGGING_DPS_SWD, 2
.set CYDEV_DEBUGGING_DPS_SWD_SWV, 6
.set CYDEV_DEBUGGING_DPS, CYDEV_DEBUGGING_DPS_SWD_SWV
.set CYDEV_DEBUGGING_ENABLE, 1
.set CYDEV_DEBUGGING_XRES, 0
.set CYDEV_DMA_CHANNELS_AVAILABLE, 24
.set CYDEV_ECC_ENABLE, 0
.set CYDEV_HEAP_SIZE, 0x80
.set CYDEV_INSTRUCT_CACHE_ENABLED, 1
.set CYDEV_INTR_RISING, 0x00008001
.set CYDEV_IS_EXPORTING_CODE, 0
.set CYDEV_IS_IMPORTING_CODE, 0
.set CYDEV_PROJ_TYPE, 0
.set CYDEV_PROJ_TYPE_BOOTLOADER, 1
.set CYDEV_PROJ_TYPE_LAUNCHER, 5
.set CYDEV_PROJ_TYPE_LOADABLE, 2
.set CYDEV_PROJ_TYPE_LOADABLEANDBOOTLOADER, 4
.set CYDEV_PROJ_TYPE_MULTIAPPBOOTLOADER, 3
.set CYDEV_PROJ_TYPE_STANDARD, 0
.set CYDEV_PROTECTION_ENABLE, 0
.set CYDEV_STACK_SIZE, 0x0800
.set CYDEV_USE_BUNDLED_CMSIS, 1
.set CYDEV_VARIABLE_VDDA, 0
.set CYDEV_VDDA_MV, 5000
.set CYDEV_VDDD_MV, 5000
.set CYDEV_VDDIO0_MV, 5000
.set CYDEV_VDDIO1_MV, 5000
.set CYDEV_VDDIO2_MV, 5000
.set CYDEV_VDDIO3_MV, 5000
.set CYDEV_VIO0_MV, 5000
.set CYDEV_VIO1_MV, 5000
.set CYDEV_VIO2_MV, 5000
.set CYDEV_VIO3_MV, 5000
.set CYIPBLOCK_ARM_CM3_VERSION, 0
.set CYIPBLOCK_P3_ANAIF_VERSION, 0
.set CYIPBLOCK_P3_CAN_VERSION, 0
.set CYIPBLOCK_P3_CAPSENSE_VERSION, 0
.set CYIPBLOCK_P3_COMP_VERSION, 0
.set CYIPBLOCK_P3_DECIMATOR_VERSION, 0
.set CYIPBLOCK_P3_DFB_VERSION, 0
.set CYIPBLOCK_P3_DMA_VERSION, 0
.set CYIPBLOCK_P3_DRQ_VERSION, 0
.set CYIPBLOCK_P3_DSM_VERSION, 0
.set CYIPBLOCK_P3_EMIF_VERSION, 0
.set CYIPBLOCK_P3_I2C_VERSION, 0
.set CYIPBLOCK_P3_LCD_VERSION, 0
.set CYIPBLOCK_P3_LPF_VERSION, 0
.set CYIPBLOCK_P3_OPAMP_VERSION, 0
.set CYIPBLOCK_P3_PM_VERSION, 0
.set CYIPBLOCK_P3_SCCT_VERSION, 0
.set CYIPBLOCK_P3_TIMER_VERSION, 0
.set CYIPBLOCK_P3_USB_VERSION, 0
.set CYIPBLOCK_P3_VIDAC_VERSION, 0
.set CYIPBLOCK_P3_VREF_VERSION, 0
.set CYIPBLOCK_S8_GPIO_VERSION, 0
.set CYIPBLOCK_S8_IRQ_VERSION, 0
.set CYIPBLOCK_S8_SAR_VERSION, 0
.set CYIPBLOCK_S8_SIO_VERSION, 0
.set CYIPBLOCK_S8_UDB_VERSION, 0
.set DMA_CHANNELS_USED__MASK0, 0x00000000
.set CYDEV_BOOTLOADER_ENABLE, 0
.endif
